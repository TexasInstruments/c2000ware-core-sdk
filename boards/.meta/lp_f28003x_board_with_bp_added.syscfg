/**
 * These arguments were used when this file was generated. They will be automatically applied on subsequent loads
 * via the GUI or CLI. Run CLI with '--help' for additional information on how to override these arguments.
 * @cliArgs --board "/boards/LAUNCHXL_F280049C" --context "system" --product "C2000WARE@4.02.00.00"
 * @versions {"tool":"1.0.0+dev"}
 */
const BOOSTXL_EXAMPLE = scripting.addHardware("/boards/BOOSTXL_EXAMPLE");

/**
 * Import the modules used in this configuration.
 */
const gpio  = scripting.addModule("/driverlib/gpio.js", {}, false);
const gpio1 = gpio.addInstance();
const spi   = scripting.addModule("/driverlib/spi.js", {}, false);
const spi1  = spi.addInstance();

/**
 * Write custom configuration values to the imported modules.
 */
gpio1.$name     = "myGPIO0";
gpio1.$hardware = BOOSTXL_EXAMPLE.components.LED;

spi1.$name          = "mySPI0";
spi1.$hardware      = BOOSTXL_EXAMPLE.components.DRV_SPI;

