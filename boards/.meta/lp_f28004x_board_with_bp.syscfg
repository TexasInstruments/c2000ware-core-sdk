/**
 * These arguments were used when this file was generated. They will be automatically applied on subsequent loads
 * via the GUI or CLI. Run CLI with '--help' for additional information on how to override these arguments.
 * @cliArgs --board "/boards/LAUNCHXL_F280049C" --product "C2000WARE@4.01.00.00"
 * @versions {"tool":"1.0.0+dev"}
 */

var bp = scripting.addHardware("/boards/BOOSTXL_EXAMPLE");