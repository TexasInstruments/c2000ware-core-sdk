/**
 * Import the modules used in this configuration.
 */
const adc     = scripting.addModule("/driverlib/adc.js", {}, false);
const adc1    = adc.addInstance();
const epwm    = scripting.addModule("/driverlib/epwm.js");
const epwm1   = epwm.addInstance();
const gpio    = scripting.addModule("/driverlib/gpio.js", {}, false);
const gpio1   = gpio.addInstance();
const sync    = scripting.addModule("/driverlib/sync.js");
const asysctl = scripting.addModule("/driverlib/asysctl.js");

/**
 * Write custom configuration values to the imported modules.
 */
adc1.$name                    = "myADC0";
adc1.adcBase                  = "ADCA_BASE";


adc1.adcClockPrescaler        = "ADC_CLK_DIV_3_0";

adc1.interruptPulseMode       = "ADC_PULSE_END_OF_CONV";
adc1.enabledSOCs              = ["ADC_SOC_NUMBER0","ADC_SOC_NUMBER1","ADC_SOC_NUMBER2","ADC_SOC_NUMBER3","ADC_SOC_NUMBER4","ADC_SOC_NUMBER5","ADC_SOC_NUMBER6","ADC_SOC_NUMBER7","ADC_SOC_NUMBER8","ADC_SOC_NUMBER9","ADC_SOC_NUMBER10","ADC_SOC_NUMBER11","ADC_SOC_NUMBER12","ADC_SOC_NUMBER13","ADC_SOC_NUMBER14","ADC_SOC_NUMBER15"];

adc1.soc0Channel              = "ADC_CH_ADCIN2";
adc1.soc1Channel              = "ADC_CH_ADCIN2";
adc1.soc2Channel              = "ADC_CH_ADCIN2";
adc1.soc3Channel              = "ADC_CH_ADCIN2";
adc1.soc4Channel              = "ADC_CH_ADCIN2";
adc1.soc5Channel              = "ADC_CH_ADCIN2";
adc1.soc6Channel              = "ADC_CH_ADCIN2";
adc1.soc7Channel              = "ADC_CH_ADCIN2";
adc1.soc8Channel              = "ADC_CH_ADCIN2";
adc1.soc9Channel              = "ADC_CH_ADCIN2";
adc1.soc10Channel             = "ADC_CH_ADCIN2";
adc1.soc11Channel             = "ADC_CH_ADCIN2";
adc1.soc12Channel             = "ADC_CH_ADCIN2";
adc1.soc13Channel             = "ADC_CH_ADCIN2";
adc1.soc14Channel             = "ADC_CH_ADCIN2";
adc1.soc15Channel             = "ADC_CH_ADCIN2";

adc1.soc0SampleWindow         = 8;
adc1.soc1SampleWindow         = 8;
adc1.soc2SampleWindow         = 8;
adc1.soc3SampleWindow         = 8;
adc1.soc4SampleWindow         = 8;
adc1.soc5SampleWindow         = 8;
adc1.soc6SampleWindow         = 8;
adc1.soc7SampleWindow         = 8;
adc1.soc8SampleWindow         = 8;
adc1.soc9SampleWindow         = 8;
adc1.soc10SampleWindow        = 8;
adc1.soc11SampleWindow        = 8;
adc1.soc12SampleWindow        = 8;
adc1.soc13SampleWindow        = 8;
adc1.soc14SampleWindow        = 8;
adc1.soc15SampleWindow        = 8;

adc1.enabledInts             = ["ADC_INT_NUMBER1"];
adc1.enableInterrupt1        = true;
adc1.interrupt1SOCSource     = "ADC_SOC_NUMBER15";
adc1.registerInterrupts      = ["1"];
adc1.enableBurstMode          = true;
adc1.burstTrigger             = "ADC_TRIGGER_EPWM1_SOCA";
adc1.adcInt1.enableInterrupt = true;

asysctl.analogReference        = "INTERNAL";
asysctl.analogReferenceVoltage = "2P5";

scripting.suppress("SOC0 is configured for Round Robin\\. With burst mode enabled, the  burst mode trigger will override the selected trigger for this SOC", adc1, "soc0Trigger");
scripting.suppress("SOC1 is configured for Round Robin\\. With burst mode enabled, the  burst mode trigger will override the selected trigger for this SOC", adc1, "soc1Trigger");
scripting.suppress("SOC2 is configured for Round Robin\\. With burst mode enabled, the  burst mode trigger will override the selected trigger for this SOC", adc1, "soc2Trigger");
scripting.suppress("SOC3 is configured for Round Robin\\. With burst mode enabled, the  burst mode trigger will override the selected trigger for this SOC", adc1, "soc3Trigger");
scripting.suppress("SOC4 is configured for Round Robin\\. With burst mode enabled, the  burst mode trigger will override the selected trigger for this SOC", adc1, "soc4Trigger");
scripting.suppress("SOC5 is configured for Round Robin\\. With burst mode enabled, the  burst mode trigger will override the selected trigger for this SOC", adc1, "soc5Trigger");
scripting.suppress("SOC6 is configured for Round Robin\\. With burst mode enabled, the  burst mode trigger will override the selected trigger for this SOC", adc1, "soc6Trigger");
scripting.suppress("SOC7 is configured for Round Robin\\. With burst mode enabled, the  burst mode trigger will override the selected trigger for this SOC", adc1, "soc7Trigger");
scripting.suppress("SOC8 is configured for Round Robin\\. With burst mode enabled, the  burst mode trigger will override the selected trigger for this SOC", adc1, "soc8Trigger");
scripting.suppress("SOC9 is configured for Round Robin\\. With burst mode enabled, the  burst mode trigger will override the selected trigger for this SOC", adc1, "soc9Trigger");
scripting.suppress("SOC10 is configured for Round Robin\\. With burst mode enabled, the  burst mode trigger will override the selected trigger for this SOC", adc1, "soc10Trigger");
scripting.suppress("SOC11 is configured for Round Robin\\. With burst mode enabled, the  burst mode trigger will override the selected trigger for this SOC", adc1, "soc11Trigger");
scripting.suppress("SOC12 is configured for Round Robin\\. With burst mode enabled, the  burst mode trigger will override the selected trigger for this SOC", adc1, "soc12Trigger");
scripting.suppress("SOC13 is configured for Round Robin\\. With burst mode enabled, the  burst mode trigger will override the selected trigger for this SOC", adc1, "soc13Trigger");
scripting.suppress("SOC14 is configured for Round Robin\\. With burst mode enabled, the  burst mode trigger will override the selected trigger for this SOC", adc1, "soc14Trigger");
scripting.suppress("SOC15 is configured for Round Robin\\. With burst mode enabled, the  burst mode trigger will override the selected trigger for this SOC", adc1, "soc15Trigger");

epwm.commentOutDefaultCode				       = true;
epwm1.$name                                                    = "myEPWM0";
epwm1.epwmEventTrigger_EPWM_SOC_A_triggerEnable                = true;
epwm1.epwmTimebase_hsClockDiv                                  = "EPWM_HSCLOCK_DIVIDER_1";
epwm1.epwmEventTrigger_EPWM_SOC_A_triggerEventPrescalar        = "1";
epwm1.epwmActionQualifier_EPWM_AQ_OUTPUT_A_ON_TIMEBASE_ZERO    = "EPWM_AQ_OUTPUT_HIGH";
epwm1.epwmActionQualifier_EPWM_AQ_OUTPUT_A_ON_TIMEBASE_UP_CMPA = "EPWM_AQ_OUTPUT_LOW";
epwm1.epwmEventTrigger_EPWM_SOC_A_triggerSource                = "EPWM_SOC_TBCTR_U_CMPA";
epwm1.epwmTimebase_counterMode                                 = "EPWM_COUNTER_MODE_UP";
epwm1.epwmTimebase_period                                      = 910;
epwm1.epwmCounterCompare_cmpA                                  = 909;

gpio1.$name           = "myGPIO0";
gpio1.direction       = "GPIO_DIR_MODE_OUT";
gpio1.gpioPin.$assign = "GPIO0";
