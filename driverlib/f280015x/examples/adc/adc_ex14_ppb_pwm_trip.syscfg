/**
 * These arguments were used when this file was generated. They will be automatically applied on subsequent loads
 * via the GUI or CLI. Run CLI with '--help' for additional information on how to override these arguments.
 * @cliArgs --device "F280015x" --part "F280015x_80PN" --package "80PN" --context "system" 
 * @v2CliArgs --device "TMS320F2800157" --package "80PN" --context "system"
 */
/**
 * Blank
 */