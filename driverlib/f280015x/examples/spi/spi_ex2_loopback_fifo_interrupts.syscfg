/**
 * @cliArgs --device "F280015x" --package "80PN" --part "F280015x_80PN" --context "system" --product "C2000WARE@5.02.00.00"
 * @versions {"tool":"1.0.0+dev"}
 */

/**
 * Import the modules used in this configuration.
 */
const device_support = scripting.addModule("/driverlib/device_support.js");
const sysctl         = scripting.addModule("/driverlib/sysctl.js");
const CMD            = scripting.addModule("/utilities/cmd_tool/cmd_syscfg/source/CMD");
const CMD1           = CMD.addInstance();
const CMD2           = CMD.addInstance();
const spi  = scripting.addModule("/driverlib/spi.js", {}, false);
const spi1 = spi.addInstance();

/**
 * Write custom configuration values to the imported modules.
 */
spi1.$name                     = "mySPI0";
spi1.mode                      = "SPI_MODE_CONTROLLER";
spi1.emulationMode             = "SPI_EMULATION_STOP_AFTER_TRANSMIT";
spi1.bitRate                   = 500000;
spi1.enabledFIFOInterrupts     = ["SPI_INT_RXFF","SPI_INT_TXFF"];
spi1.txFifo                    = "SPI_FIFO_TX2";
spi1.rxFifo                    = "SPI_FIFO_RX2";
spi1.loopback                  = true;
spi1.registerInterrupts        = true;
spi1.spi.$assign               = "SPIA";
spi1.spiRXInt.enableInterrupt  = true;
spi1.spiRXInt.$name            = "INT_SPIA_RX";
spi1.spiRXInt.interruptHandler = "spiRxFIFOISR";
spi1.spiTXInt.enableInterrupt  = true;
spi1.spiTXInt.$name            = "INT_SPIA_TX";
spi1.spiTXInt.interruptHandler = "spiTxFIFOISR";

CMD1.$name                    = "generic_ram_lnk";
CMD2.$name                    = "generic_flash_lnk";

CMD1.sectionMemory_text       = ["RAMLS0","RAMLS1"];
CMD1.sectionMemory_ramfunc    = ["RAMM0"];
CMD1.sectionMemory_cinit      = ["RAMM0"];
CMD1.sectionMemory_stack      = ["RAMM1"];
CMD1.sectionMemory_init_array = ["RAMM0"];
CMD1.sectionMemory_bss        = ["RAMLS0"];
CMD1.sectionMemory_const      = ["RAMLS0"];
CMD1.sectionMemory_data       = ["RAMLS0"];
CMD1.sectionMemory_switch     = ["RAMM0"];
CMD1.sectionMemory_sysmem     = ["RAMLS0"];

CMD2.sectionAlignEnable_ramfunc    = true;
CMD2.sectionAlignEnable_text       = true;
CMD2.sectionAlignEnable_binit      = true;
CMD2.sectionAlignEnable_cinit      = true;
CMD2.sectionAlignEnable_switch     = true;
CMD2.sectionAlignEnable_init_array = true;
CMD2.sectionAlignEnable_const      = true;
CMD2.sectionAlignEnable_ovly       = true;
CMD2.sectionMemory_codestart       = "0x080000";
CMD2.sectionMemory_stack           = ["RAMM1"];
CMD2.sectionMemory_ramfunc         = ["FLASH_BANK0_SEC_0_7"];
CMD2.sectionMemory_text            = ["FLASH_BANK0_SEC_16_23","FLASH_BANK0_SEC_24_31","FLASH_BANK0_SEC_8_15"];
CMD2.sectionMemory_binit           = ["FLASH_BANK0_SEC_0_7"];
CMD2.sectionMemory_cinit           = ["FLASH_BANK0_SEC_0_7"];
CMD2.sectionMemory_switch          = ["FLASH_BANK0_SEC_0_7"];
CMD2.sectionMemory_bss             = ["RAMLS0"];
CMD2.sectionMemory_init_array      = ["FLASH_BANK0_SEC_0_7"];
CMD2.sectionMemory_const           = ["FLASH_BANK0_SEC_32_29"];
CMD2.sectionMemory_data            = ["RAMLS0"];
CMD2.sectionMemory_sysmem          = ["RAMLS0"];
CMD2.sectionMemory_ovly            = ["FLASH_BANK0_SEC_0_7"];
CMD2.sectionRunFromDifferentAddr_ramfunc = true;
CMD2.sectionRun_ramfunc                  = ["RAMLS0"];
CMD2.sectionBinit_ramfunc                = false;
