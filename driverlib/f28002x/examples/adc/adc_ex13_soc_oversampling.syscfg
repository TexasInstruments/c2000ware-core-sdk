/**
 * Import the modules used in this configuration.
 */
const adc     = scripting.addModule("/driverlib/adc.js", {}, false);
const adc1    = adc.addInstance();
const asysctl = scripting.addModule("/driverlib/asysctl.js");

/**
 * Write custom configuration values to the imported modules.
 */
adc1.$name                    = "myADC0";
adc1.adcBase                  = "ADCA_BASE";

adc1.adcClockPrescaler        = "ADC_CLK_DIV_2_0";
adc1.interruptPulseMode       = "ADC_PULSE_END_OF_CONV";


adc1.enabledSOCs              = ["ADC_SOC_NUMBER0","ADC_SOC_NUMBER1","ADC_SOC_NUMBER2","ADC_SOC_NUMBER3","ADC_SOC_NUMBER4","ADC_SOC_NUMBER5"];

adc1.soc0Trigger              = "ADC_TRIGGER_EPWM1_SOCA";
adc1.soc1Trigger              = "ADC_TRIGGER_EPWM1_SOCA";
adc1.soc2Trigger              = "ADC_TRIGGER_EPWM1_SOCA";
adc1.soc3Trigger              = "ADC_TRIGGER_EPWM1_SOCA";
adc1.soc4Trigger              = "ADC_TRIGGER_EPWM1_SOCA";
adc1.soc5Trigger              = "ADC_TRIGGER_EPWM1_SOCA";

adc1.soc0Channel              = "ADC_CH_ADCIN0";
adc1.soc1Channel              = "ADC_CH_ADCIN1";
adc1.soc2Channel              = "ADC_CH_ADCIN2";
adc1.soc3Channel              = "ADC_CH_ADCIN2";
adc1.soc4Channel              = "ADC_CH_ADCIN2";
adc1.soc5Channel              = "ADC_CH_ADCIN2";

adc1.soc0SampleWindow        = 8;
adc1.soc1SampleWindow        = 8;
adc1.soc2SampleWindow        = 8;
adc1.soc3SampleWindow        = 8;
adc1.soc4SampleWindow        = 8;
adc1.soc5SampleWindow        = 8;

adc1.enabledInts             = ["ADC_INT_NUMBER1"];
adc1.enableInterrupt1        = true;
adc1.interrupt1SOCSource      = "ADC_SOC_NUMBER5";
adc1.registerInterrupts      = ["1"];
adc1.adcInt1.enableInterrupt = true;
adc1.adcInt1.interruptHandler = "adcA1ISR";

asysctl.analogReference        = "INTERNAL";
asysctl.analogReferenceVoltage = "1P65";
