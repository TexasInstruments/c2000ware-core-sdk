/**
 * Import the modules used in this configuration.
 */
const adc     = scripting.addModule("/driverlib/adc.js", {}, false);
const adc1    = adc.addInstance();
const adc2    = adc.addInstance();
const asysctl = scripting.addModule("/driverlib/asysctl.js");
/**
 * Write custom configuration values to the imported modules.
 */
adc1.$name                   = "myADC0";
adc1.registerInterrupts      = ["1"];
adc1.adcClockPrescaler       = "ADC_CLK_DIV_2_0";
adc1.interruptPulseMode      = "ADC_PULSE_END_OF_CONV";
adc1.enabledSOCs             = ["ADC_SOC_NUMBER0","ADC_SOC_NUMBER1","ADC_SOC_NUMBER10","ADC_SOC_NUMBER11","ADC_SOC_NUMBER12","ADC_SOC_NUMBER13","ADC_SOC_NUMBER14","ADC_SOC_NUMBER15","ADC_SOC_NUMBER2","ADC_SOC_NUMBER3","ADC_SOC_NUMBER4","ADC_SOC_NUMBER5","ADC_SOC_NUMBER6","ADC_SOC_NUMBER7","ADC_SOC_NUMBER8","ADC_SOC_NUMBER9"];
adc1.soc0SampleWindow        = 8;
adc1.soc1SampleWindow        = 8;
adc1.soc2SampleWindow        = 8;
adc1.soc3SampleWindow        = 8;
adc1.soc4SampleWindow        = 8;
adc1.soc5SampleWindow        = 8;
adc1.soc6SampleWindow        = 8;
adc1.soc7SampleWindow        = 8;
adc1.soc8SampleWindow        = 8;
adc1.soc9SampleWindow        = 8;
adc1.soc10SampleWindow       = 8;
adc1.soc11SampleWindow       = 8;
adc1.soc12SampleWindow       = 8;
adc1.soc13SampleWindow       = 8;
adc1.soc14SampleWindow       = 8;
adc1.soc15SampleWindow       = 8;
adc1.soc0Channel             = "ADC_CH_ADCIN3";
adc1.soc1Channel             = "ADC_CH_ADCIN3";
adc1.soc2Channel             = "ADC_CH_ADCIN3";
adc1.soc3Channel             = "ADC_CH_ADCIN3";
adc1.soc4Channel             = "ADC_CH_ADCIN3";
adc1.soc5Channel             = "ADC_CH_ADCIN3";
adc1.soc6Channel             = "ADC_CH_ADCIN3";
adc1.soc7Channel             = "ADC_CH_ADCIN3";
adc1.soc8Channel             = "ADC_CH_ADCIN3";
adc1.soc9Channel             = "ADC_CH_ADCIN3";
adc1.soc10Channel            = "ADC_CH_ADCIN3";
adc1.soc11Channel            = "ADC_CH_ADCIN3";
adc1.soc12Channel            = "ADC_CH_ADCIN3";
adc1.soc13Channel            = "ADC_CH_ADCIN3";
adc1.soc14Channel            = "ADC_CH_ADCIN3";
adc1.soc15Channel            = "ADC_CH_ADCIN3";
adc1.soc0Trigger             = "ADC_TRIGGER_EPWM2_SOCA";
adc1.soc0InterruptTrigger    = "ADC_INT_SOC_TRIGGER_ADCINT1";
adc1.soc1InterruptTrigger    = "ADC_INT_SOC_TRIGGER_ADCINT1";
adc1.soc2InterruptTrigger    = "ADC_INT_SOC_TRIGGER_ADCINT1";
adc1.soc3InterruptTrigger    = "ADC_INT_SOC_TRIGGER_ADCINT1";
adc1.soc4InterruptTrigger    = "ADC_INT_SOC_TRIGGER_ADCINT1";
adc1.soc5InterruptTrigger    = "ADC_INT_SOC_TRIGGER_ADCINT1";
adc1.soc6InterruptTrigger    = "ADC_INT_SOC_TRIGGER_ADCINT1";
adc1.soc7InterruptTrigger    = "ADC_INT_SOC_TRIGGER_ADCINT1";
adc1.soc8InterruptTrigger    = "ADC_INT_SOC_TRIGGER_ADCINT1";
adc1.soc9InterruptTrigger    = "ADC_INT_SOC_TRIGGER_ADCINT1";
adc1.soc10InterruptTrigger   = "ADC_INT_SOC_TRIGGER_ADCINT1";
adc1.soc11InterruptTrigger   = "ADC_INT_SOC_TRIGGER_ADCINT1";
adc1.soc12InterruptTrigger   = "ADC_INT_SOC_TRIGGER_ADCINT1";
adc1.soc13InterruptTrigger   = "ADC_INT_SOC_TRIGGER_ADCINT1";
adc1.soc14InterruptTrigger   = "ADC_INT_SOC_TRIGGER_ADCINT1";
adc1.soc15InterruptTrigger   = "ADC_INT_SOC_TRIGGER_ADCINT1";
adc1.enabledInts             = ["ADC_INT_NUMBER1","ADC_INT_NUMBER2","ADC_INT_NUMBER3","ADC_INT_NUMBER4"];
adc1.enableInterrupt1        = true;
adc1.enableInterrupt2        = true;
adc1.enableInterrupt1ContinuousMode = true;
adc1.enableInterrupt2ContinuousMode = true;
adc1.interrupt1SOCSource     = "ADC_SOC_NUMBER0";
adc1.interrupt2SOCSource     = "ADC_SOC_NUMBER15";
adc1.adcInt1.enableInterrupt = true;
adc1.adcInt1.interruptHandler = "adcA1ISR";

adc2.$name              = "myADC1";
adc2.adcBase            = "ADCC_BASE";
adc2.adcClockPrescaler  = "ADC_CLK_DIV_2_0";
adc2.interruptPulseMode = "ADC_PULSE_END_OF_CONV";
adc2.enabledSOCs             = ["ADC_SOC_NUMBER0","ADC_SOC_NUMBER1","ADC_SOC_NUMBER10","ADC_SOC_NUMBER11","ADC_SOC_NUMBER12","ADC_SOC_NUMBER13","ADC_SOC_NUMBER14","ADC_SOC_NUMBER15","ADC_SOC_NUMBER2","ADC_SOC_NUMBER3","ADC_SOC_NUMBER4","ADC_SOC_NUMBER5","ADC_SOC_NUMBER6","ADC_SOC_NUMBER7","ADC_SOC_NUMBER8","ADC_SOC_NUMBER9"];
adc2.soc0SampleWindow        = 8;
adc2.soc1SampleWindow        = 8;
adc2.soc2SampleWindow        = 8;
adc2.soc3SampleWindow        = 8;
adc2.soc4SampleWindow        = 8;
adc2.soc5SampleWindow        = 8;
adc2.soc6SampleWindow        = 8;
adc2.soc7SampleWindow        = 8;
adc2.soc8SampleWindow        = 8;
adc2.soc9SampleWindow        = 8;
adc2.soc10SampleWindow       = 8;
adc2.soc11SampleWindow       = 8;
adc2.soc12SampleWindow       = 8;
adc2.soc13SampleWindow       = 8;
adc2.soc14SampleWindow       = 8;
adc2.soc15SampleWindow       = 8;
adc2.soc0Channel             = "ADC_CH_ADCIN3";
adc2.soc1Channel             = "ADC_CH_ADCIN3";
adc2.soc2Channel             = "ADC_CH_ADCIN3";
adc2.soc3Channel             = "ADC_CH_ADCIN3";
adc2.soc4Channel             = "ADC_CH_ADCIN3";
adc2.soc5Channel             = "ADC_CH_ADCIN3";
adc2.soc6Channel             = "ADC_CH_ADCIN3";
adc2.soc7Channel             = "ADC_CH_ADCIN3";
adc2.soc8Channel             = "ADC_CH_ADCIN3";
adc2.soc9Channel             = "ADC_CH_ADCIN3";
adc2.soc10Channel            = "ADC_CH_ADCIN3";
adc2.soc11Channel            = "ADC_CH_ADCIN3";
adc2.soc12Channel            = "ADC_CH_ADCIN3";
adc2.soc13Channel            = "ADC_CH_ADCIN3";
adc2.soc14Channel            = "ADC_CH_ADCIN3";
adc2.soc15Channel            = "ADC_CH_ADCIN3";
adc2.soc0Trigger             = "ADC_TRIGGER_EPWM2_SOCA";
adc2.soc0InterruptTrigger    = "ADC_INT_SOC_TRIGGER_ADCINT1";
adc2.soc1InterruptTrigger    = "ADC_INT_SOC_TRIGGER_ADCINT1";
adc2.soc2InterruptTrigger    = "ADC_INT_SOC_TRIGGER_ADCINT1";
adc2.soc3InterruptTrigger    = "ADC_INT_SOC_TRIGGER_ADCINT1";
adc2.soc4InterruptTrigger    = "ADC_INT_SOC_TRIGGER_ADCINT1";
adc2.soc5InterruptTrigger    = "ADC_INT_SOC_TRIGGER_ADCINT1";
adc2.soc6InterruptTrigger    = "ADC_INT_SOC_TRIGGER_ADCINT1";
adc2.soc7InterruptTrigger    = "ADC_INT_SOC_TRIGGER_ADCINT1";
adc2.soc8InterruptTrigger    = "ADC_INT_SOC_TRIGGER_ADCINT1";
adc2.soc9InterruptTrigger    = "ADC_INT_SOC_TRIGGER_ADCINT1";
adc2.soc10InterruptTrigger   = "ADC_INT_SOC_TRIGGER_ADCINT1";
adc2.soc11InterruptTrigger   = "ADC_INT_SOC_TRIGGER_ADCINT1";
adc2.soc12InterruptTrigger   = "ADC_INT_SOC_TRIGGER_ADCINT1";
adc2.soc13InterruptTrigger   = "ADC_INT_SOC_TRIGGER_ADCINT1";
adc2.soc14InterruptTrigger   = "ADC_INT_SOC_TRIGGER_ADCINT1";
adc2.soc15InterruptTrigger   = "ADC_INT_SOC_TRIGGER_ADCINT1";
adc2.enabledInts             = ["ADC_INT_NUMBER1","ADC_INT_NUMBER2","ADC_INT_NUMBER3","ADC_INT_NUMBER4"];
adc2.enableInterrupt1        = true;
adc2.enableInterrupt2        = true;
adc2.interrupt1SOCSource     = "ADC_SOC_NUMBER0";
adc2.interrupt2SOCSource     = "ADC_SOC_NUMBER15";
adc2.enableInterrupt1ContinuousMode = true;
adc2.enableInterrupt2ContinuousMode = true;

asysctl.analogReference         = "INTERNAL";
asysctl.analogReferenceVoltage  = "1P65";
