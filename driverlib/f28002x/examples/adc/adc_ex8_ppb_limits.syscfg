/**
 * Import the modules used in this configuration.
 */
const adc     = scripting.addModule("/driverlib/adc.js", {}, false);
const adc1    = adc.addInstance();
const asysctl = scripting.addModule("/driverlib/asysctl.js");

/**
 * Write custom configuration values to the imported modules.
 */
adc1.$name                    = "myADC0";
adc1.adcClockPrescaler       = "ADC_CLK_DIV_2_0";
adc1.interruptPulseMode       = "ADC_PULSE_END_OF_CONV";
adc1.enabledSOCs              = ["ADC_SOC_NUMBER0"];
adc1.soc0Trigger              = "ADC_TRIGGER_EPWM1_SOCA";
adc1.soc0SampleWindow      = 8;
adc1.enabledInts              = ["ADC_INT_NUMBER1"];
adc1.enableInterrupt1         = true;
adc1.enabledPPBs              = ["ADC_PPB_NUMBER1"];
adc1.ppb1HighTripLimit        = 3000;
adc1.ppb1LowTripLimit         = 1000;
adc1.ppb1EventInterruptEnable = ["ADC_EVT_TRIPHI","ADC_EVT_TRIPLO"];
adc1.registerInterrupts          = ["5"];
adc1.adcIntEvent.enableInterrupt = true;
adc1.adcIntEvent.interruptHandler = "adcAEvtISR";

asysctl.analogReference         = "INTERNAL";
asysctl.analogReferenceVoltage  = "1P65";
