/**
 * Import the modules used in this configuration.
 */
const clb         = scripting.addModule("/driverlib/clb.js", {}, false);
const clb1        = clb.addInstance();
const clb2        = clb.addInstance();
const clbxbar     = scripting.addModule("/driverlib/clbxbar.js", {}, false);
const clbxbar1    = clbxbar.addInstance();
const epwm        = scripting.addModule("/driverlib/epwm.js", {}, false);
const epwm1       = epwm.addInstance();
const inputxbar   = scripting.addModule("/driverlib/inputxbar.js", {}, false);
const inputxbar1  = inputxbar.addInstance();
const outputxbar  = scripting.addModule("/driverlib/outputxbar.js", {}, false);
const outputxbar1 = outputxbar.addInstance();
const TILE        = scripting.addModule("/utilities/clb_tool/clb_syscfg/source/TILE");
const TILE1       = TILE.addInstance();
const TILE2       = TILE.addInstance();

/**
 * Write custom configuration values to the imported modules.
 */
clb1.$name               = "myTILE1";
clb1.enableCLB           = true;
clb1.inputsUsed          = ["CLB_IN0"];
clb1.inputTypeCLB_IN0    = "GLOBAL";
clb1.synchronizeCLB_IN0  = true;
clb1.globalConfigCLB_IN0 = "CLB_GLOBAL_IN_MUX_CLB_AUXSIG0";

clb2.$name                       = "myTILE2";
clb2.clbBase                     = "CLB2_BASE";
clb2.enableCLB                   = true;
clb2.outputsToOverridePeripheral = ["CLB_OUT0"];

clbxbar1.$name      = "myCLBXBAR1";
clbxbar1.muxesUsed  = ["XBAR_MUX01"];
clbxbar1.mux1Config = "XBAR_CLB_MUX01_INPUTXBAR1";

epwm1.useCase                = "CUSTOM";
epwm1.useInterfacePins       = ["EPWM#_A"];
epwm1.$name                  = "myEPWM2";
epwm1.epwm.$assign           = "EPWM2";
epwm1.epwm.epwm_aPin.$assign = "GPIO2";

inputxbar1.inputsUsed     = ["inputxbar1Gpio"];
inputxbar1.inputxbar1Gpio = "GPIO2";
inputxbar1.$name          = "myINPUTXBAR1";

outputxbar1.$name                            = "myOUTPUTXBAR1";
outputxbar1.muxesUsed                        = ["XBAR_MUX01"];
outputxbar1.mux1Config                       = "XBAR_OUT_MUX01_CLB1_OUT4";
outputxbar1.outputxbar.$assign               = "OUTPUTXBAR1";
outputxbar1.outputxbar.outputxbarPin.$assign = "GPIO24";

TILE.clock_period = 10000;
TILE.sim_duration = 100000000;

TILE1.$name                     = "TILE2";
TILE1.BOUNDARY.$name            = "BOUNDARY0";
TILE1.BOUNDARY.in_repeat_count0 = 50;
TILE1.BOUNDARY.in_repeat_count3 = 1;
TILE1.BOUNDARY.in_repeat_count1 = 50;
TILE1.BOUNDARY.in_repeat_count2 = 50;
TILE1.BOUNDARY.in_period0       = 10000;
TILE1.BOUNDARY.in_duty0         = 5001;
TILE1.BOUNDARY.in_period1       = 1000;
TILE1.BOUNDARY.in_duty1         = 500;
TILE1.BOUNDARY.in_period2       = 3000;
TILE1.BOUNDARY.in_duty2         = 1500;
TILE1.LUT_0.$name               = "LUT_0";
TILE1.LUT_1.$name               = "LUT_1";
TILE1.LUT_2.$name               = "LUT_2";
TILE1.FSM_0.$name               = "FSM_0";
TILE1.FSM_1.$name               = "FSM_1";
TILE1.FSM_2.$name               = "FSM_2";
TILE1.COUNTER_0.$name           = "COUNTER_0";
TILE1.COUNTER_0.mode0           = "1";
TILE1.COUNTER_0.mode1           = "1";
TILE1.COUNTER_0.match1_val      = "1000";
TILE1.COUNTER_0.reset           = "COUNTER_0.count_match1";
TILE1.COUNTER_1.$name           = "COUNTER_1";
TILE1.COUNTER_2.$name           = "COUNTER_2";
TILE1.OUTLUT_0.$name            = "OUTLUT_0";
TILE1.OUTLUT_0.i0               = "COUNTER_0.count_match1";
TILE1.OUTLUT_0.eqn              = "i0";
TILE1.OUTLUT_1.$name            = "OUTLUT_1";
TILE1.OUTLUT_2.$name            = "OUTLUT_2";
TILE1.OUTLUT_3.$name            = "OUTLUT_3";
TILE1.OUTLUT_4.$name            = "OUTLUT_4";
TILE1.OUTLUT_5.$name            = "OUTLUT_5";
TILE1.OUTLUT_6.$name            = "OUTLUT_6";
TILE1.OUTLUT_7.$name            = "OUTLUT_7";
TILE1.HLC.$name                 = "HLC_0";
TILE1.HLC.program0.$name        = "HLCP_0";
TILE1.HLC.program0.instruct0    = "INTR 0";
TILE1.HLC.program1.$name        = "HLCP_1";
TILE1.HLC.program2.$name        = "HLCP_2";
TILE1.HLC.program3.$name        = "HLCP_3";
TILE1.AOC_0.$name               = "AOC_0";
TILE1.AOC_1.$name               = "AOC_1";
TILE1.AOC_2.$name               = "AOC_2";
TILE1.AOC_3.$name               = "AOC_3";
TILE1.AOC_4.$name               = "AOC_4";
TILE1.AOC_5.$name               = "AOC_5";
TILE1.AOC_6.$name               = "AOC_6";
TILE1.AOC_7.$name               = "AOC_7";

TILE2.$name              = "TILE1";
TILE2.BOUNDARY.$name     = "BOUNDARY1";
TILE2.BOUNDARY.boundaryInput0               = "tileOutput";
TILE2.BOUNDARY.tileSelect0                  = "TILE2";
TILE2.BOUNDARY.tileOutputSelect0            = 0;
TILE2.BOUNDARY.input_pipeline0              = true;
TILE2.LUT_0.$name        = "LUT_3";
TILE2.LUT_1.$name        = "LUT_4";
TILE2.LUT_2.$name        = "LUT_5";
TILE2.FSM_0.$name        = "FSM_3";
TILE2.FSM_0.e0           = "BOUNDARY.in0";
TILE2.FSM_0.eqn_s0       = "e0 ^ s0";
TILE2.FSM_1.$name        = "FSM_4";
TILE2.FSM_2.$name        = "FSM_5";
TILE2.COUNTER_0.$name    = "COUNTER_3";
TILE2.COUNTER_1.$name    = "COUNTER_4";
TILE2.COUNTER_2.$name    = "COUNTER_5";
TILE2.OUTLUT_0.$name     = "OUTLUT_8";
TILE2.OUTLUT_1.$name     = "OUTLUT_9";
TILE2.OUTLUT_2.$name     = "OUTLUT_10";
TILE2.OUTLUT_3.$name     = "OUTLUT_11";
TILE2.OUTLUT_4.$name     = "OUTLUT_12";
TILE2.OUTLUT_4.i0        = "FSM_0.S0";
TILE2.OUTLUT_4.eqn       = "i0";
TILE2.OUTLUT_5.$name     = "OUTLUT_13";
TILE2.OUTLUT_6.$name     = "OUTLUT_14";
TILE2.OUTLUT_7.$name     = "OUTLUT_15";
TILE2.HLC.$name          = "HLC_1";
TILE2.HLC.program0.$name = "HLCP_4";
TILE2.HLC.program1.$name = "HLCP_5";
TILE2.HLC.program2.$name = "HLCP_6";
TILE2.HLC.program3.$name = "HLCP_7";
TILE2.AOC_0.$name        = "AOC_8";
TILE2.AOC_1.$name        = "AOC_9";
TILE2.AOC_2.$name        = "AOC_10";
TILE2.AOC_3.$name        = "AOC_11";
TILE2.AOC_4.$name        = "AOC_12";
TILE2.AOC_5.$name        = "AOC_13";
TILE2.AOC_6.$name        = "AOC_14";
TILE2.AOC_7.$name        = "AOC_15";
