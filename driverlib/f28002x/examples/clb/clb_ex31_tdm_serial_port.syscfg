/**
 * Import the modules used in this configuration.
 */
const clb                  = scripting.addModule("/driverlib/clb.js", {}, false);
const clb1                 = clb.addInstance();
const clb_inputxbar        = scripting.addModule("/driverlib/clb_inputxbar.js", {}, false);
const clb_inputxbar1       = clb_inputxbar.addInstance();
const clb_inputxbar_input  = scripting.addModule("/driverlib/clb_inputxbar_input.js");
const clb_inputxbar_input1 = clb_inputxbar_input.addInstance();
const clb_inputxbar_input2 = clb_inputxbar_input.addInstance();
const clb_inputxbar_input3 = clb_inputxbar_input.addInstance();
const clb_outputxbar       = scripting.addModule("/driverlib/clb_outputxbar.js", {}, false);
const clb_outputxbar1      = clb_outputxbar.addInstance();
const clb_outputxbar2      = clb_outputxbar.addInstance();
const gpio                 = scripting.addModule("/driverlib/gpio.js", {}, false);
const gpio1                = gpio.addInstance();
const gpio2                = gpio.addInstance();
const gpio3                = gpio.addInstance();
const outputxbar           = scripting.addModule("/driverlib/outputxbar.js", {}, false);
const outputxbar1          = outputxbar.addInstance();
const TILE                 = scripting.addModule("/utilities/clb_tool/clb_syscfg/source/TILE");
const TILE1                = TILE.addInstance();

/**
 * Write custom configuration values to the imported modules.
 */
clb1.globalConfigCLB_IN0     = "CLB_GLOBAL_IN_MUX_CLB_AUXSIG0";
clb1.globalConfigCLB_IN1     = "CLB_GLOBAL_IN_MUX_CLB_AUXSIG1";
clb1.$name                   = "myCLBForTILE1";
clb1.prescale                = 10000;
clb1.tap                     = 5;
clb1.globalConfigCLB_IN2     = "CLB_GLOBAL_IN_MUX_CLB_AUXSIG2";
clb1.globalConfigCLB_IN3     = "CLB_GLOBAL_IN_MUX_CLB_AUXSIG3";
clb1.inputTypeCLB_IN0        = "LOCAL";
clb1.localConfigCLB_IN0      = "CLB_LOCAL_IN_MUX_INPUT1";
clb1.inputTypeCLB_IN1        = "LOCAL";
clb1.localConfigCLB_IN1      = "CLB_LOCAL_IN_MUX_INPUT2";
clb1.inputTypeCLB_IN2        = "LOCAL";
clb1.localConfigCLB_IN2      = "CLB_LOCAL_IN_MUX_INPUT3";
clb1.inputTypeCLB_IN3        = "LOCAL";
clb1.localConfigCLB_IN3      = "CLB_LOCAL_IN_MUX_INPUT1";
clb1.inputTypeCLB_IN4        = "LOCAL";
clb1.synchronizeCLB_IN0      = true;
clb1.synchronizeCLB_IN3      = true;
clb1.inputTypeCLB_IN5        = "LOCAL";
clb1.localConfigCLB_IN5      = "CLB_LOCAL_IN_MUX_INPUT1";
clb1.synchronizeCLB_IN5      = true;
clb1.inputTypeCLB_IN6        = "LOCAL";
clb1.localConfigCLB_IN6      = "CLB_LOCAL_IN_MUX_INPUT2";
clb1.synchronizeCLB_IN2      = true;
clb1.synchronizeCLB_IN1      = true;
clb1.filterConfigCLB_IN0     = "CLB_FILTER_FALLING_EDGE";
clb1.filterConfigCLB_IN3     = "CLB_FILTER_RISING_EDGE";
clb1.filterConfigCLB_IN6     = "CLB_FILTER_FALLING_EDGE";
clb1.synchronizeCLB_IN6      = true;
clb1.localConfigCLB_IN4      = "CLB_LOCAL_IN_MUX_INPUT2";
clb1.synchronizeCLB_IN4      = true;
clb1.filterConfigCLB_IN4     = "CLB_FILTER_RISING_EDGE";
clb1.inputsUsed              = ["CLB_IN0","CLB_IN1","CLB_IN2","CLB_IN3","CLB_IN5"];
clb1.registerInterrupts      = true;
clb1.clbInt.interruptHandler = "clbISR";

clb_inputxbar1.$name = "myCLBINPUTXBAR";

clb_inputxbar_input1.$name         = "CLBINPUTXBAR_BCLK_IN";
clb_inputxbar_input1.inputxbarGpio = "GPIO1";

clb_inputxbar_input2.inputxbarInput = "XBAR_INPUT2";
clb_inputxbar_input2.$name          = "CLBINPUTXBAR_FSYNC_IN";

clb_inputxbar_input3.inputxbarInput = "XBAR_INPUT3";
clb_inputxbar_input3.$name          = "CLBINPUTXBAR_DATA1_IN";
clb_inputxbar_input3.inputxbarGpio  = "GPIO2";
clb_outputxbar1.muxesUsed                                = ["XBAR_MUX04"];
clb_outputxbar1.$name                                    = "CLB_FSYNC_OUT";
clb_outputxbar1.clb_outputxbar.$assign                   = "CLB_OUTPUTXBAR6";
clb_outputxbar1.clb_outputxbar.clb_outputxbarPin.$assign = "GPIO4";
clb_outputxbar2.muxesUsed                                = ["XBAR_MUX00"];
clb_outputxbar2.$name                                    = "CLB_DATA1_OUT";
clb_outputxbar2.clb_outputxbar.$assign                   = "CLB_OUTPUTXBAR8";
clb_outputxbar2.clb_outputxbar.clb_outputxbarPin.$assign = "GPIO6";

gpio1.qualMode        = "GPIO_QUAL_ASYNC";
gpio1.$name           = "CLB_BCLK_IN";
gpio1.padConfig       = "PULLUP_INVERT";
gpio1.gpioPin.$assign = "GPIO1";

gpio2.qualMode        = "GPIO_QUAL_ASYNC";
gpio2.padConfig       = "PULLUP";
gpio2.$name           = "CLB_FSYNC_IN";
gpio2.gpioPin.$assign = "GPIO0";

gpio3.qualMode        = "GPIO_QUAL_ASYNC";
gpio3.$name           = "CLB_DATA1_IN";
gpio3.gpioPin.$assign = "GPIO2";

outputxbar1.$name                            = "CLB_BCLK_OUT";
outputxbar1.muxesUsed                        = ["XBAR_MUX03"];
outputxbar1.mux3Config                       = "XBAR_OUT_MUX03_CLB1_OUT5";
outputxbar1.outputxbar.$assign               = "OUTPUTXBAR3";
outputxbar1.outputxbar.outputxbarPin.$assign = "GPIO5";

TILE.clock_period = 10000;
TILE.sim_duration = 100000000;

TILE1.$name                     = "TILE1";
TILE1.BOUNDARY.$name            = "BOUNDARY0";
TILE1.BOUNDARY.in0              = "squareWave";
TILE1.BOUNDARY.in_duty0         = 4;
TILE1.BOUNDARY.in1              = "squareWave";
TILE1.BOUNDARY.in_duty1         = 8;
TILE1.BOUNDARY.in_repeat_count1 = 8;
TILE1.BOUNDARY.in2              = "squareWave";
TILE1.BOUNDARY.in_repeat_count2 = 16000;
TILE1.BOUNDARY.in3              = "squareWave";
TILE1.BOUNDARY.in_duty3         = 4;
TILE1.BOUNDARY.in_repeat_count3 = 10000;
TILE1.BOUNDARY.in4              = "squareWave";
TILE1.BOUNDARY.in_sync1         = true;
TILE1.BOUNDARY.in_sync0         = true;
TILE1.BOUNDARY.in_sync2         = true;
TILE1.BOUNDARY.in_sync3         = true;
TILE1.BOUNDARY.in_sync4         = true;
TILE1.BOUNDARY.in6              = "squareWave";
TILE1.BOUNDARY.in_duty6         = 8;
TILE1.BOUNDARY.in_repeat_count6 = 8;
TILE1.BOUNDARY.in5              = "squareWave";
TILE1.BOUNDARY.in_duty5         = 4;
TILE1.BOUNDARY.in_repeat_count5 = 10000;
TILE1.BOUNDARY.in_period0       = 201;
TILE1.BOUNDARY.in_period3       = 201;
TILE1.BOUNDARY.in_edge0         = "falling edge";
TILE1.BOUNDARY.in_period1       = 202;
TILE1.BOUNDARY.in_period2       = 16;
TILE1.BOUNDARY.in_duty2         = 8;
TILE1.BOUNDARY.in_period6       = 202;
TILE1.BOUNDARY.in_period5       = 201;
TILE1.BOUNDARY.in_edge3         = "rising edge";
TILE1.BOUNDARY.in_edge6         = "falling edge";
TILE1.BOUNDARY.in_sync6         = true;
TILE1.BOUNDARY.in_period4       = 202;
TILE1.BOUNDARY.in_duty4         = 8;
TILE1.BOUNDARY.in_repeat_count4 = 8;
TILE1.BOUNDARY.in_edge4         = "rising edge";
TILE1.BOUNDARY.in_repeat_count0 = 16000;
TILE1.LUT_0.$name               = "LUT_0";
TILE1.LUT_0.i0                  = "BOUNDARY.in1";
TILE1.LUT_0.i1                  = "BOUNDARY.in0";
TILE1.LUT_0.eqn                 = "i0&i1";
TILE1.LUT_1.$name               = "LUT_1";
TILE1.LUT_1.eqn                 = "(i0&i2)|i1";
TILE1.LUT_1.i0                  = "BOUNDARY.in1";
TILE1.LUT_1.i1                  = "COUNTER_2.count_match1";
TILE1.LUT_1.i2                  = "BOUNDARY.in0";
TILE1.LUT_2.$name               = "LUT_2";
TILE1.FSM_0.$name               = "FSM_0";
TILE1.FSM_0.e0                  = "BOUNDARY.in3";
TILE1.FSM_0.e1                  = "LUT_0.OUT";
TILE1.FSM_0.eqn_s1              = "!e1&!e0&s1&!s0  | !e1&e0&!s1&s0";
TILE1.FSM_0.eqn_s0              = "!e1&!e0&!s1&s0 | e1&!e0&!s1&!s0";
TILE1.FSM_0.eqn_out             = "!e1&s1&!s0 | !e0&s1&!s0";
TILE1.FSM_1.$name               = "FSM_1";
TILE1.FSM_1.eqn_out             = "s1&s0&e0 | s1&s0&e1";
TILE1.FSM_1.eqn_s0              = "!s0&!e1&e0 | s0&!e1&!e0";
TILE1.FSM_1.eqn_s1              = "s1&!s0&!e1 | s1&!e1&!e0 | !s1&s0&!e1&e0";
TILE1.FSM_1.e1                  = "BOUNDARY.in1";
TILE1.FSM_1.e0                  = "LUT_1.OUT";
TILE1.FSM_2.$name               = "FSM_2";
TILE1.FSM_2.e1                  = "COUNTER_1.count_match1";
TILE1.FSM_2.e0                  = "BOUNDARY.in3";
TILE1.FSM_2.eqn_s0              = " !e0&s0 | e1&e0";
TILE1.COUNTER_0.$name           = "COUNTER_0";
TILE1.COUNTER_0.serializer_en   = true;
TILE1.COUNTER_0.action          = "Shift Right";
TILE1.COUNTER_0.event           = "BOUNDARY.in2";
TILE1.COUNTER_0.mode1           = "1";
TILE1.COUNTER_0.mode0           = "BOUNDARY.in0";
TILE1.COUNTER_1.$name           = "COUNTER_1";
TILE1.COUNTER_1.match1_tap_sel  = 31;
TILE1.COUNTER_1.mode1           = "1";
TILE1.COUNTER_1.serializer_en   = true;
TILE1.COUNTER_1.action          = "Load";
TILE1.COUNTER_1.match1_tap_en   = true;
TILE1.COUNTER_1.mode0           = "BOUNDARY.in3";
TILE1.COUNTER_1.event           = "1";
TILE1.COUNTER_2.$name           = "COUNTER_2";
TILE1.COUNTER_2.mode1           = "1";
TILE1.COUNTER_2.match1_val      = "32";
TILE1.COUNTER_2.match2_val      = "31";
TILE1.COUNTER_2.mode0           = "BOUNDARY.in0";
TILE1.COUNTER_2.reset           = "LUT_1.OUT";
TILE1.OUTLUT_0.$name            = "OUTLUT_0";
TILE1.OUTLUT_0.eqn              = "i0";
TILE1.OUTLUT_0.i0               = "FSM_2.S0";
TILE1.OUTLUT_1.$name            = "OUTLUT_1";
TILE1.OUTLUT_2.$name            = "OUTLUT_2";
TILE1.OUTLUT_3.$name            = "OUTLUT_3";
TILE1.OUTLUT_4.$name            = "OUTLUT_4";
TILE1.OUTLUT_4.eqn              = "i0";
TILE1.OUTLUT_4.i0               = "FSM_0.OUT";
TILE1.OUTLUT_5.$name            = "OUTLUT_5";
TILE1.OUTLUT_5.i0               = "BOUNDARY.in5";
TILE1.OUTLUT_5.eqn              = "i0";
TILE1.OUTLUT_6.$name            = "OUTLUT_6";
TILE1.OUTLUT_7.$name            = "OUTLUT_7";
TILE1.HLC.$name                 = "HLC_0";
TILE1.HLC.e2                    = "FSM_1.OUT";
TILE1.HLC.e1                    = "COUNTER_2.count_match2";
TILE1.HLC.e0                    = "LUT_1.OUT";
TILE1.HLC.program0.$name        = "HLCP_0";
TILE1.HLC.program0.instruct0    = "pull r1";
TILE1.HLC.program1.$name        = "HLCP_1";
TILE1.HLC.program1.instruct0    = "push c0";
TILE1.HLC.program1.instruct1    = "mov r1,c1";
TILE1.HLC.program2.$name        = "HLCP_2";
TILE1.HLC.program2.instruct0    = "intr 1";
TILE1.HLC.program3.$name        = "HLCP_3";
TILE1.AOC_0.$name               = "AOC_0";
TILE1.AOC_1.$name               = "AOC_1";
TILE1.AOC_2.$name               = "AOC_2";
TILE1.AOC_3.$name               = "AOC_3";
TILE1.AOC_4.$name               = "AOC_4";
TILE1.AOC_5.$name               = "AOC_5";
TILE1.AOC_5.bypass_mux          = false;
TILE1.AOC_5.input_mode          = "INPUT";
TILE1.AOC_6.$name               = "AOC_6";
TILE1.AOC_7.$name               = "AOC_7";
