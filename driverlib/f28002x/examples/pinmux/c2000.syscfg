/**
 * These arguments were used when this file was generated. They will be automatically applied on subsequent loads
 * via the GUI or CLI. Run CLI with '--help' for additional information on how to override these arguments.
 * @cliArgs --device "F28002x" --part "F28002x_80QFP" --package "80QFP" --context "system" 
 * @v2CliArgs --device "TMS320F280025C" --package "80QFP" --context "system"
 */