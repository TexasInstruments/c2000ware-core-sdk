/**
 * @cliArgs --device "F28003x" --package "100PZ" --part "F28003x_100PZ" --context "system" --product "C2000WARE@4.02.00.00"
 * @versions {"tool":"1.12.0+2406"}
 */

/**
 * Import the modules used in this configuration.
 */
const FFT  = scripting.addModule("/libraries/dsp/FPU/FFT/FFT.js", {}, false);
const FFT1 = FFT.addInstance();

/**
 * Write custom configuration values to the imported modules.
 */
FFT1.$name             = "myFFT0";
FFT1.CFFT.create(1);
FFT1.CFFT[0].$name     = "myCFFT0";
FFT1.CFFT[0].inPtr     = "inPtr";
FFT1.CFFT[0].outPtr    = "outPtr";
FFT1.CFFT[0].numStages = 7;
FFT1.CFFT[0].coeffPtr  = "twiddleFacs";
