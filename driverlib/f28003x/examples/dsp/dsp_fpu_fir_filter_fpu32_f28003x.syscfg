/**
 * @cliArgs --device "F28003x" --package "100PZ" --part "F28003x_100PZ" --context "system" --product "C2000WARE@4.02.00.00"
 * @versions {"tool":"1.12.0+2406"}
 */

/**
 * Import the modules used in this configuration.
 */
const Filter  = scripting.addModule("/libraries/dsp/FPU/Filter/Filter.js", {}, false);
const Filter1 = Filter.addInstance();

/**
 * Write custom configuration values to the imported modules.
 */
Filter1.$name              = "myFILTER0";
Filter1.FIR.create(1);
Filter1.FIR[0].$name       = "myFIR0";
Filter1.FIR[0].coeffPtr    = "filPtr";
Filter1.FIR[0].dBuffPtr    = "delPtr";
Filter1.FIR[0].filterOrder = 58;
