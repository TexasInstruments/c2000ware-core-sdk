/**
 * These arguments were used when this file was generated. They will be automatically applied on subsequent loads
 * via the GUI or CLI. Run CLI with '--help' for additional information on how to override these arguments.
 * @cliArgs --device "F28003x" --package "100PZ" --part "F28003x_100PZ" --product "C2000WARE@4.02.00.00"
 * @versions {"tool":"1.11.0+2225"}
 */

/**
 * Import the modules used in this configuration.
 */
const Vector  = scripting.addModule("/libraries/dsp/FPU/Vector/Vector.js", {}, false);
const Vector1 = Vector.addInstance();

/**
 * Write custom configuration values to the imported modules.
 */
Vector1.$name = "myVEC0";
