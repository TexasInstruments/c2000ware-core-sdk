/**
 * Import the modules used in this configuration.
 */
const eqep  = scripting.addModule("/driverlib/eqep.js", {}, false);
const eqep1 = eqep.addInstance();

/**
 * Write custom configuration values to the imported modules.
 */
eqep1.$name                = "myEQEP0";
eqep1.selectSourceA        = "EQEP_SOURCE_PWMXBAR1";
eqep1.eqepOperationMode    = "EQEP_CONFIG_UP_COUNT";
eqep1.positionCounterMax   = 4294967295;
eqep1.enableUnitTimer      = true;
eqep1.unitTimerPeriod      = 1200000;
eqep1.latchPositionCounter = "EQEP_LATCH_UNIT_TIME_OUT";
eqep1.swPositionInit       = true;
eqep1.enableModule         = true;
eqep1.captureConfig        = true;
eqep1.capPrescale          = "EQEP_CAPTURE_CLK_DIV_128";
eqep1.evntPrescale         = "EQEP_UNIT_POS_EVNT_DIV_8";
eqep1.enableCapture        = true;
eqep1.eqep.$assign         = "EQEP1";
