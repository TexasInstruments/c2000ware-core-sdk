/**
 * These arguments were used when this file was generated. They will be automatically applied on subsequent loads
 * via the GUI or CLI. Run CLI with '--help' for additional information on how to override these arguments.
 * @cliArgs --device "F28003x" --part "F28003x_100PZ" --package "100PZ" --context "system"
 * @v2CliArgs  --device "TMS320F280039C" --package "100PZ" --context "system"
 */
/**
 * Import the modules used in this configuration.
 */
const fastintdiv  = scripting.addModule("/libraries/math/FASTINTDIV/fastintdiv.js", {}, false);
const fastintdiv1 = fastintdiv.addInstance();
/**
 * Write custom configuration values to the imported modules.
 */
fastintdiv1.$name = "myFID0";