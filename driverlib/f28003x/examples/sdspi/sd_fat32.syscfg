/**
 * @cliArgs --device "F2838x" --package "337bga" --part "F2838x_337bga" --product "C2000WARE@3.01.00.00"
 * @versions {"tool":"1.10.0+2163"}
 */

/**
 * Import the modules used in this configuration.
 */
const gpio  = scripting.addModule("/driverlib/gpio.js", {}, false);
const gpio1 = gpio.addInstance();
const spi   = scripting.addModule("/driverlib/spi.js", {}, false);
const spi1  = spi.addInstance();

/**
 * Write custom configuration values to the imported modules.
 */
gpio1.$name             = "mySDCardCS";
gpio1.writeInitialValue = true;
gpio1.initialValue      = 1;
gpio1.direction         = "GPIO_DIR_MODE_OUT";

spi1.mode                    = "SPI_MODE_MASTER";
spi1.emulationMode           = "SPI_EMULATION_STOP_AFTER_TRANSMIT";
spi1.bitRate                 = 1000000;
spi1.dataWidth               = "8";
spi1.transferProtocol        = "SPI_PROT_POL0PHA1";
spi1.$name                   = "mySDCardSPI";
spi1.useCase                 = "CUSTOM";
spi1.useInterrupts           = false;
