/**
 * Import the modules used in this configuration.
 */
const adc     = scripting.addModule("/driverlib/adc.js", {}, false);
const adc1    = adc.addInstance();
const asysctl = scripting.addModule("/driverlib/asysctl.js");

/**
 * Write custom configuration values to the imported modules.
 */
adc1.$name                   = "myADC0";
adc1.enabledSOCs             = ["ADC_SOC_NUMBER0"];
adc1.soc0Channel             = "ADC_CH_ADCIN14";
adc1.adcBase                 = "ADCB_BASE";
adc1.adcClockPrescaler       = "ADC_CLK_DIV_2_0";
adc1.soc0Trigger             = "ADC_TRIGGER_EPWM1_SOCA";
adc1.interruptPulseMode      = "ADC_PULSE_END_OF_CONV";
adc1.enabledInts             = ["ADC_INT_NUMBER1"];
adc1.soc0SampleWindow        = 70;
adc1.enableInterrupt1        = true;
adc1.registerInterrupts      = ["1"];
adc1.adcInt1.enableInterrupt = true;
adc1.adcInt1.interruptHandler = "adcB1ISR";

asysctl.enableTemperatureSensor = true;
asysctl.analogReference         = "INTERNAL";
asysctl.analogReferenceVoltage  = "1P65";
