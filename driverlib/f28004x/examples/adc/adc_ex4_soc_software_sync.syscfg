/**
 * Import the modules used in this configuration.
 */
const adc        = scripting.addModule("/driverlib/adc.js", {}, false);
const adc1       = adc.addInstance();
const adc2       = adc.addInstance();
const asysctl = scripting.addModule("/driverlib/asysctl.js");
const gpio       = scripting.addModule("/driverlib/gpio.js", {}, false);
const gpio1      = gpio.addInstance();
const inputxbar  = scripting.addModule("/driverlib/inputxbar.js", {}, false);
const inputxbar1 = inputxbar.addInstance();

/**
 * Write custom configuration values to the imported modules.
 */
adc1.$name               = "myADC0";
adc1.adcClockPrescaler   = "ADC_CLK_DIV_2_0";
adc1.interruptPulseMode  = "ADC_PULSE_END_OF_CONV";
adc1.enabledSOCs         = ["ADC_SOC_NUMBER0","ADC_SOC_NUMBER1"];
adc1.soc0Trigger         = "ADC_TRIGGER_GPIO";
adc1.soc1Trigger         = "ADC_TRIGGER_GPIO";
adc1.soc0Channel         = "ADC_CH_ADCIN2";
adc1.soc1Channel         = "ADC_CH_ADCIN3";
adc1.soc0SampleWindow    = 8;
adc1.soc1SampleWindow    = 8;
adc1.enabledInts         = ["ADC_INT_NUMBER1"];
adc1.enableInterrupt1    = true;
adc1.interrupt1SOCSource = "ADC_SOC_NUMBER1";

adc2.$name              = "myADC1";
adc2.adcBase            = "ADCC_BASE";
adc2.adcClockPrescaler  = "ADC_CLK_DIV_2_0";
adc2.interruptPulseMode = "ADC_PULSE_END_OF_CONV";
adc2.enabledSOCs        = ["ADC_SOC_NUMBER0","ADC_SOC_NUMBER1"];
adc2.soc0Channel        = "ADC_CH_ADCIN2";
adc2.soc0Trigger        = "ADC_TRIGGER_GPIO";
adc2.soc1Channel        = "ADC_CH_ADCIN3";
adc2.soc1Trigger        = "ADC_TRIGGER_GPIO";
adc2.soc0SampleWindow   = 8;
adc2.soc1SampleWindow   = 8;

asysctl.analogReference         = "INTERNAL";
asysctl.analogReferenceVoltage  = "1P65";

gpio1.$name             = "myGPIO0";
gpio1.direction         = "GPIO_DIR_MODE_OUT";
gpio1.writeInitialValue = true;
gpio1.gpioPin.$assign   = "GPIO0";

inputxbar1.$name          = "myINPUTXBAR0";
inputxbar1.inputsUsed     = ["inputxbar5Gpio"];
inputxbar1.inputxbar5Gpio = "GPIO0";
