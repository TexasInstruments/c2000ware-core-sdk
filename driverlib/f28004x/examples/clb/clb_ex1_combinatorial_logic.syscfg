/**
 * Import the modules used in this configuration.
 */
const clb   = scripting.addModule("/driverlib/clb.js", {}, false);
const clb1  = clb.addInstance();
const epwm  = scripting.addModule("/driverlib/epwm.js", {}, false);
const epwm1 = epwm.addInstance();
const epwm2 = epwm.addInstance();
const TILE  = scripting.addModule("/utilities/clb_tool/clb_syscfg/source/TILE");
const TILE1 = TILE.addInstance();

/**
 * Write custom configuration values to the imported modules.
 */
clb1.$name               = "myTILE1";
clb1.enableCLB           = true;
clb1.globalConfigCLB_IN0 = "CLB_GLOBAL_IN_MUX_EPWM1_CTRDIR";
clb1.globalConfigCLB_IN1 = "CLB_GLOBAL_IN_MUX_EPWM1_CTRDIR";
clb1.inputTypeCLB_IN4    = "GLOBAL";
clb1.globalConfigCLB_IN4 = "CLB_GLOBAL_IN_MUX_EPWM1_CTRDIR";
clb1.inputTypeCLB_IN5    = "GLOBAL";
clb1.globalConfigCLB_IN5 = "CLB_GLOBAL_IN_MUX_EPWM1_CTRDIR";
clb1.inputTypeCLB_IN6    = "GLOBAL";
clb1.globalConfigCLB_IN6 = "CLB_GLOBAL_IN_MUX_EPWM1_CTRDIR";
clb1.inputTypeCLB_IN7    = "GLOBAL";
clb1.globalConfigCLB_IN7 = "CLB_GLOBAL_IN_MUX_EPWM1_CTRDIR";
clb1.inputsUsed          = ["CLB_IN0","CLB_IN1","CLB_IN2","CLB_IN3"];
clb1.inputTypeCLB_IN3    = "GLOBAL";
clb1.inputTypeCLB_IN2    = "GLOBAL";
clb1.synchronizeCLB_IN2  = true;
clb1.synchronizeCLB_IN3  = true;
clb1.globalConfigCLB_IN3 = "CLB_GLOBAL_IN_MUX_EPWM1B";

epwm1.$name                  = "myEPWM1";
epwm1.epwm.$assign           = "EPWM1";
epwm1.epwm.epwm_aPin.$assign = "GPIO0";
epwm1.epwm.epwm_bPin.$assign = "GPIO1";

epwm2.useInterfacePins       = ["EPWM#_A","EPWM#_B"];
epwm2.$name                  = "myEPWM2";
epwm2.epwm.$assign           = "EPWM2";
epwm2.epwm.epwm_aPin.$assign = "GPIO2";
epwm2.epwm.epwm_bPin.$assign = "GPIO3";

epwm1.epwmTimebase_period                                      = 2000;
epwm1.epwmTimebase_syncOutPulseMode                            = "EPWM_SYNC_OUT_PULSE_ON_COUNTER_ZERO";
epwm1.epwmCounterCompare_cmpA                                  = 1333;
epwm1.epwmCounterCompare_cmpB                                  = 667;
epwm1.epwmActionQualifier_EPWM_AQ_OUTPUT_A_ON_TIMEBASE_ZERO    = "EPWM_AQ_OUTPUT_HIGH";
epwm1.epwmActionQualifier_EPWM_AQ_OUTPUT_A_ON_TIMEBASE_UP_CMPA = "EPWM_AQ_OUTPUT_LOW";
epwm1.epwmActionQualifier_EPWM_AQ_OUTPUT_B_ON_TIMEBASE_UP_CMPB = "EPWM_AQ_OUTPUT_TOGGLE";
epwm1.epwmTimebase_hsClockDiv                                  = "EPWM_HSCLOCK_DIVIDER_1";
epwm1.epwmTimebase_counterMode                                 = "EPWM_COUNTER_MODE_UP";
epwm1.epwmEventTrigger_enableInterrupt                         = true;
epwm1.epwmEventTrigger_interruptEventCount                     = "3";
epwm1.epwmEventTrigger_interruptSource                         = "EPWM_INT_TBCTR_ZERO";
epwm1.epwmEventTrigger_registerInterrupts                      = true;

epwm2.copyFrom                                                 = "myEPWM1";
epwm2.epwmTimebase_period                                      = 2000;
epwm2.epwmTimebase_phaseEnable                                 = true;
epwm2.epwmCounterCompare_cmpA                                  = 1333;
epwm2.epwmCounterCompare_cmpB                                  = 667;
epwm2.epwmTimebase_hsClockDiv                                  = "EPWM_HSCLOCK_DIVIDER_1";
epwm2.epwmActionQualifier_EPWM_AQ_OUTPUT_A_ON_TIMEBASE_ZERO    = "EPWM_AQ_OUTPUT_HIGH";
epwm2.epwmActionQualifier_EPWM_AQ_OUTPUT_A_ON_TIMEBASE_UP_CMPA = "EPWM_AQ_OUTPUT_LOW";
epwm2.epwmActionQualifier_EPWM_AQ_OUTPUT_B_ON_TIMEBASE_UP_CMPB = "EPWM_AQ_OUTPUT_TOGGLE";
epwm2.epwmTimebase_counterMode                                 = "EPWM_COUNTER_MODE_UP";

TILE1.$name                  = "TILE1";
TILE1.BOUNDARY.$name             = "BOUNDARY0";
TILE1.BOUNDARY.boundaryInput0    = "squareWave";
TILE1.BOUNDARY.in_period0        = 1000;
TILE1.BOUNDARY.in_duty0          = 500;
TILE1.BOUNDARY.boundaryInput1    = "squareWave";
TILE1.BOUNDARY.in_initial_value1 = 1;
TILE1.BOUNDARY.in_delay1         = 250;
TILE1.BOUNDARY.in_period1        = 1000;
TILE1.BOUNDARY.in_duty1          = 500;
TILE1.BOUNDARY.in_period2        = 2000;
TILE1.BOUNDARY.boundaryInput2    = "squareWave";
TILE1.BOUNDARY.in_initial_value2 = 1;
TILE1.BOUNDARY.in_duty2          = 1333;
TILE1.BOUNDARY.boundaryInput3    = "squareWave";
TILE1.BOUNDARY.in_delay3         = 667;
TILE1.BOUNDARY.in_period3        = 4000;
TILE1.BOUNDARY.in_duty3          = 2000;
TILE1.LUT_0.$name            = "LUT_0";
TILE1.LUT_0.i1               = "BOUNDARY.in1";
TILE1.LUT_0.i2               = "BOUNDARY.in2";
TILE1.LUT_0.i3               = "BOUNDARY.in3";
TILE1.LUT_0.i0               = "BOUNDARY.in0";
TILE1.LUT_0.eqn              = "(!i0 & !i1 & i2) | (i0 & !i1 & !(i3 & !(i2 & i3))) | (!i0 & i1 & i2 & !(i2 & i3))";
TILE1.LUT_1.$name            = "LUT_1";
TILE1.LUT_1.i0               = "BOUNDARY.in0";
TILE1.LUT_1.i1               = "BOUNDARY.in1";
TILE1.LUT_1.i2               = "BOUNDARY.in2";
TILE1.LUT_1.i3               = "BOUNDARY.in3";
TILE1.LUT_1.eqn              = "(!i0 & !i1 & i3) | (i0 & !i1 & !(i2 & !(i2 & i3))) | (!i0 & i1 & i3 & !(i2 & i3))";
TILE1.LUT_2.$name            = "LUT_2";
TILE1.FSM_0.$name            = "FSM_0";
TILE1.FSM_1.$name            = "FSM_1";
TILE1.FSM_2.$name            = "FSM_2";
TILE1.COUNTER_0.$name        = "COUNTER_0";
TILE1.COUNTER_1.$name        = "COUNTER_1";
TILE1.COUNTER_2.$name        = "COUNTER_2";
TILE1.OUTLUT_0.$name         = "OUTLUT_0";
TILE1.OUTLUT_0.eqn           = "i0";
TILE1.OUTLUT_0.i0            = "LUT_0.OUT";
TILE1.OUTLUT_1.$name         = "OUTLUT_1";
TILE1.OUTLUT_1.eqn           = "0";
TILE1.OUTLUT_2.$name         = "OUTLUT_2";
TILE1.OUTLUT_2.eqn           = "i0";
TILE1.OUTLUT_2.i0            = "LUT_1.OUT";
TILE1.OUTLUT_3.$name         = "OUTLUT_3";
TILE1.OUTLUT_3.eqn           = "0";
TILE1.OUTLUT_4.$name         = "OUTLUT_4";
TILE1.OUTLUT_5.$name         = "OUTLUT_5";
TILE1.OUTLUT_6.$name         = "OUTLUT_6";
TILE1.OUTLUT_7.$name         = "OUTLUT_7";
TILE1.HLC.$name              = "HLC_0";
TILE1.HLC.program0.$name     = "HLCP_0";
TILE1.HLC.program1.$name     = "HLCP_1";
TILE1.HLC.program2.$name     = "HLCP_2";
TILE1.HLC.program2.instruct0 = "mov r0,c0";
TILE1.HLC.program3.$name     = "HLCP_3";
TILE1.AOC_0.$name            = "AOC_0";
TILE1.AOC_1.$name            = "AOC_1";
TILE1.AOC_2.$name            = "AOC_2";
TILE1.AOC_3.$name            = "AOC_3";
TILE1.AOC_4.$name            = "AOC_4";
TILE1.AOC_5.$name            = "AOC_5";
TILE1.AOC_6.$name            = "AOC_6";
TILE1.AOC_7.$name            = "AOC_7";

scripting.suppress("Clearing the phase shift value will cause the EPWM module to ignore the synchronization input pulse, if any.", epwm2, "epwmTimebase_phaseShift");
