/**
 * Import the modules used in this configuration.
 */
const clb                              = scripting.addModule("/driverlib/clb.js", {}, false);
const clb1                             = clb.addInstance();
const clb2                             = clb.addInstance();
const clb3                             = clb.addInstance();
const clb4                             = clb.addInstance();
const epwm                             = scripting.addModule("/driverlib/epwm.js", {}, false);
const epwm1                            = epwm.addInstance();
const epwm2                            = epwm.addInstance();
const epwm3                            = epwm.addInstance();
const epwm4                            = epwm.addInstance();
const TILE                             = scripting.addModule("/utilities/clb_tool/clb_syscfg/source/TILE");
const TILE1                            = TILE.addInstance();
const TILE2                            = TILE.addInstance();
const TILE3                            = TILE.addInstance();
const TILE4                            = TILE.addInstance();
const clb_run_dynamic_template_clb_c   = scripting.addModule("/utilities/clb_tool/clb_syscfg/source/clb_run_dynamic_template_clb_c.js");
const clb_run_dynamic_template_clb_dot = scripting.addModule("/utilities/clb_tool/clb_syscfg/source/clb_run_dynamic_template_clb_dot.js");
const clb_run_dynamic_template_clb_h   = scripting.addModule("/utilities/clb_tool/clb_syscfg/source/clb_run_dynamic_template_clb_h.js");
const clb_run_dynamic_template_clb_sim = scripting.addModule("/utilities/clb_tool/clb_syscfg/source/clb_run_dynamic_template_clb_sim.js");

/**
 * Write custom configuration values to the imported modules.
 */
clb1.$name               = "myTILE1";
clb1.enableCLB           = true;
clb1.inputsUsed          = ["CLB_IN0","CLB_IN1","CLB_IN2"];
clb1.filterConfigCLB_IN0 = "CLB_FILTER_RISING_EDGE";
clb1.inputTypeCLB_IN0    = "GLOBAL";
clb1.synchronizeCLB_IN0  = true;
clb1.globalConfigCLB_IN2 = "CLB_GLOBAL_IN_MUX_EPWM1B";

clb2.$name               = "myTILE2";
clb2.clbBase             = "CLB2_BASE";
clb2.enableCLB           = true;
clb2.inputsUsed          = ["CLB_IN0","CLB_IN1","CLB_IN2"];
clb2.filterConfigCLB_IN0 = "CLB_FILTER_RISING_EDGE";
clb2.inputTypeCLB_IN0    = "GLOBAL";
clb2.synchronizeCLB_IN0  = true;
clb2.globalConfigCLB_IN0 = "CLB_GLOBAL_IN_MUX_EPWM2A";
clb2.globalConfigCLB_IN1 = "CLB_GLOBAL_IN_MUX_EPWM2A";
clb2.globalConfigCLB_IN2 = "CLB_GLOBAL_IN_MUX_EPWM2B";

clb3.$name               = "myTILE3";
clb3.clbBase             = "CLB3_BASE";
clb3.enableCLB           = true;
clb3.inputsUsed          = ["CLB_IN0","CLB_IN1","CLB_IN2"];
clb3.filterConfigCLB_IN0 = "CLB_FILTER_RISING_EDGE";
clb3.inputTypeCLB_IN0    = "GLOBAL";
clb3.synchronizeCLB_IN0  = true;
clb3.globalConfigCLB_IN0 = "CLB_GLOBAL_IN_MUX_EPWM3A";
clb3.globalConfigCLB_IN1 = "CLB_GLOBAL_IN_MUX_EPWM3A";
clb3.globalConfigCLB_IN2 = "CLB_GLOBAL_IN_MUX_EPWM3B";

clb4.$name               = "myTILE4";
clb4.clbBase             = "CLB4_BASE";
clb4.enableCLB           = true;
clb4.inputsUsed          = ["CLB_IN0","CLB_IN1","CLB_IN2"];
clb4.filterConfigCLB_IN0 = "CLB_FILTER_RISING_EDGE";
clb4.inputTypeCLB_IN0    = "GLOBAL";
clb4.synchronizeCLB_IN0  = true;
clb4.globalConfigCLB_IN0 = "CLB_GLOBAL_IN_MUX_EPWM4A";
clb4.globalConfigCLB_IN1 = "CLB_GLOBAL_IN_MUX_EPWM4A";
clb4.globalConfigCLB_IN2 = "CLB_GLOBAL_IN_MUX_EPWM4B"; 

epwm1.$name                  = "myEPWM1";
epwm1.epwm.$assign           = "EPWM1";
epwm1.epwm.epwm_aPin.$assign = "GPIO0";
epwm1.epwm.epwm_bPin.$assign = "GPIO1";

epwm2.$name                  = "myEPWM2";
epwm2.epwm.$assign           = "EPWM2";
epwm2.epwm.epwm_aPin.$assign = "GPIO2";
epwm2.epwm.epwm_bPin.$assign = "GPIO3";

epwm3.$name                  = "myEPWM3";
epwm3.epwm.$assign           = "EPWM3";
epwm3.epwm.epwm_aPin.$assign = "GPIO4";
epwm3.epwm.epwm_bPin.$assign = "GPIO5";

epwm4.$name                  = "myEPWM4";
epwm4.epwm.$assign           = "EPWM4";
epwm4.epwm.epwm_aPin.$assign = "GPIO6";
epwm4.epwm.epwm_bPin.$assign = "GPIO7";

TILE.sim_duration = 500000000;

TILE1.$name                     = "TILE1";
TILE1.BOUNDARY.$name            = "BOUNDARY0";
TILE1.BOUNDARY.boundaryInput0              = "squareWave";
TILE1.BOUNDARY.in_edge0         = "rising edge";
TILE1.BOUNDARY.in_period0       = 1000;
TILE1.BOUNDARY.in_duty0         = 4;
TILE1.BOUNDARY.in_repeat_count0 = 1000;
TILE1.BOUNDARY.boundaryInput1              = "squareWave";
TILE1.BOUNDARY.in_repeat_count1 = 1000;
TILE1.BOUNDARY.in_edge1         = "rising edge";
TILE1.BOUNDARY.boundaryInput2              = "1";
TILE1.BOUNDARY.in_period1       = 1800;
TILE1.LUT_0.$name               = "LUT_0";
TILE1.LUT_1.$name               = "LUT_1";
TILE1.LUT_2.$name               = "LUT_2";
TILE1.LUT_2.i0                  = "FSM_0.S0";
TILE1.LUT_2.i1                  = "COUNTER_0.count_match1";
TILE1.LUT_2.i2                  = "COUNTER_0.count_match2";
TILE1.LUT_2.eqn                 = "(~i0 & i1) | (i0 & i2)";
TILE1.FSM_0.$name               = "FSM_0";
TILE1.FSM_0.e0                  = "BOUNDARY.in0";
TILE1.FSM_0.e1                  = "BOUNDARY.in1";
TILE1.FSM_0.eqn_s0              = "(~s0 & e0) | (s0 & (~e1))";
TILE1.FSM_0.eqn_out             = "~s0";
TILE1.FSM_1.$name               = "FSM_1";
TILE1.FSM_2.$name               = "FSM_2";
TILE1.COUNTER_0.$name           = "COUNTER_0";
TILE1.COUNTER_0.mode1           = "1";
TILE1.COUNTER_0.mode0           = "BOUNDARY.in2";
TILE1.COUNTER_0.reset           = "FSM_0.OUT";
TILE1.COUNTER_0.match1_val      = "50";
TILE1.COUNTER_0.match2_val      = "3200";
TILE1.COUNTER_1.$name           = "COUNTER_1";
TILE1.COUNTER_2.$name           = "COUNTER_2";
TILE1.OUTLUT_0.$name            = "OUTLUT_0";
TILE1.OUTLUT_1.$name            = "OUTLUT_1";
TILE1.OUTLUT_2.$name            = "OUTLUT_2";
TILE1.OUTLUT_3.$name            = "OUTLUT_3";
TILE1.OUTLUT_4.$name            = "OUTLUT_4";
TILE1.OUTLUT_5.$name            = "OUTLUT_5";
TILE1.OUTLUT_6.$name            = "OUTLUT_6";
TILE1.OUTLUT_7.$name            = "OUTLUT_7";
TILE1.HLC.$name                 = "HLC_0";
TILE1.HLC.e0                    = "LUT_2.OUT";
TILE1.HLC.program0.$name        = "HLCP_0";
TILE1.HLC.program0.instruct0    = "INTR 1";
TILE1.HLC.program1.$name        = "HLCP_1";
TILE1.HLC.program2.$name        = "HLCP_2";
TILE1.HLC.program3.$name        = "HLCP_3";
TILE1.AOC_0.$name               = "AOC_0";
TILE1.AOC_1.$name               = "AOC_1";
TILE1.AOC_2.$name               = "AOC_2";
TILE1.AOC_3.$name               = "AOC_3";
TILE1.AOC_4.$name               = "AOC_4";
TILE1.AOC_5.$name               = "AOC_5";
TILE1.AOC_6.$name               = "AOC_6";
TILE1.AOC_7.$name               = "AOC_7";

TILE2.$name                  = "TILE2";
TILE2.BOUNDARY.$name         = "BOUNDARY1";
TILE2.LUT_0.$name            = "LUT_3";
TILE2.LUT_1.$name            = "LUT_4";
TILE2.LUT_2.$name            = "LUT_5";
TILE2.LUT_2.eqn              = "(~i0 & i1) | (i0 & i2)";
TILE2.LUT_2.i0               = "FSM_0.S0";
TILE2.LUT_2.i1               = "COUNTER_0.count_match1";
TILE2.LUT_2.i2               = "COUNTER_0.count_match2";
TILE2.FSM_0.$name            = "FSM_3";
TILE2.FSM_0.eqn_s0           = "(~s0 & e0) | (s0 & (~e1))";
TILE2.FSM_0.e0               = "BOUNDARY.in0";
TILE2.FSM_0.e1               = "BOUNDARY.in1";
TILE2.FSM_0.eqn_out          = "~s0";
TILE2.FSM_1.$name            = "FSM_4";
TILE2.FSM_2.$name            = "FSM_5";
TILE2.COUNTER_0.$name        = "COUNTER_3";
TILE2.COUNTER_0.mode1        = "1";
TILE2.COUNTER_0.mode0        = "BOUNDARY.in2";
TILE2.COUNTER_0.reset        = "FSM_0.OUT";
TILE2.COUNTER_0.match1_val   = "50";
TILE2.COUNTER_0.match2_val   = "3200";
TILE2.COUNTER_1.$name        = "COUNTER_4";
TILE2.COUNTER_2.$name        = "COUNTER_5";
TILE2.OUTLUT_0.$name         = "OUTLUT_8";
TILE2.OUTLUT_1.$name         = "OUTLUT_9";
TILE2.OUTLUT_2.$name         = "OUTLUT_10";
TILE2.OUTLUT_3.$name         = "OUTLUT_11";
TILE2.OUTLUT_4.$name         = "OUTLUT_12";
TILE2.OUTLUT_5.$name         = "OUTLUT_13";
TILE2.OUTLUT_6.$name         = "OUTLUT_14";
TILE2.OUTLUT_7.$name         = "OUTLUT_15";
TILE2.HLC.$name              = "HLC_1";
TILE2.HLC.e0                 = "LUT_2.OUT";
TILE2.HLC.program0.$name     = "HLCP_4";
TILE2.HLC.program0.instruct0 = "INTR 2";
TILE2.HLC.program1.$name     = "HLCP_5";
TILE2.HLC.program2.$name     = "HLCP_6";
TILE2.HLC.program3.$name     = "HLCP_7";
TILE2.AOC_0.$name            = "AOC_8";
TILE2.AOC_1.$name            = "AOC_9";
TILE2.AOC_2.$name            = "AOC_10";
TILE2.AOC_3.$name            = "AOC_11";
TILE2.AOC_4.$name            = "AOC_12";
TILE2.AOC_5.$name            = "AOC_13";
TILE2.AOC_6.$name            = "AOC_14";
TILE2.AOC_7.$name            = "AOC_15";

TILE3.$name                  = "TILE3";
TILE3.BOUNDARY.$name         = "BOUNDARY2";
TILE3.LUT_0.$name            = "LUT_6";
TILE3.LUT_1.$name            = "LUT_7";
TILE3.LUT_2.$name            = "LUT_8";
TILE3.LUT_2.eqn              = "(~i0 & i1) | (i0 & i2)";
TILE3.LUT_2.i0               = "FSM_0.S0";
TILE3.LUT_2.i1               = "COUNTER_0.count_match1";
TILE3.LUT_2.i2               = "COUNTER_0.count_match2";
TILE3.FSM_0.$name            = "FSM_6";
TILE3.FSM_0.eqn_s0           = "(~s0 & e0) | (s0 & (~e1))";
TILE3.FSM_0.e0               = "BOUNDARY.in0";
TILE3.FSM_0.e1               = "BOUNDARY.in1";
TILE3.FSM_0.eqn_out          = "~s0";
TILE3.FSM_1.$name            = "FSM_7";
TILE3.FSM_2.$name            = "FSM_8";
TILE3.COUNTER_0.$name        = "COUNTER_6";
TILE3.COUNTER_0.mode0        = "BOUNDARY.in2";
TILE3.COUNTER_0.mode1        = "1";
TILE3.COUNTER_0.reset        = "FSM_0.OUT";
TILE3.COUNTER_0.match1_val   = "50";
TILE3.COUNTER_0.match2_val   = "3200";
TILE3.COUNTER_1.$name        = "COUNTER_7";
TILE3.COUNTER_2.$name        = "COUNTER_8";
TILE3.OUTLUT_0.$name         = "OUTLUT_16";
TILE3.OUTLUT_1.$name         = "OUTLUT_17";
TILE3.OUTLUT_2.$name         = "OUTLUT_18";
TILE3.OUTLUT_3.$name         = "OUTLUT_19";
TILE3.OUTLUT_4.$name         = "OUTLUT_20";
TILE3.OUTLUT_5.$name         = "OUTLUT_21";
TILE3.OUTLUT_6.$name         = "OUTLUT_22";
TILE3.OUTLUT_7.$name         = "OUTLUT_23";
TILE3.HLC.$name              = "HLC_2";
TILE3.HLC.e0                 = "LUT_2.OUT";
TILE3.HLC.program0.$name     = "HLCP_8";
TILE3.HLC.program0.instruct0 = "INTR 3";
TILE3.HLC.program1.$name     = "HLCP_9";
TILE3.HLC.program2.$name     = "HLCP_10";
TILE3.HLC.program3.$name     = "HLCP_11";
TILE3.AOC_0.$name            = "AOC_16";
TILE3.AOC_1.$name            = "AOC_17";
TILE3.AOC_2.$name            = "AOC_18";
TILE3.AOC_3.$name            = "AOC_19";
TILE3.AOC_4.$name            = "AOC_20";
TILE3.AOC_5.$name            = "AOC_21";
TILE3.AOC_6.$name            = "AOC_22";
TILE3.AOC_7.$name            = "AOC_23";

TILE4.$name                  = "TILE4";
TILE4.BOUNDARY.$name         = "BOUNDARY3";
TILE4.LUT_0.$name            = "LUT_9";
TILE4.LUT_1.$name            = "LUT_10";
TILE4.LUT_2.$name            = "LUT_11";
TILE4.LUT_2.eqn              = "(~i0 & i1) | (i0 & i2)";
TILE4.LUT_2.i0               = "FSM_0.S0";
TILE4.LUT_2.i1               = "COUNTER_0.count_match1";
TILE4.LUT_2.i2               = "COUNTER_0.count_match2";
TILE4.FSM_0.$name            = "FSM_9";
TILE4.FSM_0.eqn_s0           = "(~s0 & e0) | (s0 & (~e1))";
TILE4.FSM_0.e0               = "BOUNDARY.in0";
TILE4.FSM_0.e1               = "BOUNDARY.in1";
TILE4.FSM_0.eqn_out          = "~s0";
TILE4.FSM_1.$name            = "FSM_10";
TILE4.FSM_2.$name            = "FSM_11";
TILE4.COUNTER_0.$name        = "COUNTER_9";
TILE4.COUNTER_0.mode0        = "BOUNDARY.in2";
TILE4.COUNTER_0.mode1        = "1";
TILE4.COUNTER_0.reset        = "FSM_0.OUT";
TILE4.COUNTER_0.match1_val   = "50";
TILE4.COUNTER_0.match2_val   = "3200";
TILE4.COUNTER_1.$name        = "COUNTER_10";
TILE4.COUNTER_2.$name        = "COUNTER_11";
TILE4.OUTLUT_0.$name         = "OUTLUT_24";
TILE4.OUTLUT_1.$name         = "OUTLUT_25";
TILE4.OUTLUT_2.$name         = "OUTLUT_26";
TILE4.OUTLUT_3.$name         = "OUTLUT_27";
TILE4.OUTLUT_4.$name         = "OUTLUT_28";
TILE4.OUTLUT_5.$name         = "OUTLUT_29";
TILE4.OUTLUT_6.$name         = "OUTLUT_30";
TILE4.OUTLUT_7.$name         = "OUTLUT_31";
TILE4.HLC.$name              = "HLC_3";
TILE4.HLC.e0                 = "LUT_2.OUT";
TILE4.HLC.program0.$name     = "HLCP_12";
TILE4.HLC.program0.instruct0 = "INTR 4";
TILE4.HLC.program1.$name     = "HLCP_13";
TILE4.HLC.program2.$name     = "HLCP_14";
TILE4.HLC.program3.$name     = "HLCP_15";
TILE4.AOC_0.$name            = "AOC_24";
TILE4.AOC_1.$name            = "AOC_25";
TILE4.AOC_2.$name            = "AOC_26";
TILE4.AOC_3.$name            = "AOC_27";
TILE4.AOC_4.$name            = "AOC_28";
TILE4.AOC_5.$name            = "AOC_29";
TILE4.AOC_6.$name            = "AOC_30";
TILE4.AOC_7.$name            = "AOC_31";
