
var DCSM = scripting.addModule("/utilities/dcsm_tool/dcsm_syscfg/source/DCSM", {}, false);
var DCSM1 = DCSM.addInstance();
// Name
DCSM1.$name = "DCSM0";
// Name
DCSM1.ZONE1_OTP.$name = "ZONE_OTP0";
// Name
DCSM1.ZONE1.$name = "ZONE0";
// Name
DCSM1.ZONE2_OTP.$name = "ZONE_OTP1";
// Name
DCSM1.ZONE2.$name = "ZONE1";
