/**
 * @cliArgs --device "F28004x" --package "F28004x_100PZ" --part "F28004x_100PZ" --context "system" --product "C2000WARE@5.02.00.00"
 * @versions {"tool":"1.0.0+dev"}
 */
/**
 * Import the modules used in this configuration.
 */
const device_support = scripting.addModule("/driverlib/device_support.js");
const sysctl         = scripting.addModule("/driverlib/sysctl.js");
const CMD            = scripting.addModule("/utilities/cmd_tool/cmd_syscfg/source/CMD");
const CMD1           = CMD.addInstance();
const CMD2           = CMD.addInstance();
const gui            = scripting.addModule("/utilities/transfer/gui.js");
const transferbridge  = scripting.addModule("/utilities/transfer/transferbridge.js", {}, false);
const transferbridge1 = transferbridge.addInstance();

/**
 * Write custom configuration values to the imported modules.
 */

transferbridge1.$name                                 = "myBridge0";
transferbridge1.comsLinkA                             = "sci";
transferbridge1.comsLinkBBuffer                       = true;
transferbridge1.comsLinkBErrorHandler                 = true;
transferbridge1.comsLinkBModule.enableLoopback        = scripting.forceWrite(false);
transferbridge1.comsLinkBModule.pingTimeout           = scripting.forceWrite(false);
transferbridge1.comsLinkBModule.useCase               = "FSI RX Single Dataline";
transferbridge1.comsLinkAModule.wordLenght            = scripting.forceWrite("8");
transferbridge1.comsLinkAModule.stop                  = scripting.forceWrite("ONE");
transferbridge1.comsLinkAModule.parity                = scripting.forceWrite("SCI_CONFIG_PAR_NONE");
transferbridge1.comsLinkAModule.registerInterrupts    = scripting.forceWrite(false);
transferbridge1.comsLinkAModule.useFifo               = scripting.forceWrite(true);
transferbridge1.comsLinkAModule.loopback              = scripting.forceWrite(false);
transferbridge1.comsLinkAModule.useCase               = scripting.forceWrite("ALL");
transferbridge1.comsLinkAModule.rxFifo                = "SCI_FIFO_RX16";
transferbridge1.comsLinkAModule.enabledFIFOInterrupts = ["SCI_INT_RXFF"];


/**
 * Write custom configuration values to the imported modules.
 */
CMD1.$name                    = "generic_ram_lnk";
CMD2.$name                    = "generic_flash_lnk";

CMD1.sectionMemory_text       = ["RAMGS0","RAMLS4","RAMLS5","RAMLS6","RAMLS7"];
CMD1.sectionMemory_ramfunc    = ["RAMM0"];
CMD1.sectionMemory_cinit      = ["RAMM0"];
CMD1.sectionMemory_stack      = ["RAMM1"];
CMD1.sectionMemory_init_array = ["RAMM0"];
CMD1.sectionMemory_bss        = ["RAMLS4"];
CMD1.sectionMemory_const      = ["RAMLS4"];
CMD1.sectionMemory_data       = ["RAMLS4"];
CMD1.sectionMemory_switch     = ["RAMM0"];
CMD1.sectionMemory_sysmem     = ["RAMLS4"];

CMD2.sectionAlignEnable_ramfunc    = true;
CMD2.sectionAlignEnable_text       = true;
CMD2.sectionAlignEnable_binit      = true;
CMD2.sectionAlignEnable_cinit      = true;
CMD2.sectionAlignEnable_switch     = true;
CMD2.sectionAlignEnable_init_array = true;
CMD2.sectionAlignEnable_const      = true;
CMD2.sectionAlignEnable_ovly       = true;
CMD2.sectionMemory_codestart       = "0x080000";
CMD2.sectionMemory_stack           = ["RAMM1"];
CMD2.sectionMemory_ramfunc         = ["FLASH_BANK0_SEC1"];
CMD2.sectionMemory_text            = ["FLASH_BANK0_SEC2","FLASH_BANK0_SEC3","FLASH_BANK0_SEC4"];
CMD2.sectionMemory_binit           = ["FLASH_BANK0_SEC1"];
CMD2.sectionMemory_cinit           = ["FLASH_BANK0_SEC1"];
CMD2.sectionMemory_switch          = ["FLASH_BANK0_SEC1"];
CMD2.sectionMemory_bss             = ["RAMLS5"];
CMD2.sectionMemory_data            = ["RAMLS5"];
CMD2.sectionMemory_sysmem          = ["RAMLS5"];
CMD2.sectionRunFromDifferentAddr_ramfunc = true;
CMD1.sectionRun_ramfunc                  = ["RAMLS4"];
CMD2.sectionBinit_ramfunc                = false;
CMD2.sectionMemory_init_array      = ["FLASH_BANK0_SEC1"];
CMD2.sectionMemory_const           = ["FLASH_BANK0_SEC4"];
CMD2.sectionMemory_ovly            = ["FLASH_BANK0_SEC1"];
