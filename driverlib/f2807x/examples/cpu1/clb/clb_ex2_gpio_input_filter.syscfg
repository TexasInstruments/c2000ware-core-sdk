var TILE = scripting.addModule("/utilities/clb_tool/clb_syscfg/source/TILE");
var TILE1 = TILE.addInstance();
// clock_period - Period of the clock (in Nano Seconds) used for simulation in System C
TILE.clock_period = 10;
// sim_duration - Duration of the simulation (in Nano Seconds)
TILE.sim_duration = 100000;
// Name
TILE1.$name = "TILE1";
// in1
TILE1.BOUNDARY.in1 = "squareWave";
// in0
TILE1.BOUNDARY.in0 = "squareWave";
// in4
TILE1.BOUNDARY.in4 = "1";
// in5
TILE1.BOUNDARY.in5 = "0";
// in_duty1 - Duty or ON time of the square wave
TILE1.BOUNDARY.in_duty1 = 50;
// in_period1 - Period of the square wave
TILE1.BOUNDARY.in_period1 = 100;
// in2
TILE1.BOUNDARY.in2 = "1";
// in6
TILE1.BOUNDARY.in6 = "1";
// in_repeat_count0 - Number of periods the waveform is repeated
TILE1.BOUNDARY.in_repeat_count0 = 50;
// in3
TILE1.BOUNDARY.in3 = "squareWave";
// in_repeat_count3 - Number of periods the waveform is repeated
TILE1.BOUNDARY.in_repeat_count3 = 1;
// in_repeat_count1 - Number of periods the waveform is repeated
TILE1.BOUNDARY.in_repeat_count1 = 1000;
// in_duty0 - Duty or ON time of the square wave
TILE1.BOUNDARY.in_duty0 = 20;
// in_period0 - Period of the square wave
TILE1.BOUNDARY.in_period0 = 40;
// eqn - Boolean equation on the variables i3,i2,i1,i0 for the LUT output.
TILE1.LUT_0.eqn = "~i0";
// i0 - Input 0.
TILE1.LUT_0.i0 = "BOUNDARY.in0";
// e0 - External Input 0.
TILE1.FSM_0.e0 = "COUNTER_0.count_match1";
// e1 - External Input 1.
TILE1.FSM_0.e1 = "COUNTER_1.count_match1";
// eqn_s0 - Boolean equation on the variables e1,e0,s1,s0 for the S0 output.
TILE1.FSM_0.eqn_s0 = "(~s0 & e1) | (s0 & (~e0))";
// match1_val - Sets the value of the Match reference 1 register.
TILE1.COUNTER_0.match1_val = "8";
// mode1 - Controls counting direction. High enables count up. Low enables count down.
TILE1.COUNTER_0.mode1 = "1";
// mode0 - Enables Counting when high
TILE1.COUNTER_0.mode0 = "LUT_0.OUT";
// reset - Reset the counter to 0 on next clock cycle (triggers low to high)
TILE1.COUNTER_0.reset = "BOUNDARY.in0";
// match1_val - Sets the value of the Match reference 1 register.
TILE1.COUNTER_1.match1_val = "8";
// mode1 - Controls counting direction. High enables count up. Low enables count down.
TILE1.COUNTER_1.mode1 = "1";
// mode0 - Enables Counting when high
TILE1.COUNTER_1.mode0 = "BOUNDARY.in0";
// reset - Reset the counter to 0 on next clock cycle (triggers low to high)
TILE1.COUNTER_1.reset = "LUT_0.OUT";
// mode1 - Controls counting direction. High enables count up. Low enables count down.
TILE1.COUNTER_2.mode1 = "1";
// mode0 - Enables Counting when high
TILE1.COUNTER_2.mode0 = "1";
// reset - Reset the counter to 0 on next clock cycle (triggers low to high)
TILE1.COUNTER_2.reset = "COUNTER_2.count_match1";
// eqn - Boolean equation on the variables i2,i1,i0 for the OUTLUT output.
TILE1.OUTLUT_0.eqn = "i0";
// i0 - Input 0.
TILE1.OUTLUT_0.i0 = "FSM_0.S0";
