/**
 * These arguments were used when this file was generated. They will be automatically applied on subsequent loads
 * via the GUI or CLI. Run CLI with '--help' for additional information on how to override these arguments.
 * @cliArgs --device "F2807x" --part "F2807x_176PTP" --package "F2807x_176PTP" --context "system"
 * @v2CliArgs --device "TMS320F2807x" --package "176PTP" --context "system"
 */
