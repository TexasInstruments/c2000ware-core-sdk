var TILE = scripting.addModule("/utilities/clb_tool/clb_syscfg/source/TILE");
var TILE1 = TILE.addInstance();
// clock_period - Period of the clock (in Nano Seconds) used for simulation in System C
TILE.clock_period = 10;
// sim_duration - Duration of the simulation (in Nano Seconds)
TILE.sim_duration = 100000;
// Name
TILE1.$name = "TILE1";
// in_repeat_count0 - Number of periods the waveform is repeated
TILE1.BOUNDARY.in_repeat_count0 = 50;
// in0
TILE1.BOUNDARY.in0 = "squareWave";
// in_repeat_count1 - Number of periods the waveform is repeated
TILE1.BOUNDARY.in_repeat_count1 = 50;
// in_repeat_count2 - Number of periods the waveform is repeated
TILE1.BOUNDARY.in_repeat_count2 = 50;
// in_period2 - Period of the square wave
TILE1.BOUNDARY.in_period2 = 3000;
// in_duty2 - Duty or ON time of the square wave
TILE1.BOUNDARY.in_duty2 = 1500;
// in_period3 - Period of the square wave
TILE1.BOUNDARY.in_period3 = 10000;
// in_duty3 - Duty or ON time of the square wave
TILE1.BOUNDARY.in_duty3 = 5001;
// in_repeat_count3 - Number of periods the waveform is repeated
TILE1.BOUNDARY.in_repeat_count3 = 50;
// in3
TILE1.BOUNDARY.in3 = "0";
// in4
TILE1.BOUNDARY.in4 = "0";
// in5
TILE1.BOUNDARY.in5 = "0";
// in_period0 - Period of the square wave
TILE1.BOUNDARY.in_period0 = 500;
// in_duty0 - Duty or ON time of the square wave
TILE1.BOUNDARY.in_duty0 = 250;
// in1
TILE1.BOUNDARY.in1 = "squareWave";
// in_period1 - Period of the square wave
TILE1.BOUNDARY.in_period1 = 750;
// in_duty1 - Duty or ON time of the square wave
TILE1.BOUNDARY.in_duty1 = 250;
// in2
TILE1.BOUNDARY.in2 = "0";
// i0 - Input 0.
TILE1.LUT_0.i0 = "BOUNDARY.in0";
// i1 - Input 1.
TILE1.LUT_0.i1 = "BOUNDARY.in1";
// eqn - Boolean equation on the variables i3,i2,i1,i0 for the LUT output.
TILE1.LUT_0.eqn = "i0 & i1";
// eqn - Boolean equation on the variables i2,i1,i0 for the OUTLUT output.
TILE1.OUTLUT_0.eqn = "i0";
// i0 - Input 0.
TILE1.OUTLUT_0.i0 = "LUT_0.OUT";
// instruct0
TILE1.HLC.program0.instruct0 = "INTR 11";
// instruct0
TILE1.HLC.program1.instruct0 = "INTR 12";
