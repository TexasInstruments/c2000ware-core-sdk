var TILE = scripting.addModule("/utilities/clb_tool/clb_syscfg/source/TILE");
var TILE1 = TILE.addInstance();
var TILE2 = TILE.addInstance();
// sim_duration - Duration of the simulation (in Nano Seconds)
TILE.sim_duration = 500000;
// Name
TILE1.$name = "TILE1";
// Name
TILE1.BOUNDARY.$name = "BOUNDARY0";
// in0
TILE1.BOUNDARY.in0 = "squareWave";
// in_period0 - Period of the square wave
TILE1.BOUNDARY.in_period0 = 10000;
// in_duty0 - Duty or ON time of the square wave
TILE1.BOUNDARY.in_duty0 = 8000;
// in_repeat_count0 - Number of periods the waveform is repeated
TILE1.BOUNDARY.in_repeat_count0 = 10;
// Name
TILE1.LUT_0.$name = "LUT_0";
// Name
TILE1.LUT_1.$name = "LUT_1";
// Name
TILE1.LUT_2.$name = "LUT_2";
// Name
TILE1.FSM_0.$name = "FSM_0";
// e0 - External Input 0.
TILE1.FSM_0.e0 = "COUNTER_0.count_match1";
// e1 - External Input 1.
TILE1.FSM_0.e1 = "COUNTER_0.count_match2";
// eqn_s0 - Boolean equation on the variables e1,e0,s1,s0 for the S0 output.
TILE1.FSM_0.eqn_s0 = "(~s0 & e0) | (s0 & ~e1)";
// Name
TILE1.FSM_1.$name = "FSM_1";
// Name
TILE1.FSM_2.$name = "FSM_2";
// Name
TILE1.COUNTER_0.$name = "COUNTER_0";
// mode0 - Enables Counting when high
TILE1.COUNTER_0.mode0 = "BOUNDARY.in0";
// mode1 - Controls counting direction. High enables count up. Low enables count down.
TILE1.COUNTER_0.mode1 = "1";
// reset - Reset the counter to 0 on next clock cycle (triggers low to high)
TILE1.COUNTER_0.reset = "COUNTER_0.count_match2";
// match1_val - Sets the value of the Match reference 1 register.
TILE1.COUNTER_0.match1_val = "500";
// match2_val - Sets the value of the Match reference 2 register.
TILE1.COUNTER_0.match2_val = "1000";
// Name
TILE1.COUNTER_1.$name = "COUNTER_1";
// Name
TILE1.COUNTER_2.$name = "COUNTER_2";
// Name
TILE1.OUTLUT_0.$name = "OUTLUT_0";
// Name
TILE1.OUTLUT_1.$name = "OUTLUT_1";
// Name
TILE1.OUTLUT_2.$name = "OUTLUT_2";
// Name
TILE1.OUTLUT_3.$name = "OUTLUT_3";
// Name
TILE1.OUTLUT_4.$name = "OUTLUT_4";
// i0 - Input 0.
TILE1.OUTLUT_4.i0 = "FSM_0.S0";
// eqn - Boolean equation on the variables i2,i1,i0 for the OUTLUT output.
TILE1.OUTLUT_4.eqn = "i0";
// Name
TILE1.OUTLUT_5.$name = "OUTLUT_5";
// i0 - Input 0.
TILE1.OUTLUT_5.i0 = "BOUNDARY.in0";
// eqn - Boolean equation on the variables i2,i1,i0 for the OUTLUT output.
TILE1.OUTLUT_5.eqn = "i0";
// Name
TILE1.OUTLUT_6.$name = "OUTLUT_6";
// Name
TILE1.OUTLUT_7.$name = "OUTLUT_7";
// Name
TILE1.HLC.$name = "HLC_0";
// Name
TILE1.HLC.program0.$name = "HLCP_0";
// Name
TILE1.HLC.program1.$name = "HLCP_1";
// Name
TILE1.HLC.program2.$name = "HLCP_2";
// Name
TILE1.HLC.program3.$name = "HLCP_3";
var clb_run_dynamic_template_clb_h = scripting.addModule("/utilities/clb_tool/clb_syscfg/source/clb_run_dynamic_template_clb_h.js");
var clb_run_dynamic_template_clb_c = scripting.addModule("/utilities/clb_tool/clb_syscfg/source/clb_run_dynamic_template_clb_c.js");
var clb_run_dynamic_template_clb_sim = scripting.addModule("/utilities/clb_tool/clb_syscfg/source/clb_run_dynamic_template_clb_sim.js");
var clb_run_dynamic_template_clb_dot = scripting.addModule("/utilities/clb_tool/clb_syscfg/source/clb_run_dynamic_template_clb_dot.js");
// Name
TILE2.$name = "TILE2";
// Name
TILE2.BOUNDARY.$name = "BOUNDARY1";
// in0
TILE2.BOUNDARY.in0 = "TILE1_BOUNDARY.out4";
// in1
TILE2.BOUNDARY.in1 = "TILE1_BOUNDARY.out5";
// Name
TILE2.LUT_0.$name = "LUT_3";
// eqn - Boolean equation on the variables i3,i2,i1,i0 for the LUT output.
TILE2.LUT_0.eqn = "i0 & i1";
// i0 - Input 0.
TILE2.LUT_0.i0 = "BOUNDARY.in0";
// i1 - Input 1.
TILE2.LUT_0.i1 = "BOUNDARY.in1";
// Name
TILE2.LUT_1.$name = "LUT_4";
// i0 - Input 0.
TILE2.LUT_1.i0 = "BOUNDARY.in0";
// i1 - Input 1.
TILE2.LUT_1.i1 = "BOUNDARY.in1";
// eqn - Boolean equation on the variables i3,i2,i1,i0 for the LUT output.
TILE2.LUT_1.eqn = "~i0 & i1";
// Name
TILE2.LUT_2.$name = "LUT_5";
// i1 - Input 1.
TILE2.LUT_2.i1 = "COUNTER_0.count_match1";
// i2 - Input 2.
TILE2.LUT_2.i2 = "COUNTER_1.count_match1";
// i0 - Input 0.
TILE2.LUT_2.i0 = "BOUNDARY.in1";
// eqn - Boolean equation on the variables i3,i2,i1,i0 for the LUT output.
TILE2.LUT_2.eqn = "i0 & (i1 |i2)";
// Name
TILE2.FSM_0.$name = "FSM_3";
// Name
TILE2.FSM_1.$name = "FSM_4";
// e0 - External Input 0.
TILE2.FSM_1.e0 = "LUT_0.OUT";
// eqn_s0 - Boolean equation on the variables e1,e0,s1,s0 for the S0 output.
TILE2.FSM_1.eqn_s0 = "e0";
// eqn_out - Boolean equation on the variables e1,e0,s1,s0 for the LUT output.
TILE2.FSM_1.eqn_out = "e0 & ~s0";
// Name
TILE2.FSM_2.$name = "FSM_5";
// Name
TILE2.COUNTER_0.$name = "COUNTER_3";
// mode0 - Enables Counting when high
TILE2.COUNTER_0.mode0 = "LUT_0.OUT";
// mode1 - Controls counting direction. High enables count up. Low enables count down.
TILE2.COUNTER_0.mode1 = "1";
// reset - Reset the counter to 0 on next clock cycle (triggers low to high)
TILE2.COUNTER_0.reset = "LUT_1.OUT";
// match2_val - Sets the value of the Match reference 2 register.
TILE2.COUNTER_0.match2_val = "";
// match1_val - Sets the value of the Match reference 1 register.
TILE2.COUNTER_0.match1_val = "520";
// Name
TILE2.COUNTER_1.$name = "COUNTER_4";
// mode1 - Controls counting direction. High enables count up. Low enables count down.
TILE2.COUNTER_1.mode1 = "1";
// reset - Reset the counter to 0 on next clock cycle (triggers low to high)
TILE2.COUNTER_1.reset = "FSM_1.OUT";
// mode0 - Enables Counting when high
TILE2.COUNTER_1.mode0 = "BOUNDARY.in1";
// match2_val - Sets the value of the Match reference 2 register.
TILE2.COUNTER_1.match2_val = "";
// match1_val - Sets the value of the Match reference 1 register.
TILE2.COUNTER_1.match1_val = "1020";
// Name
TILE2.COUNTER_2.$name = "COUNTER_5";
// Name
TILE2.OUTLUT_0.$name = "OUTLUT_8";
// Name
TILE2.OUTLUT_1.$name = "OUTLUT_9";
// Name
TILE2.OUTLUT_2.$name = "OUTLUT_10";
// Name
TILE2.OUTLUT_3.$name = "OUTLUT_11";
// Name
TILE2.OUTLUT_4.$name = "OUTLUT_12";
// Name
TILE2.OUTLUT_5.$name = "OUTLUT_13";
// Name
TILE2.OUTLUT_6.$name = "OUTLUT_14";
// Name
TILE2.OUTLUT_7.$name = "OUTLUT_15";
// Name
TILE2.HLC.$name = "HLC_1";
// Event 0 (e0) - Event 0
TILE2.HLC.e0 = "LUT_2.OUT";
// Name
TILE2.HLC.program0.$name = "HLCP_4";
// instruct0
TILE2.HLC.program0.instruct0 = "INTR 5";
// Name
TILE2.HLC.program1.$name = "HLCP_5";
// Name
TILE2.HLC.program2.$name = "HLCP_6";
// Name
TILE2.HLC.program3.$name = "HLCP_7";
