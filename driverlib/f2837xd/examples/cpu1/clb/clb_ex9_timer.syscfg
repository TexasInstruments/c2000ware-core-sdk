/**
 * Import the modules used in this configuration.
 */
const clb         = scripting.addModule("/driverlib/clb.js", {}, false);
const clb1        = clb.addInstance();
const gpio        = scripting.addModule("/driverlib/gpio.js", {}, false);
const gpio1       = gpio.addInstance();
const outputxbar  = scripting.addModule("/driverlib/outputxbar.js", {}, false);
const outputxbar1 = outputxbar.addInstance();
const TILE        = scripting.addModule("/utilities/clb_tool/clb_syscfg/source/TILE");
const TILE1       = TILE.addInstance();

/**
 * Write custom configuration values to the imported modules.
 */
clb1.$name      = "myTILE1";
clb1.enableCLB  = true;
clb1.inputsUsed = ["CLB_IN0","CLB_IN1","CLB_IN2"];

gpio1.$name           = "myGPIO0";
gpio1.direction       = "GPIO_DIR_MODE_OUT";
gpio1.gpioPin.$assign = "GPIO0";

outputxbar1.$name                            = "myOUTPUTXBAR1";
outputxbar1.muxesUsed                        = ["XBAR_MUX01"];
outputxbar1.mux1Config                       = "XBAR_OUT_MUX01_CLB1_OUT4";
outputxbar1.outputxbar.$name                 = "MyOUTPUTXBAR1";
outputxbar1.outputxbar.$assign               = "OUTPUTXBAR1";
outputxbar1.outputxbar.outputxbarPin.$assign = "GPIO24";

TILE.clock_period = 10;
TILE.sim_duration = 100000;

TILE1.$name                     = "TILE1";
TILE1.BOUNDARY.$name            = "BOUNDARY0";
TILE1.BOUNDARY.in_repeat_count0 = 50;
TILE1.BOUNDARY.in_repeat_count3 = 1;
TILE1.BOUNDARY.in0              = "squareWave";
TILE1.BOUNDARY.in_repeat_count1 = 50;
TILE1.BOUNDARY.in_repeat_count2 = 50;
TILE1.BOUNDARY.in_period0       = 10000;
TILE1.BOUNDARY.in_duty0         = 5001;
TILE1.BOUNDARY.in_period1       = 1000;
TILE1.BOUNDARY.in_duty1         = 500;
TILE1.BOUNDARY.in_period2       = 3000;
TILE1.BOUNDARY.in_duty2         = 1500;
TILE1.BOUNDARY.in1              = "1";
TILE1.BOUNDARY.in2              = "1";
TILE1.LUT_0.$name               = "LUT_0";
TILE1.LUT_1.$name               = "LUT_1";
TILE1.LUT_2.$name               = "LUT_2";
TILE1.FSM_0.$name               = "FSM_0";
TILE1.FSM_1.$name               = "FSM_1";
TILE1.FSM_2.$name               = "FSM_2";
TILE1.COUNTER_0.$name           = "COUNTER_0";
TILE1.COUNTER_0.action          = "Load";
TILE1.COUNTER_0.reset           = "COUNTER_0.count_match1";
TILE1.COUNTER_0.event           = "BOUNDARY.in0";
TILE1.COUNTER_0.mode0           = "BOUNDARY.in1";
TILE1.COUNTER_0.mode1           = "BOUNDARY.in2";
TILE1.COUNTER_0.match1_val      = "1000";
TILE1.COUNTER_1.$name           = "COUNTER_1";
TILE1.COUNTER_2.$name           = "COUNTER_2";
TILE1.OUTLUT_0.$name            = "OUTLUT_0";
TILE1.OUTLUT_1.$name            = "OUTLUT_1";
TILE1.OUTLUT_2.$name            = "OUTLUT_2";
TILE1.OUTLUT_3.$name            = "OUTLUT_3";
TILE1.OUTLUT_4.$name            = "OUTLUT_4";
TILE1.OUTLUT_4.eqn              = "i0";
TILE1.OUTLUT_4.i0               = "COUNTER_0.count_match1";
TILE1.OUTLUT_5.$name            = "OUTLUT_5";
TILE1.OUTLUT_6.$name            = "OUTLUT_6";
TILE1.OUTLUT_7.$name            = "OUTLUT_7";
TILE1.HLC.$name                 = "HLC_0";
TILE1.HLC.e0                    = "COUNTER_0.count_match1";
TILE1.HLC.program0.$name        = "HLCP_0";
TILE1.HLC.program0.instruct0    = "INTR 0";
TILE1.HLC.program1.$name        = "HLCP_1";
TILE1.HLC.program2.$name        = "HLCP_2";
TILE1.HLC.program3.$name        = "HLCP_3";
