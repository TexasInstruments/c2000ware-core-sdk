// These arguments were used when this file was generated. They will be automatically applied on subsequent loads 
// via the GUI or CLI invocations. Run CLI with '--help' for additional information on how to override these arguments.
// @cliArgs --device "F28X7X"
// @versions {"data":"2019083011","timestamp":"2019083011","tool":"1.2.952","templates":"2019083011"}

var DCSM = scripting.addModule("/utilities/dcsm_tool/dcsm_syscfg/source/DCSM", {}, false);
var DCSM1 = DCSM.addInstance();
// Name
DCSM1.$name = "DCSM0";
// Name
DCSM1.ZONE1_OTP.$name = "ZONE_OTP0";
// Name
DCSM1.ZONE1.$name = "ZONE0";
// Name
DCSM1.ZONE2_OTP.$name = "ZONE_OTP1";
// Name
DCSM1.ZONE2.$name = "ZONE1";
