/**
 * Import the modules used in this configuration.
 */
const epwm       = scripting.addModule("/driverlib/epwm.js", {}, false);
const epwm1      = epwm.addInstance();
const epwm2      = epwm.addInstance();
const gpio       = scripting.addModule("/driverlib/gpio.js", {}, false);
const gpio1      = gpio.addInstance();
const gpio2      = gpio.addInstance();
const inputxbar  = scripting.addModule("/driverlib/inputxbar.js", {}, false);
const inputxbar1 = inputxbar.addInstance();

/**
 * Write custom configuration values to the imported modules.
 */

epwm1.useCase               = "CUSTOM";
epwm1.useInterfacePins      = ["EPWM#A"];
epwm1.$name                 = "myEPWM1";
epwm1.epwm.$assign          = "EPWM1";
epwm1.epwm.epwmaPin.$assign = "GPIO0";

epwm2.useCase               = "CUSTOM";
epwm2.useInterfacePins      = ["EPWM#A"];
epwm2.$name                 = "myEPWM2";
epwm2.epwm.$assign          = "EPWM2";
epwm2.epwm.epwmaPin.$assign = "GPIO2";

gpio1.$name           = "myGPIO12";
gpio1.qualMode        = "GPIO_QUAL_ASYNC";
gpio1.padConfig       = "PULLUP";
gpio1.gpioPin.$assign = "GPIO12";

gpio2.$name           = "myGPIO11";
gpio2.direction       = "GPIO_DIR_MODE_OUT";
gpio2.qualMode        = "GPIO_QUAL_ASYNC";
gpio2.gpioPin.$assign = "GPIO11";

inputxbar1.$name          = "myINPUTXBAR1";
inputxbar1.inputsUsed     = ["inputxbar1Gpio"];
inputxbar1.inputxbar1Gpio = "GPIO12";
