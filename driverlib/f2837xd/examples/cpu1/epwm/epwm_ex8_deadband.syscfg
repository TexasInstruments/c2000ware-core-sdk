/**
 * Import the modules used in this configuration.
 */
const epwm  = scripting.addModule("/driverlib/epwm.js", {}, false);
const epwm1 = epwm.addInstance();
const epwm2 = epwm.addInstance();
const epwm3 = epwm.addInstance();
const epwm4 = epwm.addInstance();
const epwm5 = epwm.addInstance();
const epwm6 = epwm.addInstance();

/**
 * Write custom configuration values to the imported modules.
 */

epwm1.$name                 = "myEPWM1";
epwm1.epwm.$assign          = "EPWM1";
epwm1.epwm.epwmaPin.$assign = "GPIO0";
epwm1.epwm.epwmbPin.$assign = "GPIO1";

epwm2.$name                 = "myEPWM2";
epwm2.epwm.$assign          = "EPWM2";
epwm2.epwm.epwmaPin.$assign = "GPIO2";
epwm2.epwm.epwmbPin.$assign = "GPIO3";

epwm3.$name                 = "myEPWM3";
epwm3.epwm.$assign          = "EPWM3";
epwm3.epwm.epwmaPin.$assign = "GPIO4";
epwm3.epwm.epwmbPin.$assign = "GPIO5";

epwm4.$name                 = "myEPWM4";
epwm4.epwm.$assign          = "EPWM4";
epwm4.epwm.epwmaPin.$assign = "GPIO6";
epwm4.epwm.epwmbPin.$assign = "GPIO7";

epwm5.$name                 = "myEPWM5";
epwm5.epwm.$assign          = "EPWM5";
epwm5.epwm.epwmaPin.$assign = "GPIO8";
epwm5.epwm.epwmbPin.$assign = "GPIO9";

epwm6.$name                 = "myEPWM6";
epwm6.epwm.$assign          = "EPWM6";
epwm6.epwm.epwmaPin.$assign = "GPIO10";
epwm6.epwm.epwmbPin.$assign = "GPIO11";
