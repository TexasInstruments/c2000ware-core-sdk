/**
 * These arguments were used when this file was generated. They will be automatically applied on subsequent loads
 * via the GUI or CLI. Run CLI with '--help' for additional information on how to override these arguments.
 * @cliArgs --device "F2837xD" --part "F2837xD_337ZWT" --package "F2837xD_337ZWT" --context "CPU1"
 * @v2CliArgs --device "TMS320F2837xD" --package "337ZWT" --context "CPU1"
 */

/**
 * Import the modules used in this configuration.
 */
const gpio  = scripting.addModule("/driverlib/gpio.js", {}, false);
const gpio1 = gpio.addInstance();
const gpio2 = gpio.addInstance();

/**
 * Write custom configuration values to the imported modules.
 */
gpio1.$name     = "myGPIOInputInterrupt0";
gpio1.padConfig = "PULLUP";

gpio2.$name     = "myGPIOOutput0";
gpio2.direction = "GPIO_DIR_MODE_OUT";
