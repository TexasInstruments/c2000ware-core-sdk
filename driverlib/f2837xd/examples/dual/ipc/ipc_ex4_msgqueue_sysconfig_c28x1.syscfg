/**
 * @cliArgs --device "F2837xD" --package "F2837xD_337ZWT" --part "F2837xD_337ZWT" --context "CPU1" --product "C2000WARE@4.03.00.00"
 * @versions {"tool":"1.15.999+71"}
 */

/**
 * Import the modules used in this configuration.
 */
const ipc  = scripting.addModule("/driverlib/ipc.js");
const CMD  = scripting.addModule("/utilities/cmd_tool/cmd_syscfg/source/CMD");
const CMD1 = CMD.addInstance();

/**
 * Write custom configuration values to the imported modules.
 */
ipc.flagHandler31    = "SYNC_FLAG";
ipc.ipcRegisterFlag  = ["IPC_FLAG1","IPC_FLAG31"];
ipc.enableInterrupt1 = true;

CMD.activateCMD = true;

CMD1.$name                               = "CMD0";
CMD1.sectionMemory_text                  = ["FLASHB","FLASHC","FLASHD","FLASHE"];
CMD1.sectionAlignEnable_text             = true;
CMD1.sectionMemory_ramfunc               = ["FLASHD"];
CMD1.sectionRunFromDifferentAddr_ramfunc = true;
CMD1.sectionRun_ramfunc                  = ["RAMLS0"];
CMD1.sectionAlignEnable_ramfunc          = true;
CMD1.sectionMemory_ovly                  = ["FLASHA"];
CMD1.sectionAlignEnable_ovly             = true;
CMD1.sectionMemory_cinit                 = ["FLASHA"];
CMD1.sectionAlignEnable_cinit            = true;
CMD1.sectionMemory_stack                 = ["RAMM1"];
CMD1.sectionMemory_init_array            = ["FLASHB"];
CMD1.sectionAlignEnable_init_array       = true;
CMD1.sectionMemory_bss                   = ["RAMLS5"];
CMD1.sectionMemory_const                 = ["FLASHF"];
CMD1.sectionAlignEnable_const            = true;
CMD1.sectionMemory_data                  = ["RAMLS5"];
CMD1.sectionMemory_switch                = ["FLASHA"];
CMD1.sectionAlignEnable_switch           = true;
CMD1.sectionMemory_sysmem                = ["RAMLS5"];
CMD1.sectionAlignEnable_binit            = true;
CMD1.sectionMemory_binit                 = ["FLASHA"];
