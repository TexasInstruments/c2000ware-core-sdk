/**
 * These arguments were used when this file was generated. They will be automatically applied on subsequent loads
 * via the GUI or CLI. Run CLI with '--help' for additional information on how to override these arguments.
 * @cliArgs --device "F2837xD" --part "F2837xD_337ZWT" --package "F2837xD_337ZWT" --context "CPU1"
 * @v2CliArgs --device "TMS320F2837xD" --package "337ZWT" --context "CPU1"
 */


/**
 * Import the modules used in this configuration.
 */
const ipc    = scripting.addModule("/driverlib/ipc.js");
const sysctl = scripting.addModule("/driverlib/sysctl.js");

/**
 * Write custom configuration values to the imported modules.
 */
sysctl.enableNMIGlobalInterrupt = true;
