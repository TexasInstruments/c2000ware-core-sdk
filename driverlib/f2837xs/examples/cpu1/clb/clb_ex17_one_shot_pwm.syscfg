var TILE = scripting.addModule("/utilities/clb_tool/clb_syscfg/source/TILE");
var TILE1 = TILE.addInstance();
// clock_period - Period of the clock (in Nano Seconds) used for simulation in System C
TILE.clock_period = 10;
// sim_duration - Duration of the simulation (in Nano Seconds)
TILE.sim_duration = 100000;
// Name
TILE1.$name = "TILE1";
// Name
TILE1.BOUNDARY.$name = "BOUNDARY0";
// in0
TILE1.BOUNDARY.in0 = "squareWave";
// in_duty1 - Duty or ON time of the square wave
TILE1.BOUNDARY.in_duty1 = 50;
// in_period1 - Period of the square wave
TILE1.BOUNDARY.in_period1 = 100;
// in_repeat_count3 - Number of periods the waveform is repeated
TILE1.BOUNDARY.in_repeat_count3 = 1;
// in_repeat_count1 - Number of periods the waveform is repeated
TILE1.BOUNDARY.in_repeat_count1 = 1000;
// in_period0 - Period of the square wave
TILE1.BOUNDARY.in_period0 = 100;
// in_repeat_count0 - Number of periods the waveform is repeated
TILE1.BOUNDARY.in_repeat_count0 = 1000;
// Name
TILE1.LUT_0.$name = "LUT_0";
// i0 - Input 0.
TILE1.LUT_0.i0 = "FSM_0.S0";
// eqn - Boolean equation on the variables i3,i2,i1,i0 for the LUT output.
TILE1.LUT_0.eqn = "~i0";
// Name
TILE1.LUT_1.$name = "LUT_1";
// Name
TILE1.LUT_2.$name = "LUT_2";
// Name
TILE1.FSM_0.$name = "FSM_0";
// e1 - External Input 1.
TILE1.FSM_0.e1 = "COUNTER_0.count_match2";
// eqn_s0 - Boolean equation on the variables e1,e0,s1,s0 for the S0 output.
TILE1.FSM_0.eqn_s0 = "(~e0 & (~e1) & s0) |  e0";
// e0 - External Input 0.
TILE1.FSM_0.e0 = "COUNTER_2.count_match1";
// Name
TILE1.FSM_1.$name = "FSM_1";
// Name
TILE1.FSM_2.$name = "FSM_2";
// Name
TILE1.COUNTER_0.$name = "COUNTER_0";
// mode1 - Controls counting direction. High enables count up. Low enables count down.
TILE1.COUNTER_0.mode1 = "1";
// match1_val - Sets the value of the Match reference 1 register.
TILE1.COUNTER_0.match1_val = "";
// mode0 - Enables Counting when high
TILE1.COUNTER_0.mode0 = "FSM_0.S0";
// reset - Reset the counter to 0 on next clock cycle (triggers low to high)
TILE1.COUNTER_0.reset = "COUNTER_0.count_match2";
// match2_val - Sets the value of the Match reference 2 register.
TILE1.COUNTER_0.match2_val = "20";
// Name
TILE1.COUNTER_1.$name = "COUNTER_1";
// mode1 - Controls counting direction. High enables count up. Low enables count down.
TILE1.COUNTER_1.mode1 = "1";
// What action should be taken on an event trigger?
TILE1.COUNTER_1.action = "Add";
// event_load_val - Sets the value of the event load value register.
TILE1.COUNTER_1.event_load_val = "1";
// reset - Reset the counter to 0 on next clock cycle (triggers low to high)
TILE1.COUNTER_1.reset = "COUNTER_1.count_match1";
// event - Trigger actions in the counter.
TILE1.COUNTER_1.event = "BOUNDARY.in0";
// match1_val - Sets the value of the Match reference 1 register.
TILE1.COUNTER_1.match1_val = "3";
// Name
TILE1.COUNTER_2.$name = "COUNTER_2";
// event - Trigger actions in the counter.
TILE1.COUNTER_2.event = "BOUNDARY.in0";
// What action should be taken on an event trigger?
TILE1.COUNTER_2.action = "Load";
// event_load_val - Sets the value of the event load value register.
TILE1.COUNTER_2.event_load_val = "1";
// match1_val - Sets the value of the Match reference 1 register.
TILE1.COUNTER_2.match1_val = "1";
// reset - Reset the counter to 0 on next clock cycle (triggers low to high)
TILE1.COUNTER_2.reset = "COUNTER_2.count_match1";
// Name
TILE1.OUTLUT_0.$name = "OUTLUT_0";
// Name
TILE1.OUTLUT_1.$name = "OUTLUT_1";
// Name
TILE1.OUTLUT_2.$name = "OUTLUT_2";
// Name
TILE1.OUTLUT_3.$name = "OUTLUT_3";
// Name
TILE1.OUTLUT_4.$name = "OUTLUT_4";
// i0 - Input 0.
TILE1.OUTLUT_4.i0 = "FSM_0.S0";
// i1 - Input 1.
TILE1.OUTLUT_4.i1 = "COUNTER_0.count_match2";
// eqn - Boolean equation on the variables i2,i1,i0 for the OUTLUT output.
TILE1.OUTLUT_4.eqn = "i0 & (~i1)";
// Name
TILE1.OUTLUT_5.$name = "OUTLUT_5";
// Name
TILE1.OUTLUT_6.$name = "OUTLUT_6";
// Name
TILE1.OUTLUT_7.$name = "OUTLUT_7";
// Name
TILE1.HLC.$name = "HLC_0";
// Event 0 (e0) - Event 0
TILE1.HLC.e0 = "BOUNDARY.in0";
// Event 1 (e1) - Event 1
TILE1.HLC.e1 = "COUNTER_1.count_match1";
// R0_init - Initial value for register R0
TILE1.HLC.R0_init = "20";
// Name
TILE1.HLC.program0.$name = "HLCP_0";
// instruct0
TILE1.HLC.program0.instruct0 = "MOV_T2 R0, C0";
// Name
TILE1.HLC.program1.$name = "HLCP_1";
// instruct0
TILE1.HLC.program1.instruct0 = "INTR 1";
// Name
TILE1.HLC.program2.$name = "HLCP_2";
// Name
TILE1.HLC.program3.$name = "HLCP_3";
var clb_run_dynamic_template_clb_h = scripting.addModule("/utilities/clb_tool/clb_syscfg/source/clb_run_dynamic_template_clb_h.js");
var clb_run_dynamic_template_clb_c = scripting.addModule("/utilities/clb_tool/clb_syscfg/source/clb_run_dynamic_template_clb_c.js");
var clb_run_dynamic_template_clb_sim = scripting.addModule("/utilities/clb_tool/clb_syscfg/source/clb_run_dynamic_template_clb_sim.js");
var clb_run_dynamic_template_clb_dot = scripting.addModule("/utilities/clb_tool/clb_syscfg/source/clb_run_dynamic_template_clb_dot.js");
