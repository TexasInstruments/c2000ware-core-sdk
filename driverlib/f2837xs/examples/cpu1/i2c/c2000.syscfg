/**
 * These arguments were used when this file was generated. They will be automatically applied on subsequent loads
 * via the GUI or CLI. Run CLI with '--help' for additional information on how to override these arguments.
 * @cliArgs --device "F2837xS" --part "F2837xS_337ZWT" --package "F2837xS_337ZWT" --context "system"
 * @v2CliArgs --device "TMS320F2837xS" --package "337ZWT" --context "system"
 */
