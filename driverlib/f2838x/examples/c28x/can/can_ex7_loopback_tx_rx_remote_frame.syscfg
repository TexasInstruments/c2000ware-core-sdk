/**
 * Import the modules used in this configuration.
 */
const can  = scripting.addModule("/driverlib/can.js", {}, false);
const can1 = can.addInstance();

/**
 * Write custom configuration values to the imported modules.
 */
can1.$name             = "myCAN0";
can1.enableLoopback    = true;
can1.loopbackMode      = "CAN_TEST_EXL";
can1.msgObjsUsed       = [1,2,3];
can1.msgObj1.$name     = "msgObj0";
can1.msgObj1.msgLen    = 8;
can1.msgObj1.frameType = "CAN_MSG_FRAME_EXT";
can1.msgObj1.msgID     = 5;
can1.msgObj2.$name     = "msgObj1";
can1.msgObj2.msgLen    = 8;
can1.msgObj2.frameType = "CAN_MSG_FRAME_EXT";
can1.msgObj2.msgID     = 5;
can1.msgObj2.msgType   = "CAN_MSG_OBJ_TYPE_RXTX_REMOTE";
can1.msgObj3.$name     = "msgObj2";
can1.msgObj3.frameType = "CAN_MSG_FRAME_EXT";
can1.msgObj3.msgType   = "CAN_MSG_OBJ_TYPE_TX_REMOTE";
can1.msgObj3.msgID     = 7;
