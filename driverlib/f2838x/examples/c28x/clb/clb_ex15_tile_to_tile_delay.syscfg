/**
 * Import the modules used in this configuration.
 */
const clb                              = scripting.addModule("/driverlib/clb.js", {}, false);
const clb1                             = clb.addInstance();
const clb2                             = clb.addInstance();
const clb3                             = clb.addInstance();
const clb4                             = clb.addInstance();
const clbxbar                          = scripting.addModule("/driverlib/clbxbar.js", {}, false);
const clbxbar1                         = clbxbar.addInstance();
const clbxbar2                         = clbxbar.addInstance();
const clbxbar3                         = clbxbar.addInstance();
const clbxbar4                         = clbxbar.addInstance();
const clbxbar5                         = clbxbar.addInstance();
const epwm                             = scripting.addModule("/driverlib/epwm.js", {}, false);
const epwm1                            = epwm.addInstance();
const epwm2                            = epwm.addInstance();
const gpio                             = scripting.addModule("/driverlib/gpio.js", {}, false);
const gpio1                            = gpio.addInstance();
const inputxbar                        = scripting.addModule("/driverlib/inputxbar.js", {}, false);
const inputxbar1                       = inputxbar.addInstance();
const outputxbar                       = scripting.addModule("/driverlib/outputxbar.js", {}, false);
const outputxbar1                      = outputxbar.addInstance();
const outputxbar2                      = outputxbar.addInstance();
const outputxbar3                      = outputxbar.addInstance();
const outputxbar4                      = outputxbar.addInstance();
const TILE                             = scripting.addModule("/utilities/clb_tool/clb_syscfg/source/TILE");
const TILE1                            = TILE.addInstance();
const TILE2                            = TILE.addInstance();
const TILE3                            = TILE.addInstance();
const TILE4                            = TILE.addInstance();
const clb_run_dynamic_template_clb_c   = scripting.addModule("/utilities/clb_tool/clb_syscfg/source/clb_run_dynamic_template_clb_c.js");
const clb_run_dynamic_template_clb_dot = scripting.addModule("/utilities/clb_tool/clb_syscfg/source/clb_run_dynamic_template_clb_dot.js");
const clb_run_dynamic_template_clb_h   = scripting.addModule("/utilities/clb_tool/clb_syscfg/source/clb_run_dynamic_template_clb_h.js");
const clb_run_dynamic_template_clb_sim = scripting.addModule("/utilities/clb_tool/clb_syscfg/source/clb_run_dynamic_template_clb_sim.js");

/**
 * Write custom configuration values to the imported modules.
 */
clb1.$name                       = "myTILE1";
clb1.enableCLB                   = true;
clb1.inputsUsed                  = ["CLB_IN0","CLB_IN1"];
clb1.inputTypeCLB_IN0            = "GLOBAL";
clb1.inputTypeCLB_IN1            = "GLOBAL";
clb1.globalConfigCLB_IN0         = "CLB_GLOBAL_IN_MUX_CLB_AUXSIG0";
clb1.globalConfigCLB_IN1         = "CLB_GLOBAL_IN_MUX_CLB_AUXSIG1";
clb1.outputsToOverridePeripheral = ["CLB_OUT2"];
clb1.synchronizeCLB_IN0          = true;
clb1.synchronizeCLB_IN1          = true;

clb2.clbBase             = "CLB2_BASE";
clb2.$name               = "myTILE2";
clb2.enableCLB           = true;
clb2.inputsUsed          = ["CLB_IN0","CLB_IN1"];
clb2.inputTypeCLB_IN0    = "GLOBAL";
clb2.inputTypeCLB_IN1    = "GLOBAL";
clb2.globalConfigCLB_IN0 = "CLB_GLOBAL_IN_MUX_CLB_AUXSIG0";
clb2.globalConfigCLB_IN1 = "CLB_GLOBAL_IN_MUX_CLB_AUXSIG2";
clb2.synchronizeCLB_IN0  = true;
clb2.synchronizeCLB_IN1  = true;

clb3.clbBase                     = "CLB3_BASE";
clb3.$name                       = "myTILE3";
clb3.enableCLB                   = true;
clb3.inputsUsed                  = ["CLB_IN0","CLB_IN1"];
clb3.inputTypeCLB_IN1            = "GLOBAL";
clb3.inputTypeCLB_IN0            = "GLOBAL";
clb3.globalConfigCLB_IN0         = "CLB_GLOBAL_IN_MUX_CLB_AUXSIG0";
clb3.globalConfigCLB_IN1         = "CLB_GLOBAL_IN_MUX_CLB_AUXSIG3";
clb3.outputsToOverridePeripheral = ["CLB_OUT2"];
clb3.synchronizeCLB_IN0          = true;
clb3.synchronizeCLB_IN1          = true;

clb4.clbBase             = "CLB4_BASE";
clb4.$name               = "myTILE4";
clb4.enableCLB           = true;
clb4.inputsUsed          = ["CLB_IN0","CLB_IN1"];
clb4.inputTypeCLB_IN1    = "GLOBAL";
clb4.inputTypeCLB_IN0    = "GLOBAL";
clb4.globalConfigCLB_IN0 = "CLB_GLOBAL_IN_MUX_CLB_AUXSIG0";
clb4.globalConfigCLB_IN1 = "CLB_GLOBAL_IN_MUX_CLB_AUXSIG4";
clb4.synchronizeCLB_IN0  = true;
clb4.synchronizeCLB_IN1  = true;

clbxbar1.$name      = "myCLBXBAR0";
clbxbar1.muxesUsed  = ["XBAR_MUX01"];
clbxbar1.mux1Config = "XBAR_CLB_MUX01_INPUTXBAR1";
clbxbar2.$name      = "myCLBXBAR1";
clbxbar2.auxInput   = "XBAR_AUXSIG1";
clbxbar2.muxesUsed  = ["XBAR_MUX05"];
clbxbar2.mux5Config = "XBAR_CLB_MUX05_CLB2_OUT4";

clbxbar3.$name      = "myCLBXBAR2";
clbxbar3.auxInput   = "XBAR_AUXSIG2";
clbxbar3.muxesUsed  = ["XBAR_MUX01"];
clbxbar3.mux1Config = "XBAR_CLB_MUX01_CLB1_OUT4";

clbxbar4.$name      = "myCLBXBAR3";
clbxbar4.auxInput   = "XBAR_AUXSIG3";
clbxbar4.muxesUsed  = ["XBAR_MUX03"];
clbxbar4.mux3Config = "XBAR_CLB_MUX03_INPUTXBAR2";

clbxbar5.$name      = "myCLBXBAR4";
clbxbar5.auxInput   = "XBAR_AUXSIG4";
clbxbar5.muxesUsed  = ["XBAR_MUX05"];
clbxbar5.mux5Config = "XBAR_CLB_MUX05_INPUTXBAR3";

epwm1.$name                 = "myEPWM1";
epwm1.useCase               = "CUSTOM";
epwm1.useInterfacePins      = ["EPWM#B"];
epwm1.epwm.$assign          = "EPWM1";
epwm1.epwm.epwmbPin.$assign = "GPIO1";

epwm2.$name                 = "myEPWM3";
epwm2.useCase               = "CUSTOM";
epwm2.useInterfacePins      = ["EPWM#B"];
epwm2.epwm.$assign          = "EPWM3";
epwm2.epwm.epwmbPin.$assign = "GPIO5";

gpio1.$name           = "myGPIO0";
gpio1.direction       = "GPIO_DIR_MODE_OUT";
gpio1.gpioPin.$assign = "GPIO0";

inputxbar1.$name          = "myINPUTXBAR0";
inputxbar1.inputxbar3Gpio = "GPIO14";
inputxbar1.inputsUsed     = ["inputxbar1Gpio","inputxbar2Gpio","inputxbar3Gpio"];
inputxbar1.inputxbar2Gpio = "GPIO15";

outputxbar1.$name                            = "myOUTPUTXBAR1";
outputxbar1.muxesUsed                        = ["XBAR_MUX01"];
outputxbar1.mux1Config                       = "XBAR_OUT_MUX01_CLB1_OUT4";
outputxbar1.outputxbar.$assign               = "OUTPUTXBAR1";
outputxbar1.outputxbar.outputxbarPin.$assign = "GPIO24";

outputxbar2.$name                            = "myOUTPUTXBAR7";
outputxbar2.muxesUsed                        = ["XBAR_MUX05"];
outputxbar2.mux5Config                       = "XBAR_OUT_MUX05_CLB2_OUT4";
outputxbar2.outputxbar.$assign               = "OUTPUTXBAR7";
outputxbar2.outputxbar.outputxbarPin.$assign = "GPIO16";

outputxbar3.$name                            = "myOUTPUTXBAR3";
outputxbar3.muxesUsed                        = ["XBAR_MUX09"];
outputxbar3.mux9Config                       = "XBAR_OUT_MUX09_CLB3_OUT4";
outputxbar3.outputxbar.$assign               = "OUTPUTXBAR3";
outputxbar3.outputxbar.outputxbarPin.$assign = "GPIO14";

outputxbar4.$name                            = "myOUTPUTXBAR4";
outputxbar4.muxesUsed                        = ["XBAR_MUX13"];
outputxbar4.mux13Config                      = "XBAR_OUT_MUX13_CLB4_OUT4";
outputxbar4.outputxbar.$assign               = "OUTPUTXBAR4";
outputxbar4.outputxbar.outputxbarPin.$assign = "GPIO15";

TILE1.$name                     = "TILE1";
TILE1.BOUNDARY.$name            = "BOUNDARY0";
TILE1.BOUNDARY.boundaryInput1              = "tileOutput";
TILE1.BOUNDARY.tileSelect1                 = "TILE2";
TILE1.BOUNDARY.tileOutputSelect1           = 4;
TILE1.BOUNDARY.boundaryInput0              = "squareWave";
TILE1.BOUNDARY.in_edge0         = "rising edge";
TILE1.BOUNDARY.in_period0       = 1000;
TILE1.BOUNDARY.in_duty0         = 500;
TILE1.BOUNDARY.in_repeat_count0 = 1;
TILE1.BOUNDARY.input_pipeline1   = true;
TILE1.LUT_0.$name               = "LUT_0";
TILE1.LUT_1.$name               = "LUT_1";
TILE1.LUT_2.$name               = "LUT_2";
TILE1.FSM_0.$name               = "FSM_0";
TILE1.FSM_0.e0                  = "BOUNDARY.in0";
TILE1.FSM_0.e1                  = "BOUNDARY.in1";
TILE1.FSM_0.eqn_s0              = "e0&!e1";
TILE1.FSM_1.$name               = "FSM_1";
TILE1.FSM_2.$name               = "FSM_2";
TILE1.COUNTER_0.$name           = "COUNTER_0";
TILE1.COUNTER_0.mode0           = "FSM_0.S0";
TILE1.COUNTER_0.mode1           = "1";
TILE1.COUNTER_1.$name           = "COUNTER_1";
TILE1.COUNTER_2.$name           = "COUNTER_2";
TILE1.OUTLUT_0.$name            = "OUTLUT_0";
TILE1.OUTLUT_1.$name            = "OUTLUT_1";
TILE1.OUTLUT_2.$name            = "OUTLUT_2";
TILE1.OUTLUT_2.i0               = "BOUNDARY.in1";
TILE1.OUTLUT_2.eqn              = "i0";
TILE1.OUTLUT_3.$name            = "OUTLUT_3";
TILE1.OUTLUT_4.$name            = "OUTLUT_4";
TILE1.OUTLUT_4.i0               = "BOUNDARY.in0";
TILE1.OUTLUT_4.eqn              = "i0";
TILE1.OUTLUT_5.$name            = "OUTLUT_5";
TILE1.OUTLUT_6.$name            = "OUTLUT_6";
TILE1.OUTLUT_7.$name            = "OUTLUT_7";
TILE1.HLC.$name                 = "HLC_0";
TILE1.HLC.e0                    = "BOUNDARY.in1";
TILE1.HLC.program0.$name        = "HLCP_0";
TILE1.HLC.program0.instruct0    = "INTR 1";
TILE1.HLC.program1.$name        = "HLCP_1";
TILE1.HLC.program2.$name        = "HLCP_2";
TILE1.HLC.program3.$name        = "HLCP_3";

TILE2.$name                     = "TILE2";
TILE2.BOUNDARY.$name            = "BOUNDARY1";
TILE2.BOUNDARY.boundaryInput1              = "tileOutput";
TILE2.BOUNDARY.tileSelect1                 = "TILE1";
TILE2.BOUNDARY.tileOutputSelect1           = 4;
TILE2.BOUNDARY.boundaryInput0              = "squareWave";
TILE2.BOUNDARY.in_edge0         = "rising edge";
TILE2.BOUNDARY.in_period0       = 1000;
TILE2.BOUNDARY.in_duty0         = 500;
TILE2.BOUNDARY.in_repeat_count0 = 1;
TILE2.BOUNDARY.input_pipeline1   = true;
TILE2.LUT_0.$name               = "LUT_3";
TILE2.LUT_1.$name               = "LUT_4";
TILE2.LUT_2.$name               = "LUT_5";
TILE2.FSM_0.$name               = "FSM_3";
TILE2.FSM_0.e0                  = "BOUNDARY.in0";
TILE2.FSM_0.e1                  = "BOUNDARY.in1";
TILE2.FSM_0.eqn_s0              = "e0&!e1";
TILE2.FSM_1.$name               = "FSM_4";
TILE2.FSM_2.$name               = "FSM_5";
TILE2.COUNTER_0.$name           = "COUNTER_3";
TILE2.COUNTER_0.mode0           = "FSM_0.S0";
TILE2.COUNTER_0.mode1           = "1";
TILE2.COUNTER_1.$name           = "COUNTER_4";
TILE2.COUNTER_2.$name           = "COUNTER_5";
TILE2.OUTLUT_0.$name            = "OUTLUT_8";
TILE2.OUTLUT_1.$name            = "OUTLUT_9";
TILE2.OUTLUT_2.$name            = "OUTLUT_10";
TILE2.OUTLUT_3.$name            = "OUTLUT_11";
TILE2.OUTLUT_4.$name            = "OUTLUT_12";
TILE2.OUTLUT_4.i0               = "BOUNDARY.in0";
TILE2.OUTLUT_4.eqn              = "i0";
TILE2.OUTLUT_5.$name            = "OUTLUT_13";
TILE2.OUTLUT_6.$name            = "OUTLUT_14";
TILE2.OUTLUT_7.$name            = "OUTLUT_15";
TILE2.HLC.$name                 = "HLC_1";
TILE2.HLC.e0                    = "BOUNDARY.in1";
TILE2.HLC.program0.$name        = "HLCP_4";
TILE2.HLC.program0.instruct0    = "INTR 1";
TILE2.HLC.program1.$name        = "HLCP_5";
TILE2.HLC.program2.$name        = "HLCP_6";
TILE2.HLC.program3.$name        = "HLCP_7";
TILE3.$name                     = "TILE3";
TILE3.BOUNDARY.$name            = "BOUNDARY2";
TILE3.BOUNDARY.boundaryInput1              = "tileOutput";
TILE3.BOUNDARY.tileSelect1                 = "TILE4";
TILE3.BOUNDARY.tileOutputSelect1           = 4;
TILE3.BOUNDARY.boundaryInput0              = "squareWave";
TILE3.BOUNDARY.in_edge0         = "rising edge";
TILE3.BOUNDARY.in_period0       = 1000;
TILE3.BOUNDARY.in_duty0         = 500;
TILE3.BOUNDARY.in_repeat_count0 = 1;
TILE3.BOUNDARY.input_pipeline1   = true;
TILE3.LUT_0.$name               = "LUT_6";
TILE3.LUT_1.$name               = "LUT_7";
TILE3.LUT_2.$name               = "LUT_8";
TILE3.FSM_0.$name               = "FSM_6";
TILE3.FSM_0.e0                  = "BOUNDARY.in0";
TILE3.FSM_0.e1                  = "BOUNDARY.in1";
TILE3.FSM_0.eqn_s0              = "e0&!e1";
TILE3.FSM_1.$name               = "FSM_7";
TILE3.FSM_2.$name               = "FSM_8";
TILE3.COUNTER_0.$name           = "COUNTER_6";
TILE3.COUNTER_0.mode0           = "FSM_0.S0";
TILE3.COUNTER_0.mode1           = "1";
TILE3.COUNTER_1.$name           = "COUNTER_7";
TILE3.COUNTER_2.$name           = "COUNTER_8";
TILE3.OUTLUT_0.$name            = "OUTLUT_16";
TILE3.OUTLUT_1.$name            = "OUTLUT_17";
TILE3.OUTLUT_2.$name            = "OUTLUT_18";
TILE3.OUTLUT_2.i0               = "BOUNDARY.in1";
TILE3.OUTLUT_2.eqn              = "i0";
TILE3.OUTLUT_3.$name            = "OUTLUT_19";
TILE3.OUTLUT_4.$name            = "OUTLUT_20";
TILE3.OUTLUT_4.i0               = "BOUNDARY.in0";
TILE3.OUTLUT_4.eqn              = "i0";
TILE3.OUTLUT_5.$name            = "OUTLUT_21";
TILE3.OUTLUT_6.$name            = "OUTLUT_22";
TILE3.OUTLUT_7.$name            = "OUTLUT_23";
TILE3.HLC.$name                 = "HLC_2";
TILE3.HLC.e0                    = "BOUNDARY.in1";
TILE3.HLC.program0.$name        = "HLCP_8";
TILE3.HLC.program0.instruct0    = "INTR 1";
TILE3.HLC.program1.$name        = "HLCP_9";
TILE3.HLC.program2.$name        = "HLCP_10";
TILE3.HLC.program3.$name        = "HLCP_11";

TILE4.$name                     = "TILE4";
TILE4.BOUNDARY.$name            = "BOUNDARY3";
TILE4.BOUNDARY.boundaryInput1              = "tileOutput";
TILE4.BOUNDARY.tileSelect1                 = "TILE3";
TILE4.BOUNDARY.tileOutputSelect1           = 4;
TILE4.BOUNDARY.boundaryInput0              = "squareWave";
TILE4.BOUNDARY.in_edge0         = "rising edge";
TILE4.BOUNDARY.in_period0       = 1000;
TILE4.BOUNDARY.in_duty0         = 500;
TILE4.BOUNDARY.in_repeat_count0 = 1;
TILE4.BOUNDARY.input_pipeline1   = true;
TILE4.LUT_0.$name               = "LUT_9";
TILE4.LUT_1.$name               = "LUT_10";
TILE4.LUT_2.$name               = "LUT_11";
TILE4.FSM_0.$name               = "FSM_9";
TILE4.FSM_0.e0                  = "BOUNDARY.in0";
TILE4.FSM_0.e1                  = "BOUNDARY.in1";
TILE4.FSM_0.eqn_s0              = "e0&!e1";
TILE4.FSM_1.$name               = "FSM_10";
TILE4.FSM_2.$name               = "FSM_11";
TILE4.COUNTER_0.$name           = "COUNTER_9";
TILE4.COUNTER_0.mode0           = "FSM_0.S0";
TILE4.COUNTER_0.mode1           = "1";
TILE4.COUNTER_1.$name           = "COUNTER_10";
TILE4.COUNTER_2.$name           = "COUNTER_11";
TILE4.OUTLUT_0.$name            = "OUTLUT_24";
TILE4.OUTLUT_1.$name            = "OUTLUT_25";
TILE4.OUTLUT_2.$name            = "OUTLUT_26";
TILE4.OUTLUT_3.$name            = "OUTLUT_27";
TILE4.OUTLUT_4.$name            = "OUTLUT_28";
TILE4.OUTLUT_4.i0               = "BOUNDARY.in0";
TILE4.OUTLUT_4.eqn              = "i0";
TILE4.OUTLUT_5.$name            = "OUTLUT_29";
TILE4.OUTLUT_6.$name            = "OUTLUT_30";
TILE4.OUTLUT_7.$name            = "OUTLUT_31";
TILE4.HLC.$name                 = "HLC_3";
TILE4.HLC.e0                    = "BOUNDARY.in1";
TILE4.HLC.program0.$name        = "HLCP_12";
TILE4.HLC.program0.instruct0    = "INTR 1";
TILE4.HLC.program1.$name        = "HLCP_13";
TILE4.HLC.program2.$name        = "HLCP_14";
TILE4.HLC.program3.$name        = "HLCP_15";
