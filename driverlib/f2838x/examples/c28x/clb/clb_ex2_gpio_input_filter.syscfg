/**
 * Import the modules used in this configuration.
 */
const clb   = scripting.addModule("/driverlib/clb.js", {}, false);
const clb1  = clb.addInstance();
const epwm  = scripting.addModule("/driverlib/epwm.js", {}, false);
const epwm1 = epwm.addInstance();
const TILE  = scripting.addModule("/utilities/clb_tool/clb_syscfg/source/TILE");
const TILE1 = TILE.addInstance();

/**
 * Write custom configuration values to the imported modules.
 */
clb1.$name            = "myTILE1";
clb1.enableCLB        = true;
clb1.inputsUsed       = ["CLB_IN0"];
clb1.inputTypeCLB_IN0 = "GLOBAL";
clb1.synchronizeCLB_IN0 = true;

epwm1.$name                  = "myEPWM1";
epwm1.epwm.$assign           = "EPWM1";
epwm1.epwm.epwmaPin.$assign = "GPIO0";
epwm1.epwm.epwmbPin.$assign = "GPIO1";

TILE.clock_period = 10000;
TILE.sim_duration = 100000000;

TILE1.$name                     = "TILE1";
TILE1.BOUNDARY.$name            = "BOUNDARY0";
TILE1.BOUNDARY.boundaryInput0   = "squareWave";
TILE1.BOUNDARY.in_duty0         = 20;
TILE1.BOUNDARY.in_period0       = 40;
TILE1.BOUNDARY.in_repeat_count0 = 50;
TILE1.LUT_0.$name               = "LUT_0";
TILE1.LUT_0.eqn                 = "~i0";
TILE1.LUT_0.i0                  = "BOUNDARY.in0";
TILE1.LUT_1.$name               = "LUT_1";
TILE1.LUT_2.$name               = "LUT_2";
TILE1.FSM_0.$name               = "FSM_0";
TILE1.FSM_0.e0                  = "COUNTER_0.count_match1";
TILE1.FSM_0.e1                  = "COUNTER_1.count_match1";
TILE1.FSM_0.eqn_s0              = "(~s0 & e1) | (s0 & (~e0))";
TILE1.FSM_1.$name               = "FSM_1";
TILE1.FSM_2.$name               = "FSM_2";
TILE1.COUNTER_0.$name           = "COUNTER_0";
TILE1.COUNTER_0.match1_val      = "8";
TILE1.COUNTER_0.mode1           = "1";
TILE1.COUNTER_0.mode0           = "LUT_0.OUT";
TILE1.COUNTER_0.reset           = "BOUNDARY.in0";
TILE1.COUNTER_1.$name           = "COUNTER_1";
TILE1.COUNTER_1.match1_val      = "8";
TILE1.COUNTER_1.mode1           = "1";
TILE1.COUNTER_1.mode0           = "BOUNDARY.in0";
TILE1.COUNTER_1.reset           = "LUT_0.OUT";
TILE1.COUNTER_2.$name           = "COUNTER_2";
TILE1.OUTLUT_0.$name            = "OUTLUT_0";
TILE1.OUTLUT_0.eqn              = "i0";
TILE1.OUTLUT_0.i0               = "FSM_0.S0";
TILE1.OUTLUT_1.$name            = "OUTLUT_1";
TILE1.OUTLUT_2.$name            = "OUTLUT_2";
TILE1.OUTLUT_3.$name            = "OUTLUT_3";
TILE1.OUTLUT_4.$name            = "OUTLUT_4";
TILE1.OUTLUT_5.$name            = "OUTLUT_5";
TILE1.OUTLUT_6.$name            = "OUTLUT_6";
TILE1.OUTLUT_7.$name            = "OUTLUT_7";
TILE1.HLC.$name                 = "HLC_0";
TILE1.HLC.program0.$name        = "HLCP_0";
TILE1.HLC.program1.$name        = "HLCP_1";
TILE1.HLC.program2.$name        = "HLCP_2";
TILE1.HLC.program3.$name        = "HLCP_3";
TILE1.AOC_0.$name               = "AOC_0";
TILE1.AOC_1.$name               = "AOC_1";
TILE1.AOC_2.$name               = "AOC_2";
TILE1.AOC_3.$name               = "AOC_3";
TILE1.AOC_4.$name               = "AOC_4";
TILE1.AOC_5.$name               = "AOC_5";
TILE1.AOC_6.$name               = "AOC_6";
TILE1.AOC_7.$name               = "AOC_7";
