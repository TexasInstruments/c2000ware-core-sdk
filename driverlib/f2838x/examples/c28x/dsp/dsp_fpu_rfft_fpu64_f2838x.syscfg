/**
 * @cliArgs --device "F2838x" --package "337bga" --part "F2838x_337bga" --context "CPU1" --product "C2000WARE@4.02.00.00"
 * @versions {"tool":"1.12.0+2406"}
 */

/**
 * Import the modules used in this configuration.
 */
const FFT  = scripting.addModule("/libraries/dsp/FPU/FFT/FFT.js", {}, false);
const FFT1 = FFT.addInstance();

/**
 * Write custom configuration values to the imported modules.
 */
FFT1.$name             = "myFFT0";
FFT1.fpuType           = "FPU64";
FFT1.RFFT.create(1);
FFT1.RFFT[0].$name     = "myRFFT0";
FFT1.RFFT[0].inPtr     = "inPtr";
FFT1.RFFT[0].outPtr    = "outPtr";
FFT1.RFFT[0].inAdcPtr  = "inADC";
FFT1.RFFT[0].numStages = 9;

const FPU   = scripting.addModule("/libraries/math/FPU/FPU.js", {}, false);
FPU.fpuType = "FPU64";
