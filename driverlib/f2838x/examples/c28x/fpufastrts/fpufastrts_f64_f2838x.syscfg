/**
 * @cliArgs --device "F2838x" --package "337bga" --part "F2838x_337bga" --product "C2000WARE@4.02.00.00"
 * @versions {"tool":"1.11.0+2225"}
 */

/**
 * Import the modules used in this configuration.
 */
const FPUfastRTS  = scripting.addModule("/libraries/math/FPUfastRTS/FPUfastRTS.js", {}, false);
const FPUfastRTS1 = FPUfastRTS.addInstance();

/**
 * Write custom configuration values to the imported modules.
 */
FPUfastRTS1.$name             = "myFFR0";
FPUfastRTS1.fpuType           = "FPU64";
FPUfastRTS1.cordic.create(1);
FPUfastRTS1.cordic[0].$name   = "myCOR0";
FPUfastRTS1.cordic[0].numIter = 60;

const FPU   = scripting.addModule("/libraries/math/FPU/FPU.js", {}, false);
FPU.fpuType = "FPU64";
