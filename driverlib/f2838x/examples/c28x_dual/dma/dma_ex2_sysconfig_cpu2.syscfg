/**
 * @cliArgs --device "F2838x" --package "337bga" --part "F2838x_337bga" --context "CPU2" --product "C2000WARE@4.02.00.00"
 * @versions {"tool":"1.13.0+2553"}
 */

/**
 * Import the modules used in this configuration.
 */
const cputimer  = scripting.addModule("/driverlib/cputimer.js", {}, false);
const cputimer1 = cputimer.addInstance();
const ipc       = scripting.addModule("/driverlib/ipc.js");
const spi       = scripting.addModule("/driverlib/spi.js", {}, false);
const spi1      = spi.addInstance();
const sysctl    = scripting.addModule("/driverlib/sysctl.js");

/**
 * Write custom configuration values to the imported modules.
 */
cputimer1.$name           = "myCPUTIMER1";
cputimer1.cputimerBase    = "CPUTIMER1_BASE";
cputimer1.timerPeriod     = 4294967295;
cputimer1.enableInterrupt = true;

spi1.$name                 = "mySPI0";
spi1.mode                  = "SPI_MODE_MASTER";
spi1.emulationMode         = "SPI_EMULATION_STOP_AFTER_TRANSMIT";
spi1.bitRate               = 500000;
spi1.enabledFIFOInterrupts = ["SPI_INT_RXFF","SPI_INT_TXFF"];
spi1.txFifo                = "SPI_FIFO_TX2";
spi1.rxFifo                = "SPI_FIFO_RX2";
spi1.loopback              = true;

/**
 * Pinmux solution for unlocked pins/peripherals. This ensures that minor changes to the automatic solver in a future
 * version of the tool will not impact the pinmux you originally saw.  These lines can be completely deleted in order to
 * re-solve from scratch.
 */
spi1.spi.$suggestSolution             = "SPIA";
spi1.spi.spi_simoPin.$suggestSolution = "GPIO16";
spi1.spi.spi_somiPin.$suggestSolution = "GPIO17";
spi1.spi.spi_clkPin.$suggestSolution  = "GPIO18";
spi1.spi.spi_stenPin.$suggestSolution = "GPIO19";
