/**
 * These arguments were used when this file was generated. They will be automatically applied on subsequent loads
 * via the GUI or CLI. Run CLI with '--help' for additional information on how to override these arguments.
 * @cliArgs --device "F2838x" --part "F2838x_337bga" --package "337bga" --context "CPU2" 
 * @v2CliArgs --device "TMS320F28388D" --package "337bga" --context "CPU2"
 */