/**
 * These arguments were used when this file was generated. They will be automatically applied on subsequent loads
 * via the GUI or CLI. Run CLI with '--help' for additional information on how to override these arguments.
 * @cliArgs --device "F2838x" --part "F2838x_337bga" --package "337bga" --context "CPU1" 
 * @v2CliArgs --device "TMS320F28388D" --package "337bga" --context "CPU1"
 */
/**
 * Import the modules used in this configuration.
 */
const ipc = scripting.addModule("/driverlib/ipc.js");
/**
 * Write custom configuration values to the imported modules.
 */
ipc.flagHandler31    = "SYNC_FLAG";
ipc.ipcRegisterFlag  = ["IPC_FLAG0","IPC_FLAG31"];
ipc.enableInterrupt0 = true;