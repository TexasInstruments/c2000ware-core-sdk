/**
 * @cliArgs --device "F2838x" --part "F2838x_337bga" --package "337bga" --context "CPU2" 
 */
/**
 * Import the modules used in this configuration.
 */
const ipc = scripting.addModule("/driverlib/ipc.js");
/**
 * Write custom configuration values to the imported modules.
 */
ipc.flagHandler31            = "SYNC_FLAG";
ipc.registerInterrupts       = ["0"];
ipc.ipcRegisterFlag          = ["IPC_FLAG31"];
ipc.ipcInt0.interruptHandler = "IPC_ISR0";
ipc.ipcInt0.enableInterrupt  = true;
