/**
 * @cliArgs --device "F2838x" --package "176pin" --part "F2838x_176pin" --context "CPU2" --product "C2000WARE@4.02.00.00"
 * @versions {"tool":"1.13.0+2553"}
 */

/**
 * Import the modules used in this configuration.
 */
const ipc = scripting.addModule("/driverlib/ipc.js");

/**
 * Write custom configuration values to the imported modules.
 */
ipc.ipcRegisterFlag          = ["IPC_FLAG31"];
ipc.flagHandler31            = "SYNC_FLAG";
ipc.registerInterrupts       = ["1"];
ipc.ipcInt1.enableInterrupt  = true;
ipc.ipcInt1.interruptHandler = "IPC_ISR1";
