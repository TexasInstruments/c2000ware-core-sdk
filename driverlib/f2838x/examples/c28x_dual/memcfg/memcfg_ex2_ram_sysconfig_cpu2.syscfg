/**
 * @cliArgs --device "F2838x" --package "337bga" --part "F2838x_337bga" --context "CPU2" --product "C2000WARE@4.03.00.00"
 * @versions {"tool":"1.15.999+71"}
 */

/**
 * Import the modules used in this configuration.
 */
const cputimer  = scripting.addModule("/driverlib/cputimer.js", {}, false);
const cputimer1 = cputimer.addInstance();
const ipc       = scripting.addModule("/driverlib/ipc.js");
const CMD       = scripting.addModule("/utilities/cmd_tool/cmd_syscfg/source/CMD");
const CMD1      = CMD.addInstance();

/**
 * Write custom configuration values to the imported modules.
 */
cputimer1.$name       = "myCPUTIMER0";
cputimer1.timerPeriod = 4294967295;

CMD.activateCMD = true;

CMD1.$name                               = "CMD0";
CMD1.sectionMemory_text                  = ["FLASH1","FLASH2","FLASH3","FLASH4"];
CMD1.sectionAlignEnable_text             = true;
CMD1.sectionMemory_ramfunc               = ["FLASH3"];
CMD1.sectionRunFromDifferentAddr_ramfunc = true;
CMD1.sectionRun_ramfunc                  = ["RAMLS0"];
CMD1.sectionAlignEnable_ramfunc          = true;
CMD1.sectionMemory_ovly                  = ["FLASH1"];
CMD1.sectionAlignEnable_ovly             = true;
CMD1.sectionMemory_cinit                 = ["FLASH4"];
CMD1.sectionAlignEnable_cinit            = true;
CMD1.sectionMemory_stack                 = ["RAMM1"];
CMD1.sectionMemory_init_array            = ["FLASH1"];
CMD1.sectionAlignEnable_init_array       = true;
CMD1.sectionMemory_bss                   = ["RAMLS5"];
CMD1.sectionMemory_const                 = ["FLASH5"];
CMD1.sectionAlignEnable_const            = true;
CMD1.sectionMemory_data                  = ["RAMLS5"];
CMD1.sectionMemory_switch                = ["FLASH1"];
CMD1.sectionAlignEnable_switch           = true;
CMD1.sectionMemory_sysmem                = ["RAMLS5"];
CMD1.sectionMemory_binit                 = ["FLASH0"];
CMD1.sectionAlignEnable_binit            = true;
CMD1.userSection.create(3);
CMD1.userSection[0].$name                = "isrfunc";
CMD1.userSection[0].sectionMemory        = ["RAMGS14"];
CMD1.userSection[0].sectionName          = "isrfunc";
CMD1.userSection[1].$name                = "SHARERAMGS0";
CMD1.userSection[1].sectionName          = "SHARERAMGS0";
CMD1.userSection[1].sectionMemory        = ["RAMGS0"];
CMD1.userSection[2].$name                = "SHARERAMGS1";
CMD1.userSection[2].sectionName          = "SHARERAMGS1";
CMD1.userSection[2].sectionMemory        = ["RAMGS1"];
scripting.suppress("RAMGS1 is not configured to be owned by CPU2 in @@@.+?@@@\\. CPU2 will only have read access to this memory\\.", CMD1.userSection[2], "sectionMemory");
