/**
 * Import the modules used in this configuration.
 */
const adc     = scripting.addModule("/driverlib/adc.js", {}, false);
const adc1    = adc.addInstance();
const asysctl = scripting.addModule("/driverlib/asysctl.js");

/**
 * Write custom configuration values to the imported modules.
 */
adc1.$name               = "myADC0";
adc1.adcClockPrescaler   = "ADC_CLK_DIV_1_0";
adc1.enabledSOCs         = ["ADC_SOC_NUMBER0","ADC_SOC_NUMBER1"];
adc1.soc1Channel         = "ADC_CH_ADCIN4";
adc1.soc0SampleWindow    = 4;
adc1.soc1SampleWindow    = 4;
adc1.enabledInts         = ["ADC_INT_NUMBER1"];
adc1.interruptPulseMode  = "ADC_PULSE_END_OF_CONV";
adc1.enableInterrupt1    = true;
adc1.interrupt1SOCSource = "ADC_INT_TRIGGER_EOC1";

asysctl.analogReference        = "INTERNAL";
asysctl.analogReferenceVoltage = "1P65";
