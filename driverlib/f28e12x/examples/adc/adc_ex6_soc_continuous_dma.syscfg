/**
 * Import the modules used in this configuration.
 */
const adc     = scripting.addModule("/driverlib/adc.js", {}, false);
const adc1    = adc.addInstance();
const asysctl = scripting.addModule("/driverlib/asysctl.js");
/**
 * Write custom configuration values to the imported modules.
 */
adc1.$name                   = "myADC0";
adc1.registerInterrupts      = ["1"];
adc1.adcClockPrescaler       = "ADC_CLK_DIV_1_0";
adc1.interruptPulseMode      = "ADC_PULSE_END_OF_CONV";
adc1.enabledSOCs             = ["ADC_SOC_NUMBER0","ADC_SOC_NUMBER1","ADC_SOC_NUMBER10","ADC_SOC_NUMBER11","ADC_SOC_NUMBER12","ADC_SOC_NUMBER13","ADC_SOC_NUMBER14","ADC_SOC_NUMBER15","ADC_SOC_NUMBER2","ADC_SOC_NUMBER3","ADC_SOC_NUMBER4","ADC_SOC_NUMBER5","ADC_SOC_NUMBER6","ADC_SOC_NUMBER7","ADC_SOC_NUMBER8","ADC_SOC_NUMBER9"];
adc1.soc0SampleWindow        = 4;
adc1.soc1SampleWindow        = 4;
adc1.soc2SampleWindow        = 4;
adc1.soc3SampleWindow        = 4;
adc1.soc4SampleWindow        = 4;
adc1.soc5SampleWindow        = 4;
adc1.soc6SampleWindow        = 4;
adc1.soc7SampleWindow        = 4;
adc1.soc8SampleWindow        = 4;
adc1.soc9SampleWindow        = 4;
adc1.soc10SampleWindow       = 4;
adc1.soc11SampleWindow       = 4;
adc1.soc12SampleWindow       = 4;
adc1.soc13SampleWindow       = 4;
adc1.soc14SampleWindow       = 4;
adc1.soc15SampleWindow       = 4;
adc1.soc0Channel             = "ADC_CH_ADCIN0";
adc1.soc1Channel             = "ADC_CH_ADCIN0";
adc1.soc2Channel             = "ADC_CH_ADCIN0";
adc1.soc3Channel             = "ADC_CH_ADCIN0";
adc1.soc4Channel             = "ADC_CH_ADCIN0";
adc1.soc5Channel             = "ADC_CH_ADCIN0";
adc1.soc6Channel             = "ADC_CH_ADCIN0";
adc1.soc7Channel             = "ADC_CH_ADCIN0";
adc1.soc8Channel             = "ADC_CH_ADCIN0";
adc1.soc9Channel             = "ADC_CH_ADCIN0";
adc1.soc10Channel            = "ADC_CH_ADCIN0";
adc1.soc11Channel            = "ADC_CH_ADCIN0";
adc1.soc12Channel            = "ADC_CH_ADCIN0";
adc1.soc13Channel            = "ADC_CH_ADCIN0";
adc1.soc14Channel            = "ADC_CH_ADCIN0";
adc1.soc15Channel            = "ADC_CH_ADCIN0";
adc1.soc0Trigger             = "ADC_TRIGGER_MCPWM1_SOCA";
adc1.soc0InterruptTrigger    = "ADC_INT_SOC_TRIGGER_ADCINT1";
adc1.soc1InterruptTrigger    = "ADC_INT_SOC_TRIGGER_ADCINT1";
adc1.soc2InterruptTrigger    = "ADC_INT_SOC_TRIGGER_ADCINT1";
adc1.soc3InterruptTrigger    = "ADC_INT_SOC_TRIGGER_ADCINT1";
adc1.soc4InterruptTrigger    = "ADC_INT_SOC_TRIGGER_ADCINT1";
adc1.soc5InterruptTrigger    = "ADC_INT_SOC_TRIGGER_ADCINT1";
adc1.soc6InterruptTrigger    = "ADC_INT_SOC_TRIGGER_ADCINT1";
adc1.soc7InterruptTrigger    = "ADC_INT_SOC_TRIGGER_ADCINT1";
adc1.soc8InterruptTrigger    = "ADC_INT_SOC_TRIGGER_ADCINT1";
adc1.soc9InterruptTrigger    = "ADC_INT_SOC_TRIGGER_ADCINT1";
adc1.soc10InterruptTrigger   = "ADC_INT_SOC_TRIGGER_ADCINT1";
adc1.soc11InterruptTrigger   = "ADC_INT_SOC_TRIGGER_ADCINT1";
adc1.soc12InterruptTrigger   = "ADC_INT_SOC_TRIGGER_ADCINT1";
adc1.soc13InterruptTrigger   = "ADC_INT_SOC_TRIGGER_ADCINT1";
adc1.soc14InterruptTrigger   = "ADC_INT_SOC_TRIGGER_ADCINT1";
adc1.soc15InterruptTrigger   = "ADC_INT_SOC_TRIGGER_ADCINT1";
adc1.enabledDMAInts             = ["ADC_INT_NUMBER1","ADC_INT_NUMBER2"];
adc1.enableDMAInterrupt1        = true;
adc1.enableDMAInterrupt2        = true;
adc1.enableDMAInterrupt1ContinuousMode = true;
adc1.enableDMAInterrupt2ContinuousMode = true;
adc1.dmaInterrupt1SOCSource     = "ADC_INT_TRIGGER_EOC0";
adc1.dmaInterrupt2SOCSource     = "ADC_INT_TRIGGER_EOC15";

adc1.adcInt1.enableInterrupt = true;
adc1.adcInt1.interruptHandler = "adcA1ISR";

asysctl.analogReference         = "INTERNAL";
asysctl.analogReferenceVoltage  = "1P65";
