/**
 * Import the modules used in this configuration.
 */
const ecap       = scripting.addModule("/driverlib/ecap.js", {}, false);
const ecap1      = ecap.addInstance();
const gpio       = scripting.addModule("/driverlib/gpio.js", {}, false);
const gpio1      = gpio.addInstance();
const inputxbar_input  = scripting.addModule("/driverlib/inputxbar_input.js", {}, false);
const inputxbar_input1 = inputxbar_input.addInstance();

/**
 * Write custom configuration values to the imported modules.
 */
ecap1.$name                  = "myECAP0";
ecap1.enableInterrupt        = true;
ecap1.captureMode            = "ECAP_ONE_SHOT_CAPTURE_MODE";
ecap1.eventStop              = "ECAP_EVENT_4";
ecap1.eventOnePolarity       = "ECAP_EVNT_FALLING_EDGE";
ecap1.eventThreePolarity     = "ECAP_EVNT_FALLING_EDGE";
ecap1.interruptSourceCapture = ["ECAP_ISR_SOURCE_CAPTURE_EVENT_4"];
ecap1.counterResetOnEvent    = ["ECAP_EVENT_1","ECAP_EVENT_2","ECAP_EVENT_3","ECAP_EVENT_4"];
ecap1.enableLoadCounter      = true;
ecap1.reArm                  = true;
ecap1.ecapInput              = "ECAP_INPUT_INPUTXBAR7";
ecap1.registerInterrupts     = true;
ecap1.ecapInt.enableInterrupt = true;

gpio1.$name           = "myGPIO0";
gpio1.qualMode        = "GPIO_QUAL_ASYNC";
gpio1.gpioPin.$assign = "GPIO2";

inputxbar_input1.$name          = "myINPUTXBARINPUT0";
inputxbar_input1.inputxbarInput = "XBAR_INPUT7";
inputxbar_input1.inputxbarGpio  = "GPIO2";
