/**
 * These arguments were used when this file was generated. They will be automatically applied on subsequent loads
 * via the GUI or CLI. Run CLI with '--help' for additional information on how to override these arguments.
 * @cliArgs --device "F28E12x" --part "F28E12x_48PT" --package "48PT" --context "system"
 * @v2CliArgs ---device "F28E120SC" --package "48PT" --context "system"
 */