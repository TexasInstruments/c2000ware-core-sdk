/**
 * @cliArgs --device "F28E12x" --package "48PT" --part "F28E12x_48PT" --context "system" --product "C2000WARE@5.04.00.00"
 * @versions {"tool":"1.21.0+dev"}
 */

/**
 * Import the modules used in this configuration.
 */
const device_support = scripting.addModule("/driverlib/device_support.js");
const sysctl         = scripting.addModule("/driverlib/sysctl.js");
const CMD            = scripting.addModule("/utilities/cmd_tool/cmd_syscfg/source/CMD");
const CMD1           = CMD.addInstance();
const CMD2           = CMD.addInstance();
const cputimer       = scripting.addModule("/driverlib/cputimer.js", {}, false);
const cputimer1      = cputimer.addInstance();
const cputimer2      = cputimer.addInstance();
const cputimer3      = cputimer.addInstance();

/**
 * Write custom configuration values to the imported modules.
 */
CMD1.$name                    = "generic_ram_lnk";
CMD2.$name                    = "generic_flash_lnk";
CMD1.sectionMemory_text       = ["RAMM1","RAMGS0"];
CMD1.sectionMemory_bss        = ["RAMGS0","RAMM1"];
CMD1.sectionMemory_const      = ["RAMM1","RAMGS0","RAMM0"];
CMD1.sectionMemory_data       = ["RAMGS0","RAMM1"];
CMD1.sectionMemory_ramfunc    = ["RAMM0"];
CMD1.sectionMemory_cinit      = ["RAMM0"];
CMD1.sectionMemory_stack      = ["RAMM1"];
CMD1.sectionMemory_init_array = ["RAMM0"];
CMD1.sectionMemory_switch     = ["RAMM0"];
CMD1.sectionMemory_sysmem     = ["RAMGS0"];

CMD2.sectionAlignEnable_ramfunc    = true;
CMD2.sectionAlignEnable_text       = true;
CMD2.sectionAlignEnable_binit      = true;
CMD2.sectionAlignEnable_cinit      = true;
CMD2.sectionAlignEnable_switch     = true;
CMD2.sectionAlignEnable_init_array = true;
CMD2.sectionAlignEnable_const      = true;
CMD2.sectionAlignEnable_ovly       = true;
CMD2.sectionMemory_codestart       = "0x080000";
CMD2.sectionMemory_stack           = ["RAMM0"];
CMD2.sectionMemory_bss             = ["RAMGS0"];
CMD2.sectionMemory_data            = ["RAMGS0"];
CMD2.sectionMemory_sysmem          = ["RAMGS0"];
CMD2.sectionMemory_ramfunc         = ["FLASH_BANK0_SEC_0_63"];
CMD2.sectionMemory_text            = ["FLASH_BANK0_SEC_0_63"];
CMD2.sectionMemory_binit           = ["FLASH_BANK0_SEC_0_63"];
CMD2.sectionMemory_cinit           = ["FLASH_BANK0_SEC_0_63"];
CMD2.sectionMemory_switch          = ["FLASH_BANK0_SEC_0_63"];
CMD2.sectionMemory_init_array      = ["FLASH_BANK0_SEC_0_63"];
CMD2.sectionMemory_const           = ["FLASH_BANK0_SEC_0_63"];
CMD2.sectionMemory_ovly            = ["FLASH_BANK0_SEC_0_63"];
CMD2.sectionRunFromDifferentAddr_ramfunc = true;
CMD2.sectionRun_ramfunc                  = ["RAMGS0"];
CMD2.sectionBinit_ramfunc                = false;

cputimer1.registerInterrupts        = true;
cputimer1.enableInterrupt           = true;
cputimer1.$name                     = "CPUTIMER0_BASE";
cputimer1.startTimer                = true;
cputimer1.timerInt.$name            = "INT_TIMER0";
cputimer1.timerInt.interruptHandler = "cpuTimer0ISR";
cputimer1.timerInt.enableInterrupt  = true;

cputimer2.registerInterrupts        = true;
cputimer2.enableInterrupt           = true;
cputimer2.$name                     = "CPUTIMER1_BASE";
cputimer2.cputimerBase              = "CPUTIMER1_BASE";
cputimer2.startTimer                = true;
cputimer2.timerInt.$name            = "INT_TIMER1";
cputimer2.timerInt.interruptHandler = "cpuTimer1ISR";
cputimer2.timerInt.enableInterrupt  = true;

cputimer3.cputimerBase              = "CPUTIMER2_BASE";
cputimer3.registerInterrupts        = true;
cputimer3.enableInterrupt           = true;
cputimer3.$name                     = "CPUTIMER2_BASE";
cputimer3.startTimer                = true;
cputimer3.timerInt.$name            = "INT_TIMER2";
cputimer3.timerInt.interruptHandler = "cpuTimer2ISR";
cputimer3.timerInt.enableInterrupt  = true;

cputimer1.timerPeriod               = 160000000;
cputimer2.timerPeriod               = 320000000;
cputimer3.timerPeriod               = 480000000;
