/**
 * These arguments were used when this file was generated. They will be automatically applied on subsequent loads
 * via the GUI or CLI. Run CLI with '--help' for additional information on how to override these arguments.
 * @cliArgs --device "F28E12x" --part "F28E12x_48PT" --package "48PT" --context "system"
 * @v2CliArgs ---device "F28E120SC" --package "48PT" --context "system"
 */
/**
 * Import the modules used in this configuration.
 */
const device_support = scripting.addModule("/driverlib/device_support.js");
/**
 * Write custom configuration values to the imported modules.
 */
const divider2       = system.clockTree["PLL_PDIV"];
divider2.divideValue = 2;
const multiplier1         = system.clockTree["PLL_QDIV"];
multiplier1.multiplyValue = 32;
const mux1       = system.clockTree["OSCCLKSRCSEL"];
mux1.inputSelect = "X1_XTAL";