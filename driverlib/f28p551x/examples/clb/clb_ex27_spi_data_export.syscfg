/**
 * Import the modules used in this configuration.
 */
const clb   = scripting.addModule("/driverlib/clb.js", {}, false);
const clb1  = clb.addInstance();
const spi   = scripting.addModule("/driverlib/spi.js", {}, false);
const spi1  = spi.addInstance();
const TILE  = scripting.addModule("/utilities/clb_tool/clb_syscfg/source/TILE", {}, false);
const TILE1 = TILE.addInstance();

/**
 * Write custom configuration values to the imported modules.
 */
clb1.spiBufferAccess            = true;
clb1.spiBufferLoadTriggerSignal = 3;
clb1.$name                      = "myCLBForTILE1";

spi1.$name                 = "mySPIForTILE1";
spi1.emulationMode         = "SPI_EMULATION_STOP_AFTER_TRANSMIT";
spi1.enabledFIFOInterrupts = ["SPI_INT_RXFF","SPI_INT_RXFF_OVERFLOW"];
spi1.rxFifo                = "SPI_FIFO_RX8";
spi1.bitRate               = 1000000;
spi1.spi.$name             = "MySPI1";
spi1.spi.$assign           = "SPIA";

TILE1.$name                  = "TILE1";
TILE1.BOUNDARY.$name         = "BOUNDARY0";
TILE1.LUT_0.$name            = "LUT_0";
TILE1.LUT_1.$name            = "LUT_1";
TILE1.LUT_2.$name            = "LUT_2";
TILE1.FSM_0.$name            = "FSM_0";
TILE1.FSM_1.$name            = "FSM_1";
TILE1.FSM_2.$name            = "FSM_2";
TILE1.COUNTER_0.$name        = "COUNTER_0";
TILE1.COUNTER_0.mode0        = "1";
TILE1.COUNTER_0.mode1        = "1";
TILE1.COUNTER_0.reset        = "COUNTER_0.count_match1";
TILE1.COUNTER_0.match1_val   = "125000";
TILE1.COUNTER_1.$name        = "COUNTER_1";
TILE1.COUNTER_2.$name        = "COUNTER_2";
TILE1.OUTLUT_0.$name         = "OUTLUT_0";
TILE1.OUTLUT_1.$name         = "OUTLUT_1";
TILE1.OUTLUT_2.$name         = "OUTLUT_2";
TILE1.OUTLUT_3.$name         = "OUTLUT_3";
TILE1.OUTLUT_4.$name         = "OUTLUT_4";
TILE1.OUTLUT_5.$name         = "OUTLUT_5";
TILE1.OUTLUT_6.$name         = "OUTLUT_6";
TILE1.OUTLUT_7.$name         = "OUTLUT_7";
TILE1.HLC.$name              = "HLC_0";
TILE1.HLC.e0                 = "COUNTER_0.count_match1";
TILE1.HLC.R1_init            = "5";
TILE1.HLC.program0.$name     = "HLCP_0";
TILE1.HLC.program0.instruct0 = "ADD R1, R0";
TILE1.HLC.program1.$name     = "HLCP_1";
TILE1.HLC.program2.$name     = "HLCP_2";
TILE1.HLC.program3.$name     = "HLCP_3";
TILE1.AOC_0.$name            = "AOC_0";
TILE1.AOC_1.$name            = "AOC_1";
TILE1.AOC_2.$name            = "AOC_2";
TILE1.AOC_3.$name            = "AOC_3";
TILE1.AOC_4.$name            = "AOC_4";
TILE1.AOC_5.$name            = "AOC_5";
TILE1.AOC_6.$name            = "AOC_6";
TILE1.AOC_7.$name            = "AOC_7";
