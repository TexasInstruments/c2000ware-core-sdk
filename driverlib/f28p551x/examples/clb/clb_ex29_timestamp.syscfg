/**
 * Import the modules used in this configuration.
 */
const clb        = scripting.addModule("/driverlib/clb.js", {}, false);
const clb1       = clb.addInstance();
const clbxbar    = scripting.addModule("/driverlib/clbxbar.js", {}, false);
const clbxbar1   = clbxbar.addInstance();
const clbxbar2   = clbxbar.addInstance();
const epwm       = scripting.addModule("/driverlib/epwm.js", {}, false);
const epwm1      = epwm.addInstance();
const gpio       = scripting.addModule("/driverlib/gpio.js", {}, false);
const gpio1      = gpio.addInstance();
const gpio2      = gpio.addInstance();
const gpio3      = gpio.addInstance();
const inputxbar  = scripting.addModule("/driverlib/inputxbar.js", {}, false);
const inputxbar1 = inputxbar.addInstance();
const TILE       = scripting.addModule("/utilities/clb_tool/clb_syscfg/source/TILE", {}, false);
const TILE1      = TILE.addInstance();

/**
 * Write custom configuration values to the imported modules.
 */
clb1.$name               = "myTILE1";
clb1.localConfigCLB_IN0  = "CLB_LOCAL_IN_MUX_EPWM_OST";
clb1.localConfigCLB_IN1  = "CLB_LOCAL_IN_MUX_EPWM_OST";
clb1.filterConfigCLB_IN0 = "CLB_FILTER_RISING_EDGE";
clb1.filterConfigCLB_IN1 = "CLB_FILTER_RISING_EDGE";
clb1.synchronizeCLB_IN0  = true;
clb1.synchronizeCLB_IN1  = true;
clb1.enableCLB           = true;
clb1.inputTypeCLB_IN0    = "GLOBAL";
clb1.globalConfigCLB_IN0 = "CLB_GLOBAL_IN_MUX_CLB_AUXSIG0";
clb1.inputTypeCLB_IN1    = "GLOBAL";
clb1.globalConfigCLB_IN1 = "CLB_GLOBAL_IN_MUX_CLB_AUXSIG1";
clb1.inputsUsed          = ["CLB_IN0","CLB_IN1","CLB_IN7"];
clb1.filterConfigCLB_IN7 = "CLB_FILTER_RISING_EDGE";

clbxbar1.$name      = "myCLBXBAR0";
clbxbar1.muxesUsed  = ["XBAR_MUX01"];
clbxbar1.mux1Config = "XBAR_CLB_MUX01_INPUTXBAR1_INPUT1";

clbxbar2.$name      = "myCLBXBAR1";
clbxbar2.auxInput   = "XBAR_AUXSIG1";
clbxbar2.muxesUsed  = ["XBAR_MUX03"];
clbxbar2.mux3Config = "XBAR_CLB_MUX03_INPUTXBAR1_INPUT2";

epwm1.$name                  = "myEPWM1";
epwm1.useCase                = "CUSTOM";
epwm1.useInterfacePins       = ["EPWM#_A"];
epwm1.epwm.$assign           = "EPWM1";
epwm1.epwm.epwm_aPin.$assign = "GPIO0";

gpio1.$name           = "myGPIO11";
gpio1.direction       = "GPIO_DIR_MODE_OUT";
gpio1.padConfig       = "PULLUP";
gpio1.qualMode        = "GPIO_QUAL_ASYNC";
gpio1.gpioPin.$assign = "A24, D0, E0, GPIO11";

gpio2.$name           = "myGPIO12";
gpio2.padConfig       = "PULLUP";
gpio2.qualMode        = "GPIO_QUAL_ASYNC";
gpio2.gpioPin.$assign = "A20, B20, C20, GPIO12";

gpio3.$name           = "myGPIO13";
gpio3.qualMode        = "GPIO_QUAL_ASYNC";
gpio3.padConfig       = "PULLUP";
gpio3.gpioPin.$assign = "A19, B19, C19, GPIO13";

inputxbar1.$name          = "myINPUTXBAR1";
inputxbar1.inputxbar1Gpio = "GPIO12";
inputxbar1.inputxbar2Gpio = "GPIO13";
inputxbar1.inputxbar3Gpio = "GPIO14";
inputxbar1.inputxbar1Lock = true;
inputxbar1.inputxbar2Lock = true;
inputxbar1.inputxbar3Lock = true;
inputxbar1.inputsUsed     = ["inputxbar1Gpio","inputxbar2Gpio"];

TILE1.$name                  = "TILE1";
TILE1.BOUNDARY.$name         = "BOUNDARY0";
TILE1.LUT_0.$name            = "LUT_0";
TILE1.LUT_1.$name            = "LUT_1";
TILE1.LUT_2.$name            = "LUT_2";
TILE1.LUT_2.i0               = "COUNTER_0.count_match1";
TILE1.LUT_2.i1               = "COUNTER_1.count_match1";
TILE1.LUT_2.eqn              = "i0 | i1";
TILE1.FSM_0.$name            = "FSM_0";
TILE1.FSM_0.e0               = "BOUNDARY.in0";
TILE1.FSM_0.eqn_out          = "(!s0 & !s1 & e1) | (s0 & !s1 & !e0)";
TILE1.FSM_0.eqn_s0           = "(s0 & !e0) | (s0 & s1) | (!s0 & !s1 & e1)";
TILE1.FSM_0.eqn_s1           = "s1 | (s0 & e0)";
TILE1.FSM_0.e1               = "BOUNDARY.in7";
TILE1.FSM_1.$name            = "FSM_1";
TILE1.FSM_1.e0               = "BOUNDARY.in1";
TILE1.FSM_1.e1               = "BOUNDARY.in7";
TILE1.FSM_1.eqn_out          = "(!s0 & !s1 & e1) | (s0 & !s1 & !e0)";
TILE1.FSM_1.eqn_s0           = "(s0 & !e0) | (s0 & s1) | (!s0 & !s1 & e1)";
TILE1.FSM_1.eqn_s1           = "s1 | (s0 & e0)";
TILE1.FSM_2.$name            = "FSM_2";
TILE1.COUNTER_0.$name        = "COUNTER_0";
TILE1.COUNTER_0.mode1        = "1";
TILE1.COUNTER_0.reset        = "COUNTER_0.count_match1";
TILE1.COUNTER_0.match1_val   = "2147483647";
TILE1.COUNTER_0.action       = "Load";
TILE1.COUNTER_0.mode0        = "FSM_0.OUT";
TILE1.COUNTER_1.$name        = "COUNTER_1";
TILE1.COUNTER_1.mode1        = "1";
TILE1.COUNTER_1.match1_val   = "2147483647";
TILE1.COUNTER_1.reset        = "COUNTER_1.count_match1";
TILE1.COUNTER_1.action       = "Load";
TILE1.COUNTER_1.mode0        = "FSM_1.OUT";
TILE1.COUNTER_2.$name        = "COUNTER_2";
TILE1.COUNTER_2.reset        = "COUNTER_2.count_match1";
TILE1.COUNTER_2.event        = "1";
TILE1.COUNTER_2.mode1        = "1";
TILE1.COUNTER_2.action       = "Add";
TILE1.COUNTER_2.match1_val   = "2147483647";
TILE1.COUNTER_2.mode0        = "LUT_2.OUT";
TILE1.OUTLUT_0.$name         = "OUTLUT_0";
TILE1.OUTLUT_1.$name         = "OUTLUT_1";
TILE1.OUTLUT_2.$name         = "OUTLUT_2";
TILE1.OUTLUT_3.$name         = "OUTLUT_3";
TILE1.OUTLUT_4.$name         = "OUTLUT_4";
TILE1.OUTLUT_5.$name         = "OUTLUT_5";
TILE1.OUTLUT_6.$name         = "OUTLUT_6";
TILE1.OUTLUT_7.$name         = "OUTLUT_7";
TILE1.HLC.$name              = "HLC_0";
TILE1.HLC.e0                 = "BOUNDARY.in0";
TILE1.HLC.e1                 = "BOUNDARY.in1";
TILE1.HLC.program0.$name     = "HLCP_0";
TILE1.HLC.program0.instruct0 = "MOV C0, R0";
TILE1.HLC.program0.instruct2 = "INTR 12";
TILE1.HLC.program0.instruct1 = "MOV C2, R2";
TILE1.HLC.program1.$name     = "HLCP_1";
TILE1.HLC.program1.instruct0 = "MOV C1, R1";
TILE1.HLC.program1.instruct2 = "INTR 13";
TILE1.HLC.program1.instruct1 = "MOV C2, R3";
TILE1.HLC.program2.$name     = "HLCP_2";
TILE1.HLC.program3.$name     = "HLCP_3";
TILE1.AOC_0.$name            = "AOC_0";
TILE1.AOC_1.$name            = "AOC_1";
TILE1.AOC_2.$name            = "AOC_2";
TILE1.AOC_3.$name            = "AOC_3";
TILE1.AOC_4.$name            = "AOC_4";
TILE1.AOC_5.$name            = "AOC_5";
TILE1.AOC_6.$name            = "AOC_6";
TILE1.AOC_7.$name            = "AOC_7";
