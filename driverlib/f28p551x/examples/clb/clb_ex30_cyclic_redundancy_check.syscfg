/**
 * Import the modules used in this configuration.
 */
const clb                              = scripting.addModule("/driverlib/clb.js", {}, false);
const clb1                             = clb.addInstance();
const TILE                             = scripting.addModule("/utilities/clb_tool/clb_syscfg/source/TILE");
const TILE1                            = TILE.addInstance();
const clb_run_dynamic_template_clb_c   = scripting.addModule("/utilities/clb_tool/clb_syscfg/source/clb_run_dynamic_template_clb_c.js");
const clb_run_dynamic_template_clb_dot = scripting.addModule("/utilities/clb_tool/clb_syscfg/source/clb_run_dynamic_template_clb_dot.js");
const clb_run_dynamic_template_clb_h   = scripting.addModule("/utilities/clb_tool/clb_syscfg/source/clb_run_dynamic_template_clb_h.js");
const clb_run_dynamic_template_clb_sim = scripting.addModule("/utilities/clb_tool/clb_syscfg/source/clb_run_dynamic_template_clb_sim.js");

/**
 * Write custom configuration values to the imported modules.
 */
clb1.$name      = "myTILE1";
clb1.inputsUsed = ["CLB_IN0","CLB_IN2"];

TILE.clock_period   = 10000;
TILE.sim_duration   = 3000000;
TILE.reset_duration = 10000;

TILE1.$name                     = "TILE1";
TILE1.BOUNDARY.$name            = "BOUNDARY0";
TILE1.BOUNDARY.in_repeat_count5 = 1;
TILE1.BOUNDARY.in_repeat_count0 = 1;
TILE1.BOUNDARY.in_period2       = 80;
TILE1.BOUNDARY.in_repeat_count2 = 1;
TILE1.BOUNDARY.in_duty2         = 60;
TILE1.BOUNDARY.in_duty5         = 8;
TILE1.BOUNDARY.in_period0       = 15;
TILE1.BOUNDARY.in_duty0         = 12;
TILE1.LUT_0.$name               = "LUT_0";
TILE1.LUT_1.$name               = "LUT_1";
TILE1.LUT_1.i0                  = "COUNTER_2.count_match1";
TILE1.LUT_1.i1                  = "BOUNDARY.in2";
TILE1.LUT_1.eqn                 = "~i0 & i1";
TILE1.LUT_2.$name               = "LUT_2";
TILE1.FSM_0.$name               = "FSM_0";
TILE1.FSM_1.$name               = "FSM_1";
TILE1.FSM_2.$name               = "FSM_2";
TILE1.COUNTER_0.$name           = "COUNTER_0";
TILE1.COUNTER_0.action          = "Add";
TILE1.COUNTER_0.serializer_en   = true;
TILE1.COUNTER_0.lfsr_en         = true;
TILE1.COUNTER_0.mode0           = "LUT_1.OUT";
TILE1.COUNTER_0.event           = "COUNTER_1.count_match1";
TILE1.COUNTER_0.reset           = "BOUNDARY.in0";
TILE1.COUNTER_0.match2_val      = "0b1000011";
TILE1.COUNTER_0.match1_val      = "5";
TILE1.COUNTER_0.mode1           = "1";
TILE1.COUNTER_1.$name           = "COUNTER_1";
TILE1.COUNTER_1.match2_val      = "";
TILE1.COUNTER_1.match1_val      = "";
TILE1.COUNTER_1.serializer_en   = true;
TILE1.COUNTER_1.match1_tap_en   = true;
TILE1.COUNTER_1.mode0           = "LUT_1.OUT";
TILE1.COUNTER_1.mode1           = "1";
TILE1.COUNTER_1.event_load_val  = "";
TILE1.COUNTER_1.match1_tap_sel  = 6;
TILE1.COUNTER_2.$name           = "COUNTER_2";
TILE1.COUNTER_2.match2_val      = "";
TILE1.COUNTER_2.event_load_val  = "";
TILE1.COUNTER_2.mode0           = "LUT_1.OUT";
TILE1.COUNTER_2.mode1           = "1";
TILE1.COUNTER_2.reset           = "BOUNDARY.in0";
TILE1.COUNTER_2.match1_val      = "13";
TILE1.OUTLUT_0.$name            = "OUTLUT_0";
TILE1.OUTLUT_1.$name            = "OUTLUT_1";
TILE1.OUTLUT_2.$name            = "OUTLUT_2";
TILE1.OUTLUT_3.$name            = "OUTLUT_3";
TILE1.OUTLUT_4.$name            = "OUTLUT_4";
TILE1.OUTLUT_5.$name            = "OUTLUT_5";
TILE1.OUTLUT_6.$name            = "OUTLUT_6";
TILE1.OUTLUT_7.$name            = "OUTLUT_7";
TILE1.HLC.$name                 = "HLC_0";
TILE1.HLC.e0                    = "COUNTER_2.count_match1";
TILE1.HLC.program0.$name        = "HLCP_0";
TILE1.HLC.program0.instruct0    = "INTR 1";
TILE1.HLC.program1.$name        = "HLCP_1";
TILE1.HLC.program2.$name        = "HLCP_2";
TILE1.HLC.program3.$name        = "HLCP_3";
TILE1.AOC_0.$name               = "AOC_0";
TILE1.AOC_1.$name               = "AOC_1";
TILE1.AOC_2.$name               = "AOC_2";
TILE1.AOC_3.$name               = "AOC_3";
TILE1.AOC_4.$name               = "AOC_4";
TILE1.AOC_5.$name               = "AOC_5";
TILE1.AOC_6.$name               = "AOC_6";
TILE1.AOC_7.$name               = "AOC_7";
