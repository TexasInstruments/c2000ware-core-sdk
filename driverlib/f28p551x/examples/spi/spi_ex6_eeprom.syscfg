/**
 * @cliArgs --device "F28P551x" --part "F28P551x_100PZ" --package "100PZ" --context "system"
 */
/**
 * Import the modules used in this configuration.
 */
const gpio  = scripting.addModule("/driverlib/gpio.js", {}, false);
const gpio1 = gpio.addInstance();
const spi   = scripting.addModule("/driverlib/spi.js", {}, false);
const spi1  = spi.addInstance();
/**
 * Write custom configuration values to the imported modules.
 */
gpio1.$name           = "SPI_CS_GPIO";
gpio1.direction       = "GPIO_DIR_MODE_OUT";
spi1.$name                   = "mySPI0";
spi1.useCase                 = "CUSTOM";
spi1.transferProtocol        = "SPI_PROT_POL0PHA1";
spi1.mode                    = "SPI_MODE_CONTROLLER";
spi1.bitRate                 = 1000000;
spi1.dataWidth               = "8";
spi1.useInterrupts           = false;
spi1.useFifo                 = false;
spi1.spi.$assign             = "SPIA";
