/**
 * @cliArgs --device "F28P55x" --part "F28P55x_128PDT" --package "128PDT" --context "system" 
 */
/**
 * Import the modules used in this configuration.
 */
const cmpss       = scripting.addModule("/driverlib/cmpss.js", {}, false);
const cmpss1      = cmpss.addInstance();
const outputxbar  = scripting.addModule("/driverlib/outputxbar.js", {}, false);
const outputxbar1 = outputxbar.addInstance();
/**
 * Write custom configuration values to the imported modules.
 */
cmpss1.$name        = "myCMPSS0";
cmpss1.enableModule = true;
cmpss1.dacValHigh   = 2048;
outputxbar1.$name                            = "myOUTPUTXBAR0";
outputxbar1.muxesUsed                        = ["XBAR_MUX00"];
outputxbar1.outputxbar.$assign               = "OUTPUTXBAR3";
outputxbar1.outputxbar.outputxbarPin.$assign = "GPIO14";
