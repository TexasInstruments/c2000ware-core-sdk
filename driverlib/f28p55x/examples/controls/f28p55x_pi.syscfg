/**
 * @cliArgs --device "F28P55x" --package "100PZ" --part "F28P55x_100PZ" --context "system" --product "C2000WARE@5.02.00.00"
 * @versions {"tool":"1.20.0+3514"}
 */

/**
 * Import the modules used in this configuration.
 */
const cputimer       = scripting.addModule("/driverlib/cputimer.js", {}, false);
const cputimer1      = cputimer.addInstance();
const device_support = scripting.addModule("/driverlib/device_support.js");
const sysctl         = scripting.addModule("/driverlib/sysctl.js");
const controller     = scripting.addModule("/libraries/control/dcl/controller.js", {}, false);
const controller1    = controller.addInstance();
const logger         = scripting.addModule("/libraries/control/dcl/logger.js", {}, false);
const logger1        = logger.addInstance();
const logger2        = logger.addInstance();
const logger3        = logger.addInstance();
const logger4        = logger.addInstance();
const CMD            = scripting.addModule("/utilities/cmd_tool/cmd_syscfg/source/CMD");
const CMD1           = CMD.addInstance();
const CMD2           = CMD.addInstance();

/**
 * Write custom configuration values to the imported modules.
 */
cputimer1.$name                     = "myCPUTIMER0";
cputimer1.enableInterrupt           = true;
cputimer1.startTimer                = true;
cputimer1.timerPeriod               = 10;
cputimer1.registerInterrupts        = true;
cputimer1.emulationMode             = "CPUTIMER_EMULATIONMODE_STOPATZERO";
cputimer1.timerInt.$name            = "control_Isr";
cputimer1.timerInt.interruptHandler = "control_Isr";
cputimer1.timerInt.enableInterrupt  = true;

controller1.controllerChoice = "PI";
controller1.$name            = "myController0";
controller1.Kp               = "2.5f";
controller1.Ki               = "0.01f";
controller1.Umax             = "2.0f";
controller1.Umin             = "-2.0f";

logger1.$name     = "rkLog";
logger1.arrEn     = false;
logger1.linkerVal = "LoggerDataSection";
logger1.logSize   = 800;

logger2.arrEn     = false;
logger2.$name     = "ykLog";
logger2.linkerVal = "LoggerDataSection";
logger2.logSize   = 800;

logger3.arrEn     = false;
logger3.$name     = "ctlLog";
logger3.linkerVal = "LoggerDataSection";
logger3.logSize   = 800;

logger4.$name     = "outLog";
logger4.fillEn    = true;
logger4.linkerEn  = true;
logger4.linkerVal = "LoggerDataSection";
logger4.logSize   = 800;

CMD1.$name                        = "generic_ram_lnk";
CMD1.sectionMemory_const          = ["RAMLS5","RAMLS6"];
CMD1.sectionMemory_ramfunc        = ["RAMM0"];
CMD1.sectionMemory_init_array     = ["RAMM0"];
CMD1.sectionMemory_switch         = ["RAMM0"];
CMD1.sectionMemory_sysmem         = ["RAMLS4"];
CMD1.sectionMemory_stack          = ["RAMLS0"];
CMD1.sectionMemory_bss            = ["RAMGS1","RAMLS3","RAMLS4","RAMLS5"];
CMD1.sectionMemory_data           = ["RAMGS2","RAMLS5","RAMLS6","RAMLS7","RAMLS8"];
CMD1.sectionMemory_cinit          = ["RAMGS1"];
CMD1.sectionMemory_text           = ["RAMLS0","RAMLS1","RAMLS2","RAMLS3","RAMLS4","RAMLS5","RAMLS6","RAMLS7","RAMLS8","RAMLS9"];
CMD1.userSection.create(2);
CMD1.userSection[0].$name         = "LoggerDataSection";
CMD1.userSection[0].sectionMemory = ["RAMGS3"];
CMD1.userSection[1].sectionMemory = ["RAMM0"];
CMD1.userSection[1].$name         = "dclfuncs";

CMD2.$name                         = "generic_flash_lnk";
CMD2.sectionAlignEnable_ramfunc          = true;
CMD2.sectionAlignEnable_text             = true;
CMD2.sectionAlignEnable_binit            = true;
CMD2.sectionAlignEnable_cinit            = true;
CMD2.sectionAlignEnable_switch           = true;
CMD2.sectionAlignEnable_init_array       = true;
CMD2.sectionAlignEnable_const            = true;
CMD2.sectionAlignEnable_ovly             = true;
CMD2.sectionMemory_codestart             = "0x080000";
CMD2.sectionMemory_stack                 = ["RAMM1"];
CMD2.sectionMemory_bss                   = ["RAMLS5"];
CMD2.sectionMemory_data                  = ["RAMLS5"];
CMD2.sectionMemory_sysmem                = ["RAMLS4"];
CMD2.sectionMemory_ramfunc               = ["FLASH_BANK0"];
CMD2.sectionMemory_text                  = ["FLASH_BANK0","FLASH_BANK1"];
CMD2.sectionMemory_binit                 = ["FLASH_BANK0"];
CMD2.sectionMemory_cinit                 = ["FLASH_BANK0"];
CMD2.sectionMemory_switch                = ["FLASH_BANK0"];
CMD2.sectionMemory_init_array            = ["FLASH_BANK0"];
CMD2.sectionMemory_const                 = ["FLASH_BANK0"];
CMD2.sectionMemory_ovly                  = ["FLASH_BANK0"];
CMD2.sectionRunFromDifferentAddr_ramfunc = true;
CMD2.sectionRun_ramfunc                  = ["RAMLS0"];
CMD2.sectionBinit_ramfunc                = false;
