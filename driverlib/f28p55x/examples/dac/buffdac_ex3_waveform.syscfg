/**
 * @cliArgs --device "F28P55x" --part "F28P55x_128PDT" --package "128PDT" --context "system" 
 */
/**
 * Import the modules used in this configuration.
 */
const dac  = scripting.addModule("/driverlib/dac.js", {}, false);
const dac1 = dac.addInstance();
const asysctl = scripting.addModule("/driverlib/asysctl.js");
/**
 * Write custom configuration values to the imported modules.
 */
dac1.$name        = "myDAC0";
dac1.enableOutput = true;
dac1.referenceVoltage = "DAC_REF_ADC_VREFHI";
dac1.gainMode         = "DAC_GAIN_TWO";
asysctl.analogReference        = "INTERNAL";
asysctl.analogReferenceVoltage = "1P65";
