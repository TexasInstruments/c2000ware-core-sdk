/**
 * Import the modules used in this configuration.
 */
const mcan  = scripting.addModule("/driverlib/mcan.js", {}, false);
const mcan1 = mcan.addInstance();

/**
 * Write custom configuration values to the imported modules.
 */
mcan1.$name                     = "myMCAN0";
mcan1.enableInterrupt           = true;
mcan1.interruptFlags            = ["MCAN_INTR_MASK_ALL"];
mcan1.interruptLine             = ["MCAN_INTR_LINE_NUM_1"];
mcan1.interruptLine1Flag        = ["MCAN_INTR_MASK_ALL"];
mcan1.registerInterruptLine1    = true;
mcan1.registerInterruptLine0    = true;
mcan1.additionalCoreConfig      = true;
mcan1.stdFiltsUsed              = [0];
mcan1.nomTimeSeg1               = 2;
mcan1.nomTimeSeg2               = 0;
mcan1.nomSynchJumpWidth         = 0;
mcan1.nomRatePrescalar          = 11;
mcan1.dataRatePrescalar         = 1;
mcan1.dataTimeSeg1              = 10;
mcan1.dataTimeSeg2              = 2;
mcan1.dataSynchJumpWidth        = 2;
mcan1.msgRamConfig              = true;
mcan1.mcanInt1.interruptHandler = "MCANIntr1ISR";
mcan1.mcanInt1.enableInterrupt  = true;
mcan1.mcanInt0.interruptHandler = "MCANIntr0ISR";
mcan1.mcanInt0.enableInterrupt  = true;
mcan1.stdFilt0.$name            = "stdFilt0";
mcan1.stdFilt0.sfec             = "MCAN_STDFILTEC_RXBUFF";
mcan1.stdFilt0.sfid1            = 4;
mcan1.mcan.$assign              = "MCANA";
/**
 * Pinmux solution for unlocked pins/peripherals. This ensures that minor changes to the automatic solver in a future
 * version of the tool will not impact the pinmux you originally saw.  These lines can be completely deleted in order to
 * re-solve from scratch.
 */
mcan1.mcan.mcan_rxPin.$suggestSolution = "A10, B1, C10, GPIO230";
mcan1.mcan.mcan_txPin.$suggestSolution = "A17, B17, C17, GPIO20";
