/**
 * @cliArgs --device "F28P65x" --package "256ZEJ" --part "F28P65x_256ZEJ" --context "CPU1" --product "C2000WARE@5.02.00.00"
 * @versions {"tool":"1.19.0+3288"}
 */

/**
 * Import the modules used in this configuration.
 */
const adc     = scripting.addModule("/driverlib/adc.js", {}, false);
const adc1    = adc.addInstance();
const asysctl = scripting.addModule("/driverlib/asysctl.js");

/**
 * Write custom configuration values to the imported modules.
 */
adc1.$name               = "myADC0";
adc1.adcClockPrescaler   = "ADC_CLK_DIV_4_0";
adc1.enabledSOCs         = ["ADC_SOC_NUMBER0","ADC_SOC_NUMBER1"];
adc1.soc1Channel         = "ADC_CH_ADCIN1";
adc1.soc0SampleWindow    = 15;
adc1.soc1SampleWindow    = 15;
adc1.interruptPulseMode  = "ADC_PULSE_END_OF_CONV";
adc1.interrupt1SOCSource = "ADC_INT_TRIGGER_EOC1";
adc1.enableInterrupt1    = true;
adc1.registerInterrupts  = ["1"];
adc1.useInterrupts       = false;
adc1.enabledInts         = ["ADC_INT_NUMBER1"];

asysctl.analogReference        = "INTERNAL";
asysctl.analogReferenceVoltage = "1P65";
