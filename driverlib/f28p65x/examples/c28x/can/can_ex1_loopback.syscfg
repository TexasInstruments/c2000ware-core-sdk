/**
 * @cliArgs --device "F28P65x" --part "F28P65x_256ZEJ" --package "256ZEJ" --board "/boards/TMDSCNCD28P65X" --context "CPU1"
 */
/**
 * Import the modules used in this configuration.
 */
const can  = scripting.addModule("/driverlib/can.js", {}, false);
const can1 = can.addInstance();
/**
 * Write custom configuration values to the imported modules.
 */
can1.$name           = "myCAN0";
can1.msgObjsUsed     = [1,2];
can1.enableLoopback  = true;
can1.loopbackMode    = "CAN_TEST_EXL";
can1.msgObj1.$name   = "msgObj0";
can1.msgObj1.msgID   = 4;
can1.msgObj1.msgType = "CAN_MSG_OBJ_TYPE_TX";
can1.msgObj1.msgLen  = 2;
can1.msgObj2.$name   = "msgObj1";
can1.msgObj2.msgID   = 4;
