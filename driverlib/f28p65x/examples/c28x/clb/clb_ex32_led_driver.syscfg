/**
 * Import the modules used in this configuration.
 */
const clb                  = scripting.addModule("/driverlib/clb.js", {}, false);
const clb1                 = clb.addInstance();
const clb2                 = clb.addInstance();
const clb_inputxbar        = scripting.addModule("/driverlib/clb_inputxbar.js", {}, false);
const clb_inputxbar1       = clb_inputxbar.addInstance();
const clb_inputxbar_input  = scripting.addModule("/driverlib/clb_inputxbar_input.js");
const clb_inputxbar_input1 = clb_inputxbar_input.addInstance();
const clb_inputxbar_input2 = clb_inputxbar_input.addInstance();
const clb_outputxbar       = scripting.addModule("/driverlib/clb_outputxbar.js", {}, false);
const clb_outputxbar1      = clb_outputxbar.addInstance();
const clb_outputxbar2      = clb_outputxbar.addInstance();
const clbxbar              = scripting.addModule("/driverlib/clbxbar.js", {}, false);
const clbxbar1             = clbxbar.addInstance();
const epwm                 = scripting.addModule("/driverlib/epwm.js", {}, false);
const epwm1                = epwm.addInstance();
const gpio                 = scripting.addModule("/driverlib/gpio.js", {}, false);
const gpio1                = gpio.addInstance();
const TILE                 = scripting.addModule("/utilities/clb_tool/clb_syscfg/source/TILE");
const TILE1                = TILE.addInstance();
const TILE2                = TILE.addInstance();

/**
 * Write custom configuration values to the imported modules.
 */
clb1.globalConfigCLB_IN0 = "CLB_GLOBAL_IN_MUX_CLB_AUXSIG0";
clb1.synchronizeCLB_IN0  = true;
clb1.globalConfigCLB_IN1 = "CLB_GLOBAL_IN_MUX_CLB_AUXSIG1";
clb1.synchronizeCLB_IN1  = true;
clb1.prescale            = 10000;
clb1.tap                 = 5;
clb1.inputTypeCLB_IN0    = "LOCAL";
clb1.localConfigCLB_IN0  = "CLB_LOCAL_IN_MUX_INPUT1";
clb1.filterConfigCLB_IN0 = "CLB_FILTER_RISING_EDGE";
clb1.inputTypeCLB_IN1    = "LOCAL";
clb1.inputTypeCLB_IN2    = "LOCAL";
clb1.inputTypeCLB_IN4    = "LOCAL";
clb1.localConfigCLB_IN4  = "CLB_LOCAL_IN_MUX_INPUT3";
clb1.synchronizeCLB_IN4  = true;
clb1.localConfigCLB_IN3  = "CLB_LOCAL_IN_MUX_INPUT1";
clb1.synchronizeCLB_IN3  = true;
clb1.filterConfigCLB_IN5 = "CLB_FILTER_RISING_EDGE";
clb1.synchronizeCLB_IN2  = true;
clb1.inputsUsed          = ["CLB_IN1","CLB_IN2","CLB_IN3"];
clb1.registerInterrupts  = true;
clb1.$name               = "CCSI1_RX_TILE";
clb1.localConfigCLB_IN1  = "CLB_LOCAL_IN_MUX_INPUT1";
clb1.localConfigCLB_IN2  = "CLB_LOCAL_IN_MUX_INPUT2";
clb1.filterConfigCLB_IN2 = "CLB_FILTER_RISING_EDGE";

clb2.clbBase             = "CLB2_BASE";
clb2.synchronizeCLB_IN0  = true;
clb2.synchronizeCLB_IN3  = true;
clb2.localConfigCLB_IN0  = "CLB_LOCAL_IN_MUX_INPUT1";
clb2.localConfigCLB_IN3  = "CLB_LOCAL_IN_MUX_INPUT1";
clb2.synchronizeCLB_IN4  = true;
clb2.localConfigCLB_IN4  = "CLB_LOCAL_IN_MUX_INPUT3";
clb2.filterConfigCLB_IN0 = "CLB_FILTER_FALLING_EDGE";
clb2.globalConfigCLB_IN5 = "CLB_GLOBAL_IN_MUX_CLB_AUXSIG0";
clb2.inputTypeCLB_IN5    = "GLOBAL";
clb2.inputsUsed          = ["CLB_IN0","CLB_IN1","CLB_IN3","CLB_IN4","CLB_IN5","CLB_IN6"];
clb2.registerInterrupts  = true;
clb2.$name               = "CCSI1_TX_TILE";
clb2.inputTypeCLB_IN0    = "GLOBAL";
clb2.inputTypeCLB_IN4    = "GLOBAL";
clb2.inputTypeCLB_IN3    = "GLOBAL";
clb2.synchronizeCLB_IN5  = true;
clb2.globalConfigCLB_IN4 = "CLB_GLOBAL_IN_MUX_EPWM1B";

clb_inputxbar1.$name = "CLB_CCSI_RX_PINS";

clb_inputxbar_input1.$name         = "CLBINPUTXBAR_CLB_SIN_1";

clb_inputxbar_input2.inputxbarInput = "XBAR_INPUT2";
clb_inputxbar_input2.$name          = "CLBINPUTXBAR_CLB_SCLKX2";
clb_outputxbar1.muxesUsed                                = ["XBAR_MUX09"];
clb_outputxbar1.$name                                    = "CLB_SCLK_1";
clb_outputxbar1.clb_outputxbar.$assign                   = "CLB_OUTPUTXBAR2";
clb_outputxbar1.clb_outputxbar.clb_outputxbarPin.$assign = "GPIO1";

clb_outputxbar2.muxesUsed                                = ["XBAR_MUX08"];
clb_outputxbar2.$name                                    = "CLB_SCLKX2_1";
clb_outputxbar2.clb_outputxbar.$assign                   = "CLB_OUTPUTXBAR1";
clb_outputxbar2.clb_outputxbar.clb_outputxbarPin.$assign = "GPIO0";

clbxbar1.muxesUsed  = ["XBAR_MUX07"];
clbxbar1.mux7Config = "XBAR_CLB_MUX07_CLB2_OUT5";
clbxbar1.$name      = "myCLBXBAR_TRANSFER_START_SYNC";
epwm1.$name                  = "EPWM_CLK";
epwm1.epwm.$assign           = "EPWM16"
epwm1.epwm.epwm_aPin.$assign = "GPIO91";
epwm1.epwm.epwm_bPin.$assign = "GPIO92";


gpio1.qualMode        = "GPIO_QUAL_ASYNC";
gpio1.$name           = "CLB_SIN_1";

TILE.sim_duration = 100000000;
TILE.clock_period = 12000;

TILE1.$name                     = "TILE1";
TILE1.BOUNDARY.$name            = "BOUNDARY0";
TILE1.BOUNDARY.in_sync0         = true;
TILE1.BOUNDARY.in_edge0         = "rising edge";
TILE1.BOUNDARY.in2              = "squareWave";
TILE1.BOUNDARY.in_sync2         = true;
TILE1.BOUNDARY.in_sync1         = true;
TILE1.BOUNDARY.in_repeat_count0 = 200;
TILE1.BOUNDARY.in_repeat_count2 = 1000;
TILE1.BOUNDARY.in1              = "squareWave";
TILE1.BOUNDARY.in0              = "1";
TILE1.BOUNDARY.in_period1       = 44269;
TILE1.BOUNDARY.in_repeat_count1 = 4;
TILE1.BOUNDARY.in_duty1         = 500;
TILE1.BOUNDARY.in_period2       = 12;
TILE1.BOUNDARY.in_edge2         = "rising edge";
TILE1.LUT_0.$name               = "LUT_0";
TILE1.LUT_0.i0                  = "BOUNDARY.in1";
TILE1.LUT_0.i1                  = "BOUNDARY.in2";
TILE1.LUT_0.eqn                 = "!i0&i1";
TILE1.LUT_0.i2                  = "BOUNDARY.in3";
TILE1.LUT_1.$name               = "LUT_1";
TILE1.LUT_1.i1                  = "COUNTER_1.count_match1";
TILE1.LUT_1.i0                  = "COUNTER_2.count_match2";
TILE1.LUT_1.i2                  = "COUNTER_1.count_match2";
TILE1.LUT_1.i3                  = "FSM_0.OUT";
TILE1.LUT_1.eqn                 = "i0&i1&i2&i3 | i0&!i1&!i2&i3";
TILE1.LUT_2.$name               = "LUT_2";
TILE1.LUT_2.i1                  = "FSM_0.OUT";
TILE1.LUT_2.i0                  = "COUNTER_2.count_match2";
TILE1.LUT_2.eqn                 = "i0|!i1";
TILE1.FSM_0.$name               = "FSM_0";
TILE1.FSM_0.e0                  = "COUNTER_0.count_match1";
TILE1.FSM_0.e1                  = "LUT_0.OUT";
TILE1.FSM_0.eqn_s0              = "!s1&!s0&e1&!e0 | !s1&!s0&e1&e0 | !s1&s0&!e1&!e0 | !s1&s0&e1&!e0";
TILE1.FSM_0.eqn_out             = "!s1&s0&!e1&!e0 | !s1&s0&!e1&e0 | !s1&s0&e1&!e0 | !s1&s0&e1&e0";
TILE1.FSM_1.$name               = "FSM_1";
TILE1.FSM_1.e0                  = "COUNTER_2.count_match2";
TILE1.FSM_1.e1                  = "FSM_0.OUT";
TILE1.FSM_1.eqn_out             = "s1&s0&e1&e0";
TILE1.FSM_1.eqn_s1              = "!s1&s0&e1&e0 | s1&!s0&e1&!e0 | s1&!s0&e1&e0 | s1&s0&e1&!e0";
TILE1.FSM_1.eqn_s0              = "!s1&!s0&e1&e0 | !s1&s0&e1&!e0 | s1&!s0&e1&e0 | s1&s0&e1&!e0";
TILE1.FSM_2.$name               = "FSM_2";
TILE1.FSM_2.e0                  = "COUNTER_0.count_match1";
TILE1.FSM_2.e1                  = "FSM_0.OUT";
TILE1.FSM_2.eqn_out             = "e0&e1";
TILE1.COUNTER_0.$name           = "COUNTER_0";
TILE1.COUNTER_0.reset           = "LUT_0.OUT";
TILE1.COUNTER_0.mode1           = "1";
TILE1.COUNTER_0.event           = "BOUNDARY.in1";
TILE1.COUNTER_0.match1_val      = "0x3FFFF";
TILE1.COUNTER_0.action          = "Shift Right";
TILE1.COUNTER_0.serializer_en   = true;
TILE1.COUNTER_0.mode0           = "BOUNDARY.in2";
TILE1.COUNTER_1.$name           = "COUNTER_1";
TILE1.COUNTER_1.match1_tap_en   = true;
TILE1.COUNTER_1.event           = "BOUNDARY.in1";
TILE1.COUNTER_1.mode1           = "1";
TILE1.COUNTER_1.action          = "Shift Right";
TILE1.COUNTER_1.serializer_en   = true;
TILE1.COUNTER_1.match2_tap_en   = true;
TILE1.COUNTER_1.match1_tap_sel  = 1;
TILE1.COUNTER_1.reset           = "LUT_2.OUT";
TILE1.COUNTER_1.mode0           = "BOUNDARY.in2";
TILE1.COUNTER_2.$name           = "COUNTER_2";
TILE1.COUNTER_2.mode1           = "1";
TILE1.COUNTER_2.match1_val      = "16";
TILE1.COUNTER_2.match2_val      = "17";
TILE1.COUNTER_2.reset           = "LUT_2.OUT";
TILE1.COUNTER_2.mode0           = "BOUNDARY.in2";
TILE1.OUTLUT_0.$name            = "OUTLUT_0";
TILE1.OUTLUT_1.$name            = "OUTLUT_1";
TILE1.OUTLUT_2.$name            = "OUTLUT_2";
TILE1.OUTLUT_3.$name            = "OUTLUT_3";
TILE1.OUTLUT_4.$name            = "OUTLUT_4";
TILE1.OUTLUT_5.$name            = "OUTLUT_5";
TILE1.OUTLUT_6.$name            = "OUTLUT_6";
TILE1.OUTLUT_7.$name            = "OUTLUT_7";
TILE1.HLC.$name                 = "HLC_0";
TILE1.HLC.e0                    = "COUNTER_2.count_match1";
TILE1.HLC.R0_init               = "1";
TILE1.HLC.e3                    = "LUT_1.OUT";
TILE1.HLC.e1                    = "FSM_2.OUT";
TILE1.HLC.e2                    = "FSM_1.OUT";
TILE1.HLC.program0.$name        = "HLCP_0";
TILE1.HLC.program0.instruct0    = "push c1";
TILE1.HLC.program1.$name        = "HLCP_1";
TILE1.HLC.program1.instruct0    = "mov r1, r3";
TILE1.HLC.program1.instruct1    = "intr 1";
TILE1.HLC.program2.$name        = "HLCP_2";
TILE1.HLC.program2.instruct0    = "mov r0, r2";
TILE1.HLC.program2.instruct1    = "intr 1";
TILE1.HLC.program3.$name        = "HLCP_3";
TILE1.HLC.program3.instruct0    = "mov r0, r1";
TILE1.HLC.program3.instruct1    = "intr 1";
TILE1.AOC_0.$name               = "AOC_0";
TILE1.AOC_1.$name               = "AOC_1";
TILE1.AOC_2.$name               = "AOC_2";
TILE1.AOC_3.$name               = "AOC_3";
TILE1.AOC_4.$name               = "AOC_4";
TILE1.AOC_5.$name               = "AOC_5";
TILE1.AOC_6.$name               = "AOC_6";
TILE1.AOC_7.$name               = "AOC_7";

TILE2.$name                     = "TILE2";
TILE2.BOUNDARY.$name            = "BOUNDARY1";
TILE2.BOUNDARY.in0              = "squareWave";
TILE2.BOUNDARY.in_sync1         = true;
TILE2.BOUNDARY.in_repeat_count1 = 1;
TILE2.BOUNDARY.in_repeat_count0 = 1000;
TILE2.BOUNDARY.in_duty1         = 9500;
TILE2.BOUNDARY.in_sync0         = true;
TILE2.BOUNDARY.in3              = "squareWave";
TILE2.BOUNDARY.in_repeat_count3 = 1000;
TILE2.BOUNDARY.in_sync3         = true;
TILE2.BOUNDARY.in_edge0         = "falling edge";
TILE2.BOUNDARY.in1              = "squareWave";
TILE2.BOUNDARY.in_period1       = 44270;
TILE2.BOUNDARY.in_period0       = 12;
TILE2.BOUNDARY.in_period3       = 12;
TILE2.LUT_0.$name               = "LUT_3";
TILE2.LUT_0.i1                  = "BOUNDARY.in5";
TILE2.LUT_0.i0                  = "BOUNDARY.in1";
TILE2.LUT_0.eqn                 = "i0|i1";
TILE2.LUT_1.$name               = "LUT_4";
TILE2.LUT_1.i1                  = "FSM_0.OUT";
TILE2.LUT_1.eqn                 = "!i0|i1";
TILE2.LUT_1.i0                  = "COUNTER_1.count_match2";
TILE2.LUT_2.$name               = "LUT_5";
TILE2.LUT_2.i0                  = "COUNTER_2.count_match1";
TILE2.LUT_2.eqn                 = "i0|i1";
TILE2.LUT_2.i1                  = "FSM_0.OUT";
TILE2.FSM_0.$name               = "FSM_3";
TILE2.FSM_0.e0                  = "COUNTER_0.count_match1";
TILE2.FSM_0.eqn_out             = "!s0 | s1";
TILE2.FSM_0.eqn_s1              = "!s1&s0&e0 | s1&!s0&e1";
TILE2.FSM_0.eqn_s0              = "!s1&e1&!e0 | !s1&s0&!e0";
TILE2.FSM_0.e1                  = "LUT_0.OUT";
TILE2.FSM_1.$name               = "FSM_4";
TILE2.FSM_2.$name               = "FSM_5";
TILE2.FSM_2.e0                  = "COUNTER_2.count_match1";
TILE2.FSM_2.eqn_s1              = "s1&!s0&!e1 | s1&!e1&!e0 | !s1&s0&!e1&e0";
TILE2.FSM_2.eqn_s0              = "!s0&!e1&e0 | s0&!e1&!e0";
TILE2.FSM_2.eqn_out             = "s1&s0&!e1&e0";
TILE2.FSM_2.e1                  = "FSM_0.OUT";
TILE2.COUNTER_0.$name           = "COUNTER_3";
TILE2.COUNTER_0.mode0           = "COUNTER_2.count_match1";
TILE2.COUNTER_0.mode1           = "1";
TILE2.COUNTER_0.reset           = "COUNTER_0.count_match1";
TILE2.COUNTER_0.match1_val      = "2";
TILE2.COUNTER_0.match2_val      = "3";
TILE2.COUNTER_1.$name           = "COUNTER_4";
TILE2.COUNTER_1.mode0           = "BOUNDARY.in0";
TILE2.COUNTER_1.mode1           = "1";
TILE2.COUNTER_1.serializer_en   = true;
TILE2.COUNTER_1.match1_tap_en   = true;
TILE2.COUNTER_1.action          = "Load";
TILE2.COUNTER_1.event           = "LUT_1.OUT";
TILE2.COUNTER_1.match1_tap_sel  = 15;
TILE2.COUNTER_1.match2_tap_en   = true;
TILE2.COUNTER_2.$name           = "COUNTER_5";
TILE2.COUNTER_2.mode0           = "BOUNDARY.in0";
TILE2.COUNTER_2.mode1           = "1";
TILE2.COUNTER_2.match1_val      = "17";
TILE2.COUNTER_2.reset           = "LUT_2.OUT";
TILE2.OUTLUT_0.$name            = "OUTLUT_8";
TILE2.OUTLUT_0.i0               = "BOUNDARY.in3";
TILE2.OUTLUT_0.eqn              = "i0";
TILE2.OUTLUT_1.$name            = "OUTLUT_9";
TILE2.OUTLUT_1.i0               = "BOUNDARY.in4";
TILE2.OUTLUT_1.eqn              = "i0";
TILE2.OUTLUT_2.$name            = "OUTLUT_10";
TILE2.OUTLUT_3.$name            = "OUTLUT_11";
TILE2.OUTLUT_4.$name            = "OUTLUT_12";
TILE2.OUTLUT_4.i0               = "COUNTER_1.count_match1";
TILE2.OUTLUT_4.eqn              = "i0|i1";
TILE2.OUTLUT_4.i1               = "FSM_0.OUT";
TILE2.OUTLUT_5.$name            = "OUTLUT_13";
TILE2.OUTLUT_5.i0               = "BOUNDARY.in6";
TILE2.OUTLUT_5.eqn              = "i0";
TILE2.OUTLUT_6.$name            = "OUTLUT_14";
TILE2.OUTLUT_7.$name            = "OUTLUT_15";
TILE2.HLC.$name                 = "HLC_1";
TILE2.HLC.R0_init               = "1";
TILE2.HLC.e0                    = "COUNTER_2.count_match1";
TILE2.HLC.e1                    = "FSM_2.OUT";
TILE2.HLC.R1_init               = "0x5555";
TILE2.HLC.e2                    = "COUNTER_0.count_match1";
TILE2.HLC.program0.$name        = "HLCP_4";
TILE2.HLC.program0.instruct0    = "mov r1, c1";
TILE2.HLC.program0.instruct1    = "pull r1";
TILE2.HLC.program1.$name        = "HLCP_5";
TILE2.HLC.program1.instruct0    = "mov r0, r3";
TILE2.HLC.program1.instruct1    = "intr 1";
TILE2.HLC.program2.$name        = "HLCP_6";
TILE2.HLC.program2.instruct0    = "mov r0, r2";
TILE2.HLC.program2.instruct1    = "intr 1";
TILE2.HLC.program3.$name        = "HLCP_7";
TILE2.AOC_0.$name               = "AOC_8";
TILE2.AOC_1.$name               = "AOC_9";
TILE2.AOC_2.$name               = "AOC_10";
TILE2.AOC_3.$name               = "AOC_11";
TILE2.AOC_4.$name               = "AOC_12";
TILE2.AOC_5.$name               = "AOC_13";
TILE2.AOC_6.$name               = "AOC_14";
TILE2.AOC_7.$name               = "AOC_15";
