/**
 * @cliArgs --device "F28P65x" --part "F28P65x_256ZEJ" --package "256ZEJ" --board "/boards/TMDSCNCD28P65X" --context "CPU1"
 */
/**
 * Import the modules used in this configuration.
 */
const dcc  = scripting.addModule("/driverlib/dcc.js", {}, false);
const dcc1 = dcc.addInstance();
/**
 * Write custom configuration values to the imported modules.
 */
dcc1.$name                      = "myDCC0";
dcc1.freqerrtol                 = 3;
dcc1.dccerrtol                  = 1;
dcc1.setCounter0ClkSource       = "DCC_COUNT0SRC_INTOSC2";
dcc1.enableInterrupts           = true;
dcc1.enableErrorSignalInterrupt = true;
dcc1.registerInterrupts         = true;
// Configure Counter1 Clock with higher frequency to artificially increase derived Counter 1 seed.
// This will trigger DCC error
dcc1.fclk1                      = 210;
const interrupt_sys_err                            = scripting.addModule("/driverlib/interrupt/interrupt_sys_err.js", {}, false);
const interrupt_sys_err1                           = interrupt_sys_err.addInstance({}, false);
interrupt_sys_err1.$name                           = "myInterruptSysErr0";
dcc1.sysErrInt                                     = interrupt_sys_err1;
interrupt_sys_err1.enableInterrupt                 = true;
interrupt_sys_err1.sysErrSource_SYSCTL_STATUS_DCC1 = true;
interrupt_sys_err1.interruptHandler                = "INT_myDCC0_ISR";
