/**
 * Import the modules used in this configuration.
 */
const ecap       = scripting.addModule("/driverlib/ecap.js", {}, false);
const ecap1      = ecap.addInstance();
const ecap2      = ecap.addInstance();
const ecap3      = ecap.addInstance();
const gpio       = scripting.addModule("/driverlib/gpio.js", {}, false);
const gpio1      = gpio.addInstance();
const inputxbar  = scripting.addModule("/driverlib/inputxbar.js", {}, false);
const inputxbar1 = inputxbar.addInstance();

/**
 * Write custom configuration values to the imported modules.
 */
ecap1.$name               = "myECAP1";
ecap1.ecapInput              = "ECAP_INPUT_INPUTXBAR7";
ecap1.captureMode         = "ECAP_ONE_SHOT_CAPTURE_MODE";
ecap1.eventOnePolarity    = "ECAP_EVNT_FALLING_EDGE";
ecap1.eventThreePolarity  = "ECAP_EVNT_FALLING_EDGE";
ecap1.enableLoadCounter   = true;
ecap1.loadCounter         = true;
ecap1.eventStop           = "ECAP_EVENT_4";
ecap1.counterResetOnEvent = ["ECAP_EVENT_1","ECAP_EVENT_2","ECAP_EVENT_3","ECAP_EVENT_4"];
ecap1.reArm               = true;

ecap2.$name               = "myECAP2";
ecap2.ecapBase            = "ECAP2_BASE";
ecap2.ecapInput              = "ECAP_INPUT_INPUTXBAR7";
ecap2.captureMode         = "ECAP_ONE_SHOT_CAPTURE_MODE";
ecap2.eventOnePolarity    = "ECAP_EVNT_FALLING_EDGE";
ecap2.eventThreePolarity  = "ECAP_EVNT_FALLING_EDGE";
ecap2.enableLoadCounter   = true;
ecap2.eventStop           = "ECAP_EVENT_4";
ecap2.counterResetOnEvent = ["ECAP_EVENT_1","ECAP_EVENT_2","ECAP_EVENT_3","ECAP_EVENT_4"];
ecap2.reArm               = true;

ecap3.$name                   = "myECAP3";
ecap3.ecapBase                = "ECAP3_BASE";
ecap3.ecapInput              = "ECAP_INPUT_INPUTXBAR7";
ecap3.captureMode             = "ECAP_ONE_SHOT_CAPTURE_MODE";
ecap3.eventOnePolarity        = "ECAP_EVNT_FALLING_EDGE";
ecap3.eventThreePolarity      = "ECAP_EVNT_FALLING_EDGE";
ecap3.enableLoadCounter       = true;
ecap3.enableInterrupt         = true;
ecap3.interruptSourceCapture  = ["ECAP_ISR_SOURCE_CAPTURE_EVENT_4"];
ecap3.eventStop               = "ECAP_EVENT_4";
ecap3.counterResetOnEvent     = ["ECAP_EVENT_1","ECAP_EVENT_2","ECAP_EVENT_3","ECAP_EVENT_4"];
ecap3.reArm                   = true;
ecap3.registerInterrupts      = true;
ecap3.ecapInt.enableInterrupt = true;

gpio1.$name           = "myGPIO0";
gpio1.qualMode        = "GPIO_QUAL_ASYNC";
gpio1.gpioPin.$assign = "GPIO16";

inputxbar1.$name          = "myINPUTXBAR0";
inputxbar1.inputxbar7Gpio = "GPIO16";
inputxbar1.inputsUsed     = ["inputxbar7Gpio"];
