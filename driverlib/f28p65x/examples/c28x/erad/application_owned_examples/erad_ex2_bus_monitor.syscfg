/**
 * @cliArgs --device "F28P65x" --part "F28P65x_256ZEJ" --package "256ZEJ" --board "/boards/TMDSCNCD28P65X" --context "CPU1"
 */
/**
 * Import the modules used in this configuration.
 */
const erad  = scripting.addModule("/driverlib/erad.js", {}, false);
const erad1 = erad.addInstance();
/**
 * Write custom configuration values to the imported modules.
 */
erad1.$name                             = "myERAD0";
erad1.ctmsUsed                          = ["COUNTER1"];
erad1.hwbpsUsed                         = ["BUSCOMP1","BUSCOMP2","BUSCOMP3"];
erad1.eradBUSCOMP1.$name                = "ERAD_HWBP0";
erad1.eradBUSCOMP1.hwbpAddressInputMode = "CODE";
erad1.eradBUSCOMP1.hwbpRefCodeName      = "addr_delayFunction";
erad1.eradCOUNTER1.$name                = "ERAD_CTM0";
erad1.eradCOUNTER1.clockSource          = "1";
erad1.eradBUSCOMP2.$name                = "ERAD_HWBP1";
erad1.eradBUSCOMP2.hwbpBusSel           = "ERAD_BUSCOMP_BUS_DRAB";
erad1.eradBUSCOMP2.hwbpAddressInputMode = "CODE";
erad1.eradBUSCOMP2.hwbpRefCodeName      = "addr_startCount";
erad1.eradBUSCOMP2.rtosInterrupt        = true;
erad1.eradBUSCOMP3.$name                = "ERAD_HWBP2";
erad1.eradBUSCOMP3.hwbpBusSel           = "ERAD_BUSCOMP_BUS_DWAB";
erad1.eradBUSCOMP3.hwbpAddressInputMode = "CODE";
erad1.eradBUSCOMP3.hwbpRefCodeName      = "addr_endCount";
erad1.eradBUSCOMP3.rtosInterrupt        = true;
