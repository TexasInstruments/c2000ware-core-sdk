/**
 * Import the modules used in this configuration.
 */
const erad                             = scripting.addModule("/driverlib/erad.js", {}, false);
const erad1                            = erad.addInstance();
const TILE                             = scripting.addModule("/utilities/clb_tool/clb_syscfg/source/TILE");
const TILE1                            = TILE.addInstance();
const clb_run_dynamic_template_clb_c   = scripting.addModule("/utilities/clb_tool/clb_syscfg/source/clb_run_dynamic_template_clb_c.js");
const clb_run_dynamic_template_clb_dot = scripting.addModule("/utilities/clb_tool/clb_syscfg/source/clb_run_dynamic_template_clb_dot.js");
const clb_run_dynamic_template_clb_h   = scripting.addModule("/utilities/clb_tool/clb_syscfg/source/clb_run_dynamic_template_clb_h.js");
const clb_run_dynamic_template_clb_sim = scripting.addModule("/utilities/clb_tool/clb_syscfg/source/clb_run_dynamic_template_clb_sim.js");

/**
 * Write custom configuration values to the imported modules.
 */
erad1.$name                             = "myERAD0";
erad1.hwbpsUsed                         = ["BUSCOMP1","BUSCOMP2","BUSCOMP3","BUSCOMP4"];
erad1.ctmsUsed                          = ["COUNTER1"];
erad1.eradBUSCOMP1.$name                = "ERAD_HWBP0";
erad1.eradBUSCOMP1.hwbpBusSel           = "ERAD_BUSCOMP_BUS_DWAB";
erad1.eradBUSCOMP1.hwbpAddressInputMode = "CODE";
erad1.eradBUSCOMP1.hwbpRefCodeName      = "addr_x";
erad1.eradBUSCOMP2.$name                = "ERAD_HWBP1";
erad1.eradBUSCOMP2.hwbpBusSel           = "ERAD_BUSCOMP_BUS_DWDB";
erad1.eradBUSCOMP2.hwbpRef              = 1;
erad1.eradBUSCOMP3.$name                = "ERAD_HWBP2";
erad1.eradBUSCOMP3.hwbpBusSel           = "ERAD_BUSCOMP_BUS_DWDB";
erad1.eradBUSCOMP4.$name                = "ERAD_HWBP3";
erad1.eradBUSCOMP4.hwbpBusSel           = "ERAD_BUSCOMP_BUS_DRAB";
erad1.eradBUSCOMP4.hwbpAddressInputMode = "CODE";
erad1.eradBUSCOMP4.hwbpRefCodeName      = "addr_y";
erad1.eradCOUNTER1.$name                = "ERAD_CTM0";
erad1.eradCOUNTER1.clockSource          = "1";

TILE1.$name                     = "TILE1";
TILE1.BOUNDARY.$name            = "BOUNDARY0";
TILE1.BOUNDARY.in_period0       = 1000;
TILE1.BOUNDARY.in_repeat_count2 = 1000;
TILE1.BOUNDARY.in_period2       = 30;
TILE1.BOUNDARY.in_duty2         = 15;
TILE1.LUT_0.$name               = "LUT_0";
TILE1.LUT_0.i0                  = "BOUNDARY.in0";
TILE1.LUT_0.i1                  = "BOUNDARY.in1";
TILE1.LUT_0.eqn                 = "i0&i1";
TILE1.LUT_1.$name               = "LUT_1";
TILE1.LUT_1.eqn                 = "i0&i1";
TILE1.LUT_1.i1                  = "BOUNDARY.in2";
TILE1.LUT_1.i0                  = "BOUNDARY.in0";
TILE1.LUT_2.$name               = "LUT_2";
TILE1.FSM_0.$name               = "FSM_0";
TILE1.FSM_1.$name               = "FSM_1";
TILE1.FSM_2.$name               = "FSM_2";
TILE1.FSM_2.eqn_out             = "!s0&xe1";
TILE1.FSM_2.e1                  = "LUT_1.OUT";
TILE1.FSM_2.e0                  = "LUT_0.OUT";
TILE1.FSM_2.eqn_s0              = "!e1&(s0|e0)";
TILE1.FSM_2.xe1                 = "BOUNDARY.in3";
TILE1.COUNTER_0.$name           = "COUNTER_0";
TILE1.COUNTER_1.$name           = "COUNTER_1";
TILE1.COUNTER_2.$name           = "COUNTER_2";
TILE1.OUTLUT_0.$name            = "OUTLUT_0";
TILE1.OUTLUT_1.$name            = "OUTLUT_1";
TILE1.OUTLUT_2.$name            = "OUTLUT_2";
TILE1.OUTLUT_3.$name            = "OUTLUT_3";
TILE1.OUTLUT_4.$name            = "OUTLUT_4";
TILE1.OUTLUT_5.$name            = "OUTLUT_5";
TILE1.OUTLUT_5.eqn              = "i0";
TILE1.OUTLUT_5.i0               = "FSM_2.S0";
TILE1.OUTLUT_6.$name            = "OUTLUT_6";
TILE1.OUTLUT_7.$name            = "OUTLUT_7";
TILE1.HLC.$name                 = "HLC_0";
TILE1.HLC.e0                    = "FSM_2.OUT";
TILE1.HLC.program0.$name        = "HLCP_0";
TILE1.HLC.program0.instruct0    = "INTR 0";
TILE1.HLC.program1.$name        = "HLCP_1";
TILE1.HLC.program2.$name        = "HLCP_2";
TILE1.HLC.program3.$name        = "HLCP_3";
