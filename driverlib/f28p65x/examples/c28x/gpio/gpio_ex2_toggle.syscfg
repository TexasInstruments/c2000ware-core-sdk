
/**
 * Import the modules used in this configuration.
 */
const gpio  = scripting.addModule("/driverlib/gpio.js", {}, false);
const gpio1 = gpio.addInstance();

/**
 * Write custom configuration values to the imported modules.
 */
gpio1.$name     = "myGPIOOutput0";
gpio1.direction = "GPIO_DIR_MODE_OUT";
