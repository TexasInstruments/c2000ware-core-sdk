/**
 * @cliArgs --board "/boards/TMDSCNCD28P65X" --context "CPU1" --product "C2000WARE@5.00.00.00"
 * @versions {"tool":"1.17.0+3047"}
 */

/**
 * Import the modules used in this configuration.
 */
const led            = scripting.addModule("/driverlib/board_components/led", {}, false);
const led1           = led.addInstance();
const device_support = scripting.addModule("/driverlib/device_support.js");
const sysctl         = scripting.addModule("/driverlib/sysctl.js");
const CMD            = scripting.addModule("/utilities/cmd_tool/cmd_syscfg/source/CMD");
const CMD1           = CMD.addInstance();
const CMD2           = CMD.addInstance();
const memcfg         = scripting.addModule("/driverlib/memcfg.js");
/**
 * Write custom configuration values to the imported modules.
 */
CMD1.$name                    = "generic_ram_lnk";
CMD2.$name                    = "generic_flash_lnk";

CMD1.sectionMemory_text       = ["RAMD0","RAMD1","RAMLS0","RAMLS1","RAMLS2","RAMLS3"];
CMD1.sectionMemory_bss        = ["RAMLS5"];
CMD1.sectionMemory_const      = ["RAMLS5","RAMLS6"];
CMD1.sectionMemory_data       = ["RAMLS5"];
CMD1.sectionMemory_ramfunc    = ["RAMM0"];
CMD1.sectionMemory_cinit      = ["RAMM0"];
CMD1.sectionMemory_stack      = ["RAMM1"];
CMD1.sectionMemory_init_array = ["RAMM0"];
CMD1.sectionMemory_switch     = ["RAMM0"];
CMD1.sectionMemory_sysmem     = ["RAMLS4"];

CMD2.sectionAlignEnable_ramfunc    = true;
CMD2.sectionAlignEnable_text       = true;
CMD2.sectionAlignEnable_binit      = true;
CMD2.sectionAlignEnable_cinit      = true;
CMD2.sectionAlignEnable_switch     = true;
CMD2.sectionAlignEnable_init_array = true;
CMD2.sectionAlignEnable_const      = true;
CMD2.sectionAlignEnable_ovly       = true;
CMD2.sectionMemory_codestart       = "0x080000";
CMD2.sectionMemory_stack           = ["RAMM1"];
CMD2.sectionMemory_bss             = ["RAMLS5"];
CMD2.sectionMemory_data            = ["RAMLS5"];
CMD2.sectionMemory_sysmem          = ["RAMLS5"];
CMD2.sectionMemory_ramfunc         = ["FLASH_BANK0"];
CMD2.sectionMemory_text            = ["FLASH_BANK0","FLASH_BANK1"];
CMD2.sectionMemory_binit           = ["FLASH_BANK0"];
CMD2.sectionMemory_cinit           = ["FLASH_BANK0"];
CMD2.sectionMemory_switch          = ["FLASH_BANK0"];
CMD2.sectionMemory_init_array      = ["FLASH_BANK0"];
CMD2.sectionMemory_const           = ["FLASH_BANK0"];
CMD2.sectionMemory_ovly            = ["FLASH_BANK0"];
CMD2.sectionRunFromDifferentAddr_ramfunc = true;
CMD2.sectionRun_ramfunc                  = ["RAMLS0"];
CMD2.sectionBinit_ramfunc                = false;

led1.$name                = "myBoardLED0";
led1.$name     = "myBoardLED0";
led1.$hardware = system.deviceData.board.components.D1;
