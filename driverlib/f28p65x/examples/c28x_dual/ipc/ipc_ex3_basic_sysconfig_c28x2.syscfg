/**
 * @cliArgs --device "F28P65x" --package "256ZEJ" --part "F28P65x_256ZEJ" --context "CPU2" --product "C2000WARE@5.00.00.00"
 * @versions {"tool":"1.16.1+2960"}
 */

/**
 * Import the modules used in this configuration.
 */
const ipc    = scripting.addModule("/driverlib/ipc.js");
const memcfg = scripting.addModule("/driverlib/memcfg.js");

/**
 * Write custom configuration values to the imported modules.
 */
ipc.flagHandler31            = "SYNC_FLAG";
ipc.registerInterrupts       = ["0"];
ipc.ipcRegisterFlag          = ["IPC_FLAG31"];
ipc.ipcInt0.interruptHandler = "IPC_ISR0";
ipc.ipcInt0.enableInterrupt  = true;
