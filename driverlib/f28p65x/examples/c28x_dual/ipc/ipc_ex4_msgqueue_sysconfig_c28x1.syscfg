/**
 * @cliArgs --device "F28P65x" --package "256ZEJ" --part "F28P65x_256ZEJ" --context "CPU1" --product "C2000WARE@5.00.00.00"
 * @versions {"tool":"1.16.1+2960"}
 */

/**
 * Import the modules used in this configuration.
 */
const ipc    = scripting.addModule("/driverlib/ipc.js");
const memcfg = scripting.addModule("/driverlib/memcfg.js");

/**
 * Write custom configuration values to the imported modules.
 */
ipc.flagHandler31    = "SYNC_FLAG";
ipc.ipcRegisterFlag  = ["IPC_FLAG1","IPC_FLAG31"];
ipc.enableInterrupt1 = true;

memcfg.config_MEMCFG_SECT_GS3    = "MEMCFG_GSRAMCONTROLLER_CPU2";
memcfg.config_MEMCFG_SECT_GS4    = "MEMCFG_GSRAMCONTROLLER_CPU2";
memcfg.config_SYSCTL_FLASH_BANK3 = "SYSCTL_CPUSEL_CPU2";
memcfg.config_SYSCTL_FLASH_BANK4 = "SYSCTL_CPUSEL_CPU2";
