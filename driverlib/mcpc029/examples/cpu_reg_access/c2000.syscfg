/**
 * These arguments were used when this file was generated. They will be automatically applied on subsequent loads
 * via the GUI or CLI. Run CLI with '--help' for additional information on how to override these arguments.
 * @cliArgs --device "MCPC029" --part "MCPC029_48RGZ" --package "48RGZ"
 * @v2CliArgs --device "MCPC029" --package "48RGZ"
 */