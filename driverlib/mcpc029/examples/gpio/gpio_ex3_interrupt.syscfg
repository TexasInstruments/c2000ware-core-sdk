/**
 * These arguments were used when this file was generated. They will be automatically applied on subsequent loads
 * via the GUI or CLI. Run CLI with '--help' for additional information on how to override these arguments.
 * @cliArgs --device "MCPC029" --part "MCPC029_48RGZ" --package "48RGZ"
 * @v2CliArgs --device "MCPC029" --package "48RGZ"
 */
/**
 * Import the modules used in this configuration.
 */
const gpio  = scripting.addModule("/driverlib/gpio.js", {}, false);
const gpio1 = gpio.addInstance();
const gpio2 = gpio.addInstance();
/**
 * Write custom configuration values to the imported modules.
 */
gpio1.$name     = "myGPIOInputInterrupt0";
gpio1.padConfig = "PULLUP";
gpio2.$name     = "myGPIOOutput0";
gpio2.direction = "GPIO_DIR_MODE_OUT";