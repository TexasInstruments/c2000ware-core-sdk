/**
 * @cliArgs --device "MCPC029" --part "MCPC029_48RGZ" --package "48RGZ"
 */
/**
 * Import the modules used in this configuration.
 */
const device_support = scripting.addModule("/driverlib/device_support.js");
const sysctl         = scripting.addModule("/driverlib/sysctl.js");
const CMD            = scripting.addModule("/utilities/cmd_tool/cmd_syscfg/source/CMD");
const CMD1           = CMD.addInstance();
const CMD2           = CMD.addInstance();
const gui            = scripting.addModule("/utilities/transfer/gui.js");
/**
 * Write custom configuration values to the imported modules.
 */
const divider2       = system.clockTree["PLL_PDIV"];
divider2.divideValue = 2;
const multiplier1         = system.clockTree["PLL_QDIV"];
multiplier1.multiplyValue = 32;
const mux1       = system.clockTree["OSCCLKSRCSEL"];
mux1.inputSelect = "X1_XTAL";
CMD1.$name                    = "generic_ram_lnk";
CMD2.$name                    = "generic_flash_lnk";
CMD1.sectionMemory_text       = ["RAMM1","RAMGS0"];
CMD1.sectionMemory_bss        = ["RAMGS0","RAMM1"];
CMD1.sectionMemory_const      = ["RAMM1","RAMGS0","RAMM0"];
CMD1.sectionMemory_data       = ["RAMGS0","RAMM1"];
CMD1.sectionMemory_ramfunc    = ["RAMM0"];
CMD1.sectionMemory_cinit      = ["RAMM0"];
CMD1.sectionMemory_stack      = ["RAMM1"];
CMD1.sectionMemory_init_array = ["RAMM0"];
CMD1.sectionMemory_switch     = ["RAMM0"];
CMD1.sectionMemory_sysmem     = ["RAMGS0"];
CMD2.sectionAlignEnable_ramfunc    = true;
CMD2.sectionAlignEnable_text       = true;
CMD2.sectionAlignEnable_binit      = true;
CMD2.sectionAlignEnable_cinit      = true;
CMD2.sectionAlignEnable_switch     = true;
CMD2.sectionAlignEnable_init_array = true;
CMD2.sectionAlignEnable_const      = true;
CMD2.sectionAlignEnable_ovly       = true;
CMD2.sectionMemory_codestart       = "0x080000";
CMD2.sectionMemory_stack           = ["RAMM0"];
CMD2.sectionMemory_bss             = ["RAMGS0"];
CMD2.sectionMemory_data            = ["RAMGS0"];
CMD2.sectionMemory_sysmem          = ["RAMGS0"];
CMD2.sectionMemory_ramfunc         = ["FLASH_BANK0_SEC_0_63"];
CMD2.sectionMemory_text            = ["FLASH_BANK0_SEC_0_63"];
CMD2.sectionMemory_binit           = ["FLASH_BANK0_SEC_0_63"];
CMD2.sectionMemory_cinit           = ["FLASH_BANK0_SEC_0_63"];
CMD2.sectionMemory_switch          = ["FLASH_BANK0_SEC_0_63"];
CMD2.sectionMemory_init_array      = ["FLASH_BANK0_SEC_0_63"];
CMD2.sectionMemory_const           = ["FLASH_BANK0_SEC_0_63"];
CMD2.sectionMemory_ovly            = ["FLASH_BANK0_SEC_0_63"];
CMD2.sectionRunFromDifferentAddr_ramfunc = true;
CMD2.sectionRun_ramfunc                  = ["RAMGS0"];
CMD2.sectionBinit_ramfunc                = false;
gui.guiProjectName                             = "transfer_ex1_customlog_export_sci";
gui.customlogger                               = true;
gui.exporter.$name                             = "myEXPORT0";
gui.exporter.exportMods                        = false;
gui.exporter.exportCustomLogTimestamp          = true;
gui.exporter.comsLinkModule.wordLenght         = scripting.forceWrite("8");
gui.exporter.comsLinkModule.stop               = scripting.forceWrite("ONE");
gui.exporter.comsLinkModule.parity             = scripting.forceWrite("SCI_CONFIG_PAR_NONE");
gui.exporter.comsLinkModule.registerInterrupts = scripting.forceWrite(false);
gui.exporter.comsLinkModule.useFifo            = scripting.forceWrite(true);
gui.exporter.comsLinkModule.loopback           = scripting.forceWrite(false);
gui.exporter.comsLinkModule.useCase            = scripting.forceWrite("ALL");
