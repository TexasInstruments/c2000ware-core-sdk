/**
 * These arguments were used when this file was generated. They will be automatically applied on subsequent loads
 * via the GUI or CLI. Run CLI with '--help' for additional information on how to override these arguments.
 * @cliArgs --device "MCPC029" --part "MCPC029_48RGZ" --package "48RGZ"
 * @v2CliArgs --device "MCPC029" --package "48RGZ"
 */
/**
 * Import the modules used in this configuration.
 */
const device_support = scripting.addModule("/driverlib/device_support.js");
/**
 * Write custom configuration values to the imported modules.
 */
const divider2       = system.clockTree["PLL_PDIV"];
divider2.divideValue = 2;
const multiplier1         = system.clockTree["PLL_QDIV"];
multiplier1.multiplyValue = 32;
const mux1       = system.clockTree["OSCCLKSRCSEL"];
mux1.inputSelect = "X1_XTAL";