/**
 * These arguments were used when this file was generated. They will be automatically applied on subsequent loads
 * via the GUI or CLI. Run CLI with '--help' for additional information on how to override these arguments.
 * @cliArgs --device "F28P55x" --part "F28P55x_128PDT" --package "128PDT" --context "system" --product "C2000WARE@6.00.01.00"
 * @v2CliArgs --device "TMS320F28P550SG" --package "128PDT" --variant "TMS320F28P550SG9" --context "system" --product "C2000WARE@6.00.01.00"
 * @versions {"tool":"1.26.0"}
 */

/**
 * Import the modules used in this configuration.
 */
const npu  = scripting.addModule("/driverlib/npu.js", {}, false);
const npu1 = npu.addInstance();

/**
 * Write custom configuration values to the imported modules.
 */
npu1.$name = "myNPU0";
