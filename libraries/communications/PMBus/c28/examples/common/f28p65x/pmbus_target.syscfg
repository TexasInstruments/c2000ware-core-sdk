/**
 * @cliArgs --device F28P65x --package 256ZEJ --part F28P65x_256ZEJ --product "C2000WARE@4.01.00.00"
 * @versions {"tool":"1.12.0+2377"}
 */

/**
 * Import the modules used in this configuration.
 */
const device_support = scripting.addModule("/driverlib/device_support.js");
const pmbus  = scripting.addModule("/driverlib/pmbus.js");
const pmbus1 = pmbus.addInstance();

/**
 * Write custom configuration values to the imported modules.
 */
pmbus1.$name                        = "myPMBUS0";
pmbus1.registerInterrupts           = true;
pmbus1.BaudRate                     = 10000000;
pmbus1.mode                         = "Target";
pmbus1.OwnAddress                   = 0x6A;
pmbus1.TargetAddress                = 0x1A;
pmbus1.configTarget                 = ["PMBUS_TARGET_AUTO_ACK_4_BYTES","PMBUS_TARGET_ENABLE_PEC_PROCESSING"];
pmbus1.enabledInterrupts            = ["PMBUS_INT_DATA_READY","PMBUS_INT_DATA_REQUEST","PMBUS_INT_EOM"];
pmbus1.enablePMBus                  = true;
pmbus1.useInterrupts                = true;
pmbus1.pmbus.$assign                = "PMBUSA";
pmbus1.pmbus.pmbus_alertPin.$assign = "GPIO11";
pmbus1.pmbus.pmbus_ctlPin.$assign   = "GPIO12";
pmbus1.pmbus.pmbus_sclPin.$assign   = "GPIO14";
pmbus1.pmbus.pmbus_sdaPin.$assign   = "GPIO13";
pmbus1.PMBusInt.enableInterrupt     = true;
pmbus1.PMBusInt.interruptHandler    = "pmbusIntHandler";
