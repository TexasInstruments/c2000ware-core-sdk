/**
 * @cliArgs --device "F28P55x" --package "100PZ" --part "F28P55x_100PZ" --context "system" --product "C2000WARE@5.02.00.00"
 * @versions {"tool":"1.20.0+3514"}
 */

/**
 * Import the modules used in this configuration.
 */
const cputimer       = scripting.addModule("/driverlib/cputimer.js", {}, false);
const cputimer1      = cputimer.addInstance();
const device_support = scripting.addModule("/driverlib/device_support.js");
const sysctl         = scripting.addModule("/driverlib/sysctl.js");
const logger         = scripting.addModule("/libraries/control/dcl/logger.js", {}, false);
const logger1        = logger.addInstance();
const logger2        = logger.addInstance();
const logger3        = logger.addInstance();
const refgen         = scripting.addModule("/libraries/control/dcl/refgen.js", {}, false);
const refgen1        = refgen.addInstance();
const FPUfastRTS     = scripting.addModule("/libraries/math/FPUfastRTS/FPUfastRTS.js", {}, false);
const FPUfastRTS1    = FPUfastRTS.addInstance();
const CMD            = scripting.addModule("/utilities/cmd_tool/cmd_syscfg/source/CMD");
const CMD1           = CMD.addInstance();

/**
 * Write custom configuration values to the imported modules.
 */
cputimer1.$name                     = "myCPUTIMER0";
cputimer1.timerPeriod               = 100;
cputimer1.enableInterrupt           = true;
cputimer1.registerInterrupts        = true;
cputimer1.startTimer                = true;
cputimer1.timerInt.enableInterrupt  = true;
cputimer1.timerInt.$name            = "timer_Isr";
cputimer1.timerInt.interruptHandler = "timer_Isr";

logger1.$name     = "LoggerSineA";
logger1.logSize   = 400;
logger1.fillEn    = true;
logger1.linkerEn  = true;
logger1.linkerVal = "LoggerDataSection";

logger2.logSize   = 400;
logger2.fillEn    = true;
logger2.linkerEn  = true;
logger2.linkerVal = "LoggerDataSection";
logger2.$name     = "LoggerSineB";

logger3.linkerEn  = true;
logger3.fillEn    = true;
logger3.linkerVal = "LoggerDataSection";
logger3.$name     = "LoggerSineC";
logger3.logSize   = 400;

refgen1.$name = "myREFGEN0";
refgen1.umax  = 1;
refgen1.umin  = -1;
refgen1.mode  = "SINE3";
refgen1.ampl  = 2;

FPUfastRTS1.$name = "myFFR0";

CMD1.$name                        = "generic_ram_lnk";
CMD1.sectionMemory_const          = ["RAMLS5","RAMLS6"];
CMD1.sectionMemory_ramfunc        = ["RAMM0"];
CMD1.sectionMemory_init_array     = ["RAMM0"];
CMD1.sectionMemory_switch         = ["RAMM0"];
CMD1.sectionMemory_sysmem         = ["RAMLS4"];
CMD1.sectionMemory_stack          = ["RAMLS0"];
CMD1.sectionMemory_bss            = ["RAMGS1","RAMLS3","RAMLS4","RAMLS5"];
CMD1.sectionMemory_data           = ["RAMGS2","RAMLS5","RAMLS6","RAMLS7","RAMLS8"];
CMD1.sectionMemory_cinit          = ["RAMGS1"];
CMD1.sectionMemory_text           = ["RAMLS0","RAMLS1","RAMLS2","RAMLS3","RAMLS4","RAMLS5","RAMLS6","RAMLS7","RAMLS8","RAMLS9"];
CMD1.userSection.create(2);
CMD1.userSection[0].$name         = "LoggerDataSection";
CMD1.userSection[0].sectionMemory = ["RAMGS3"];
CMD1.userSection[1].$name         = "dclfuncs";
CMD1.userSection[1].sectionMemory = ["RAMGS3"];
