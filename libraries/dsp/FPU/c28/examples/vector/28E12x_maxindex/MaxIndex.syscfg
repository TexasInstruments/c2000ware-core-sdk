/**
 * @cliArgs --device "F28E12x" --part "F28E12x_48PT" --package "48PT" --context "system" --product "C2000WARE@6.00.00.00"
 * @versions {"tool":"1.24.0+4110"}
 */

/**
 * Import the modules used in this configuration.
 */
const device_support = scripting.addModule("/driverlib/device_support.js");
const sysctl         = scripting.addModule("/driverlib/sysctl.js");
const Vector         = scripting.addModule("/libraries/dsp/FPU/Vector/Vector.js", {}, false);
const Vector1        = Vector.addInstance();
const CMD            = scripting.addModule("/utilities/cmd_tool/cmd_syscfg/source/CMD");
const CMD1           = CMD.addInstance();
const CMD2           = CMD.addInstance();

/**
 * Write custom configuration values to the imported modules.
 */
Vector1.$name = "myVEC0";

CMD1.$name                    = "generic_ram_lnk";
CMD1.sectionMemory_ramfunc    = ["RAMM0"];
CMD1.sectionMemory_init_array = ["RAMM0"];
CMD1.sectionMemory_switch     = ["RAMM0"];
CMD1.sectionMemory_cinit      = ["RAMM0"];
CMD1.sectionMemory_text       = ["RAMGS0"];
CMD1.sectionMemory_bss        = ["RAMM1"];
CMD1.sectionMemory_stack      = ["RAMGS0"];
CMD1.sectionMemory_const      = ["RAMGS0"];
CMD1.sectionMemory_data       = ["RAMGS0"];
CMD1.sectionMemory_sysmem     = ["RAMGS0"];

CMD2.$name                               = "generic_flash_lnk";
CMD2.sectionAlignEnable_ramfunc          = true;
CMD2.sectionAlignEnable_text             = true;
CMD2.sectionAlignEnable_binit            = true;
CMD2.sectionAlignEnable_cinit            = true;
CMD2.sectionAlignEnable_switch           = true;
CMD2.sectionAlignEnable_init_array       = true;
CMD2.sectionAlignEnable_const            = true;
CMD2.sectionAlignEnable_ovly             = true;
CMD2.sectionMemory_codestart             = "0x080000";
CMD2.sectionRunFromDifferentAddr_ramfunc = true;
CMD2.sectionBinit_ramfunc                = false;
CMD2.sectionMemory_text                  = ["FLASH_BANK0_SEC_0_63"];
CMD2.sectionMemory_ramfunc               = ["FLASH_BANK0_SEC_0_63"];
CMD2.sectionRun_ramfunc                  = ["RAMGS0"];
CMD2.sectionMemory_binit                 = ["FLASH_BANK0_SEC_0_63"];
CMD2.sectionMemory_ovly                  = ["FLASH_BANK0_SEC_0_63"];
CMD2.sectionMemory_cinit                 = ["FLASH_BANK0_SEC_0_63"];
CMD2.sectionMemory_init_array            = ["FLASH_BANK0_SEC_0_63"];
CMD2.sectionMemory_bss                   = ["RAMM1"];
CMD2.sectionMemory_const                 = ["FLASH_BANK0_SEC_0_63"];
CMD2.sectionMemory_data                  = ["RAMGS0"];
CMD2.sectionMemory_switch                = ["FLASH_BANK0_SEC_0_63"];
CMD2.sectionMemory_sysmem                = ["RAMGS0"];
CMD2.sectionMemory_stack                 = ["RAMM0"];
