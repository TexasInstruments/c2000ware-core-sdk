/**
 * @cliArgs --device "F28P55x" --package "100PZ" --part "F28P55x_100PZ" --context "system" --product "C2000WARE@5.02.00.00"
 * @versions {"tool":"1.20.0+3514"}
 */

/**
 * Import the modules used in this configuration.
 */
const device_support = scripting.addModule("/driverlib/device_support.js");
const sysctl         = scripting.addModule("/driverlib/sysctl.js");
const vcrc           = scripting.addModule("/libraries/dsp/VCU/VCRC/vcrc.js", {}, false);
const vcrc1          = vcrc.addInstance();
const vcrc2          = vcrc.addInstance();
const vcrc3          = vcrc.addInstance();
const vcrc4          = vcrc.addInstance();
const vcrc5          = vcrc.addInstance();
const vcrc6          = vcrc.addInstance();
const vcrc7          = vcrc.addInstance();
const vcrc8          = vcrc.addInstance();
const vcrc9          = vcrc.addInstance();
const vcrc10         = vcrc.addInstance();
const vcrc11         = vcrc.addInstance();
const vcrc12         = vcrc.addInstance();
const vcrc13         = vcrc.addInstance();
const vcrc14         = vcrc.addInstance();
const vcrc15         = vcrc.addInstance();
const vcrc16         = vcrc.addInstance();
const vcrc17         = vcrc.addInstance();
const vcrc18         = vcrc.addInstance();
const vcrc19         = vcrc.addInstance();
const vcrc20         = vcrc.addInstance();
const vcrc21         = vcrc.addInstance();
const vcrc22         = vcrc.addInstance();
const CMD            = scripting.addModule("/utilities/cmd_tool/cmd_syscfg/source/CMD");
const CMD1           = CMD.addInstance();
const CMD2           = CMD.addInstance();

/**
 * Write custom configuration values to the imported modules.
 */
vcrc1.crcInit           = "CRC_init16Bit";
vcrc1.dataSize          = 7;
vcrc1.reflected         = true;
vcrc1.$name             = "VCRC_Ex1";
vcrc1.runVerification   = false;
vcrc1.cRoutineInputMode = "MANUAL";
vcrc1.cRoutineManual    = "CRC_run4BitENDATTableLookupC";
vcrc1.numMsgBytes       = 128;

vcrc2.crcInit           = "CRC_init16Bit";
vcrc2.dataSize          = 7;
vcrc2.reflected         = true;
vcrc2.runVerification   = false;
vcrc2.cRoutineInputMode = "MANUAL";
vcrc2.cRoutineManual    = "CRC_run4BitENDATTableLookupC";
vcrc2.$name             = "VCRC_Ex2";
vcrc2.numMsgBytes       = 7;

vcrc3.crcInit           = "CRC_init16Bit";
vcrc3.dataSize          = 7;
vcrc3.reflected         = true;
vcrc3.runVerification   = false;
vcrc3.cRoutineInputMode = "MANUAL";
vcrc3.$name             = "VCRC_Ex3";
vcrc3.cRoutineManual    = "CRC_run4BitENDATBitTableLookupC_Generic";
vcrc3.crcRun            = "CRC_runConfigPolyBitsReflected";
vcrc3.numMsgBytes       = 13;

vcrc4.crcInit           = "CRC_init16Bit";
vcrc4.dataSize          = 7;
vcrc4.reflected         = true;
vcrc4.runVerification   = false;
vcrc4.cRoutineInputMode = "MANUAL";
vcrc4.$name             = "VCRC_Ex4";
vcrc4.numMsgBytes       = 51;
vcrc4.crcRun            = "CRC_runConfigPolyBitsReflected";
vcrc4.cRoutineManual    = "CRC_run4BitENDATBitTableLookupC_Generic";

vcrc5.numMsgBytes = 8;
vcrc5.crcTable    = "crc16P2Table";
vcrc5.userPoly    = "0x1021";
vcrc5.polySize    = 15;
vcrc5.dataSize    = 7;
vcrc5.reflected   = true;
vcrc5.crcInit     = "CRC_init16Bit";
vcrc5.$name       = "VCRC_Ex5";
vcrc5.cRoutine    = "CRC_run16BitTableLookupC";

vcrc6.numMsgBytes = 128;
vcrc6.crcTable    = "crc16P1TableReflected";
vcrc6.userPoly    = "0x8005";
vcrc6.polySize    = 15;
vcrc6.dataSize    = 7;
vcrc6.crcInit     = "CRC_init16Bit";
vcrc6.cRoutine    = "CRC_run16BitReflectedTableLookupC";
vcrc6.crcRun      = "CRC_runConfigPolyBytes";
vcrc6.$name       = "VCRC_Ex6";

vcrc7.numMsgBytes = 6;
vcrc7.numMsgBits  = 48;
vcrc7.userPoly    = "0x1021";
vcrc7.polySize    = 15;
vcrc7.dataSize    = 7;
vcrc7.reflected   = true;
vcrc7.crcInit     = "CRC_init16Bit";
vcrc7.crcTable    = "crc16P2Table";
vcrc7.crcRun      = "CRC_runConfigPolyBitsReflected";
vcrc7.$name       = "VCRC_Ex7";
vcrc7.cRoutine    = "CRC_run16BitTableLookupC";

vcrc8.polySize    = 15;
vcrc8.dataSize    = 7;
vcrc8.crcInit     = "CRC_init16Bit";
vcrc8.numMsgBytes = 16;
vcrc8.numMsgBits  = 128;
vcrc8.userPoly    = "0x8005";
vcrc8.cRoutine    = "CRC_run16BitReflectedTableLookupC";
vcrc8.crcRun      = "CRC_runConfigPolyBits";
vcrc8.$name       = "VCRC_Ex8";
vcrc8.crcTable    = "crc16P1TableReflected";

vcrc9.polySize    = 15;
vcrc9.dataSize    = 7;
vcrc9.crcInit     = "CRC_init16Bit";
vcrc9.userPoly    = "0x8005";
vcrc9.$name       = "VCRC_Ex9";
vcrc9.numMsgBytes = 10;
vcrc9.parity      = "CRC_parity_odd";
vcrc9.crcTable    = "crc16P1Table";
vcrc9.reflected   = true;
vcrc9.cRoutine    = "CRC_run16BitTableLookupC";

vcrc10.polySize    = 15;
vcrc10.dataSize    = 7;
vcrc10.crcInit     = "CRC_init16Bit";
vcrc10.userPoly    = "0x8005";
vcrc10.parity      = "CRC_parity_odd";
vcrc10.$name       = "VCRC_Ex10";
vcrc10.numMsgBytes = 15;
vcrc10.crcTable    = "crc16P1TableReflected";
vcrc10.cRoutine    = "CRC_run16BitReflectedTableLookupC";
vcrc10.crcRun      = "CRC_runConfigPolyBytes";

vcrc11.polySize    = 15;
vcrc11.dataSize    = 7;
vcrc11.crcInit     = "CRC_init16Bit";
vcrc11.parity      = "CRC_parity_odd";
vcrc11.reflected   = true;
vcrc11.$name       = "VCRC_Ex11";
vcrc11.numMsgBytes = 6;
vcrc11.numMsgBits  = 48;
vcrc11.crcTable    = "crc16P2Table";
vcrc11.userPoly    = "0x1021";
vcrc11.crcRun      = "CRC_runConfigPolyBitsReflected";
vcrc11.cRoutine    = "CRC_run16BitTableLookupC";

vcrc12.polySize    = 15;
vcrc12.dataSize    = 7;
vcrc12.crcInit     = "CRC_init16Bit";
vcrc12.parity      = "CRC_parity_odd";
vcrc12.numMsgBytes = 6;
vcrc12.numMsgBits  = 48;
vcrc12.userPoly    = "0x1021";
vcrc12.$name       = "VCRC_Ex12";
vcrc12.crcRun      = "CRC_runConfigPolyBits";
vcrc12.cRoutine    = "CRC_run16BitReflectedTableLookupC";
vcrc12.crcTable    = "crc16P2TableReflected";

vcrc13.polySize    = 15;
vcrc13.dataSize    = 7;
vcrc13.crcInit     = "CRC_init16Bit";
vcrc13.numMsgBytes = 6;
vcrc13.numMsgBits  = 48;
vcrc13.userPoly    = "0x1021";
vcrc13.crcRun      = "CRC_runConfigPolyBits";
vcrc13.cRoutine    = "CRC_run16BitReflectedTableLookupC";
vcrc13.$name       = "VCRC_Ex13";
vcrc13.seedVal     = "0xFFFF";
vcrc13.crcTable    = "crc16P2TableReflected";

vcrc14.polySize    = 15;
vcrc14.dataSize    = 7;
vcrc14.crcInit     = "CRC_init16Bit";
vcrc14.numMsgBytes = 6;
vcrc14.numMsgBits  = 48;
vcrc14.userPoly    = "0x1021";
vcrc14.seedVal     = "0xFFFF";
vcrc14.$name       = "VCRC_Ex14";
vcrc14.crcTable    = "crc16P2Table";
vcrc14.reflected   = true;
vcrc14.crcRun      = "CRC_runConfigPolyBitsReflected";
vcrc14.cRoutine    = "CRC_run16BitTableLookupC";

vcrc15.dataSize    = 7;
vcrc15.$name       = "VCRC_Ex15";
vcrc15.seedVal     = "0xFFFFFFFF";
vcrc15.numMsgBytes = 16;
vcrc15.userPoly    = "0x04C11DB7";
vcrc15.polySize    = 31;
vcrc15.crcInit     = "CRC_init32Bit";
vcrc15.cRoutine    = "CRC_run32BitReflectedTableLookupC";
vcrc15.crcTable    = "crc32P1TableReflected";
vcrc15.crcRun      = "CRC_runConfigPolyBytes";

vcrc16.dataSize    = 7;
vcrc16.seedVal     = "0xFFFFFFFF";
vcrc16.userPoly    = "0x04C11DB7";
vcrc16.polySize    = 31;
vcrc16.crcInit     = "CRC_init32Bit";
vcrc16.$name       = "VCRC_Ex16";
vcrc16.numMsgBytes = 6;
vcrc16.crcTable    = "crc32P1Table";
vcrc16.reflected   = true;
vcrc16.cRoutine    = "CRC_run32BitTableLookupC";

vcrc17.dataSize    = 7;
vcrc17.seedVal     = "0xFFFFFFFF";
vcrc17.userPoly    = "0x04C11DB7";
vcrc17.polySize    = 31;
vcrc17.crcInit     = "CRC_init32Bit";
vcrc17.numMsgBytes = 6;
vcrc17.$name       = "VCRC_Ex17";
vcrc17.numMsgBits  = 48;
vcrc17.crcTable    = "crc32P1TableReflected";
vcrc17.cRoutine    = "CRC_run32BitReflectedTableLookupC";
vcrc17.crcRun      = "CRC_runConfigPolyBits";

vcrc18.dataSize    = 7;
vcrc18.seedVal     = "0xFFFFFFFF";
vcrc18.userPoly    = "0x04C11DB7";
vcrc18.polySize    = 31;
vcrc18.crcInit     = "CRC_init32Bit";
vcrc18.reflected   = true;
vcrc18.$name       = "VCRC_Ex18";
vcrc18.numMsgBytes = 16;
vcrc18.numMsgBits  = 128;
vcrc18.crcTable    = "crc32P1Table";
vcrc18.cRoutine    = "CRC_run32BitTableLookupC";
vcrc18.crcRun      = "CRC_runConfigPolyBitsReflected";

vcrc19.dataSize          = 7;
vcrc19.reflected         = true;
vcrc19.numMsgBytes       = 16;
vcrc19.cRoutine          = "CRC_run32BitTableLookupC";
vcrc19.$name             = "VCRC_Ex19";
vcrc19.userPoly          = "0x1EDC6F41";
vcrc19.userPolyInputMode = "MANUAL";
vcrc19.userPolyManual    = "0x1685B";
vcrc19.polySize          = 16;
vcrc19.cRoutineInputMode = "MANUAL";
vcrc19.cRoutineManual    = "CRC_run17BitCANFDTableLookupC";
vcrc19.crcTable          = "crc16P2Table";
vcrc19.crcInit           = "CRC_init16Bit";

vcrc20.dataSize          = 7;
vcrc20.reflected         = true;
vcrc20.numMsgBytes       = 16;
vcrc20.cRoutine          = "CRC_run32BitTableLookupC";
vcrc20.userPoly          = "0x1EDC6F41";
vcrc20.userPolyInputMode = "MANUAL";
vcrc20.userPolyManual    = "0x1685B";
vcrc20.polySize          = 16;
vcrc20.cRoutineInputMode = "MANUAL";
vcrc20.cRoutineManual    = "CRC_run17BitCANFDTableLookupC";
vcrc20.crcTable          = "crc16P2Table";
vcrc20.$name             = "VCRC_Ex20";
vcrc20.numMsgBits        = 128;
vcrc20.crcRun            = "CRC_runConfigPolyBitsReflected";
vcrc20.crcInit           = "CRC_init16Bit";

vcrc21.dataSize          = 7;
vcrc21.reflected         = true;
vcrc21.cRoutine          = "CRC_run32BitTableLookupC";
vcrc21.userPolyManual    = "0x1685B";
vcrc21.crcRun            = "CRC_runConfigPolyBitsReflected";
vcrc21.$name             = "VCRC_Ex21";
vcrc21.numMsgBytes       = 4;
vcrc21.numMsgBits        = 32;
vcrc21.userPoly          = "0x0007";
vcrc21.polySize          = 7;
vcrc21.crcInit           = "CRC_init16Bit";
vcrc21.cRoutineInputMode = "MANUAL";
vcrc21.cRoutineManual    = "CRC_run8BitTableLookupC";

vcrc22.dataSize          = 7;
vcrc22.reflected         = true;
vcrc22.cRoutine          = "CRC_run32BitTableLookupC";
vcrc22.userPolyManual    = "0x1685B";
vcrc22.userPoly          = "0x0007";
vcrc22.polySize          = 7;
vcrc22.crcInit           = "CRC_init16Bit";
vcrc22.cRoutineInputMode = "MANUAL";
vcrc22.cRoutineManual    = "CRC_run8BitTableLookupC";
vcrc22.numMsgBytes       = 7;
vcrc22.parity            = "CRC_parity_odd";
vcrc22.$name             = "VCRC_Ex22";

CMD1.$name                         = "generic_ram_lnk";
CMD1.sectionMemory_const           = ["RAMLS5","RAMLS6"];
CMD1.sectionMemory_ramfunc         = ["RAMM0"];
CMD1.sectionMemory_init_array      = ["RAMM0"];
CMD1.sectionMemory_switch          = ["RAMM0"];
CMD1.sectionMemory_sysmem          = ["RAMLS4"];
CMD1.sectionMemory_stack           = ["RAMLS0"];
CMD1.sectionMemory_text            = ["RAMGS0","RAMGS1","RAMLS0","RAMLS1","RAMLS2","RAMLS3"];
CMD1.sectionMemory_data            = ["RAMLS5","RAMLS6","RAMLS7","RAMLS8","RAMLS9"];
CMD1.sectionMemory_cinit           = ["RAMGS1"];
CMD1.sectionMemory_bss             = ["RAMLS2","RAMLS3","RAMLS4","RAMLS5"];
CMD1.userSection.create(2);
CMD1.userSection[0].$name          = "testInput";
CMD1.userSection[0].sectionMemory  = ["RAMGS1"];
CMD1.userSection[1].$name          = "TEST_INPUT_CRC";
CMD1.userSection[1].sectionMemory  = ["RAMGS0"];
CMD1.userSection[1].sectionBinit   = false;
CMD1.userSection[1].sectionSymbols = ["loadSize","loadStart","runSize","runStart"];

CMD2.$name                         = "generic_flash_lnk";
CMD2.sectionAlignEnable_ramfunc          = true;
CMD2.sectionAlignEnable_text             = true;
CMD2.sectionAlignEnable_binit            = true;
CMD2.sectionAlignEnable_cinit            = true;
CMD2.sectionAlignEnable_switch           = true;
CMD2.sectionAlignEnable_init_array       = true;
CMD2.sectionAlignEnable_const            = true;
CMD2.sectionAlignEnable_ovly             = true;
CMD2.sectionMemory_codestart             = "0x080000";
CMD2.sectionMemory_stack                 = ["RAMM1"];
CMD2.sectionMemory_bss                   = ["RAMLS5"];
CMD2.sectionMemory_data                  = ["RAMLS5"];
CMD2.sectionMemory_sysmem                = ["RAMLS4"];
CMD2.sectionMemory_ramfunc               = ["FLASH_BANK0"];
CMD2.sectionMemory_binit                 = ["FLASH_BANK0"];
CMD2.sectionMemory_cinit                 = ["FLASH_BANK0"];
CMD2.sectionMemory_switch                = ["FLASH_BANK0"];
CMD2.sectionMemory_init_array            = ["FLASH_BANK0"];
CMD2.sectionMemory_const                 = ["FLASH_BANK0"];
CMD2.sectionMemory_ovly                  = ["FLASH_BANK0"];
CMD2.sectionRunFromDifferentAddr_ramfunc = true;
CMD2.sectionRun_ramfunc                  = ["RAMLS0"];
CMD2.sectionBinit_ramfunc                = false;
CMD2.sectionMemory_text                  = ["FLASH_BANK0"];
