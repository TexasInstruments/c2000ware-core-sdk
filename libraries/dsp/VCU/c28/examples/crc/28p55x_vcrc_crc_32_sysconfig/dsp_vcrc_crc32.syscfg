/**
 * @cliArgs --device "F28P55x" --package "100PZ" --part "F28P55x_100PZ" --context "system" --product "C2000WARE@5.02.00.00"
 * @versions {"tool":"1.20.0+3514"}
 */

/**
 * Import the modules used in this configuration.
 */
const device_support = scripting.addModule("/driverlib/device_support.js");
const sysctl         = scripting.addModule("/driverlib/sysctl.js");
const vcrc           = scripting.addModule("/libraries/dsp/VCU/VCRC/vcrc.js", {}, false);
const vcrc1          = vcrc.addInstance();
const vcrc2          = vcrc.addInstance();
const CMD            = scripting.addModule("/utilities/cmd_tool/cmd_syscfg/source/CMD");
const CMD1           = CMD.addInstance();
const CMD2           = CMD.addInstance();

/**
 * Write custom configuration values to the imported modules.
 */
vcrc1.$name             = "VCRC_Ex1";
vcrc1.cRoutineManual    = "CRC_run4BitENDATTableLookupC";
vcrc1.numMsgBytes       = 128;
vcrc1.crcTable          = "crc32P1Table";
vcrc1.cRoutine          = "CRC_run32BitTableLookupC";
vcrc1.crcInit           = "CRC_init32Bit";
vcrc1.userPoly          = "0x04C11DB7";
vcrc1.polySize          = 0;
vcrc1.userPolyInputMode = "MANUAL";
vcrc1.crcRun            = "CRC_runConfigPolyBytes";

vcrc2.cRoutineManual    = "CRC_run4BitENDATTableLookupC";
vcrc2.numMsgBytes       = 128;
vcrc2.crcInit           = "CRC_init32Bit";
vcrc2.userPoly          = "0x04C11DB7";
vcrc2.polySize          = 0;
vcrc2.$name             = "VCRC_Ex2";
vcrc2.cRoutine          = "CRC_run32BitReflectedTableLookupC";
vcrc2.crcTable          = "crc32P1TableReflected";
vcrc2.userPolyInputMode = "MANUAL";
vcrc2.crcRun            = "CRC_runConfigPolyBytes";

CMD1.$name                    = "generic_ram_lnk";
CMD1.sectionMemory_stack      = ["RAMM1"];
CMD1.sectionMemory_bss        = ["RAMLS5"];
CMD1.sectionMemory_data       = ["RAMLS5"];
CMD1.sectionMemory_sysmem     = ["RAMLS4"];
CMD1.sectionMemory_binit      = ["FLASH_BANK0"];
CMD1.sectionAlignEnable_binit = true;
CMD1.sectionMemory_ramfunc    = ["RAMM0"];
CMD1.sectionMemory_cinit      = ["RAMM0"];
CMD1.sectionMemory_switch     = ["RAMM0"];
CMD1.sectionMemory_init_array = ["RAMM0"];
CMD1.sectionMemory_const      = ["RAMLS5","RAMLS6"];
CMD1.sectionMemory_text       = ["RAMGS0","RAMLS0","RAMLS1","RAMLS2","RAMLS3","RAMLS4","RAMLS5","RAMLS6","RAMLS7","RAMLS8","RAMLS9"];

CMD2.$name                         = "generic_flash_lnk";
CMD2.sectionAlignEnable_ramfunc          = true;
CMD2.sectionAlignEnable_text             = true;
CMD2.sectionAlignEnable_binit            = true;
CMD2.sectionAlignEnable_cinit            = true;
CMD2.sectionAlignEnable_switch           = true;
CMD2.sectionAlignEnable_init_array       = true;
CMD2.sectionAlignEnable_const            = true;
CMD2.sectionAlignEnable_ovly             = true;
CMD2.sectionMemory_codestart             = "0x080000";
CMD2.sectionMemory_stack                 = ["RAMM1"];
CMD2.sectionMemory_bss                   = ["RAMLS5"];
CMD2.sectionMemory_data                  = ["RAMLS5"];
CMD2.sectionMemory_sysmem                = ["RAMLS4"];
CMD2.sectionMemory_ramfunc               = ["FLASH_BANK0"];
CMD2.sectionMemory_binit                 = ["FLASH_BANK0"];
CMD2.sectionMemory_cinit                 = ["FLASH_BANK0"];
CMD2.sectionMemory_switch                = ["FLASH_BANK0"];
CMD2.sectionMemory_init_array            = ["FLASH_BANK0"];
CMD2.sectionMemory_const                 = ["FLASH_BANK0"];
CMD2.sectionMemory_ovly                  = ["FLASH_BANK0"];
CMD2.sectionRunFromDifferentAddr_ramfunc = true;
CMD2.sectionRun_ramfunc                  = ["RAMLS0"];
CMD2.sectionBinit_ramfunc                = false;
CMD2.sectionMemory_text                  = ["FLASH_BANK0"];
